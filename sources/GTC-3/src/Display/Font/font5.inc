#include "font.h"
const Font font5 = {
	5, {
/*0*/		{ 0, { 0,	0,	0,	0,	0,	0,	0,	0	} },	
/*1*/		{ 0, { 0,	0,	0,	0,	0,	0,	0,	0	} },	
/*2*/		{ 0, { 0,	0,	0,	0,	0,	0,	0,	0	} },	
/*3*/		{ 0, { 0,	0,	0,	0,	0,	0,	0,	0	} },	
/*4*/		{ 0, { 0,	0,	0,	0,	0,	0,	0,	0	} },	
/*5*/		{ 0, { 0,	0,	0,	0,	0,	0,	0,	0	} },	
/*6*/		{ 0, { 0,	0,	0,	0,	0,	0,	0,	0	} },	
/*7*/		{ 0, { 0,	0,	0,	0,	0,	0,	0,	0	} },	
/*8*/		{ 0, { 0,	0,	0,	0,	0,	0,	0,	0	} },	
/*9*/		{ 0, { 0,	0,	0,	0,	0,	0,	0,	0	} },	
/*10*/		{ 0, { 0,	0,	0,	0,	0,	0,	0,	0	} },	
/*11*/		{ 0, { 0,	0,	0,	0,	0,	0,	0,	0	} },	
/*12*/		{ 0, { 0,	0,	0,	0,	0,	0,	0,	0	} },	
/*13*/		{ 0, { 0,	0,	0,	0,	0,	0,	0,	0	} },	
/*14*/		{ 0, { 0,	0,	0,	0,	0,	0,	0,	0	} },	
/*15*/		{ 0, { 0,	0,	0,	0,	0,	0,	0,	0	} },	
/*16*/		{ 0, { 0,	0,	0,	0,	0,	0,	0,	0	} },	
/*17*/		{ 1, { 0,	0,	0,	0,	0,	0,	0,	0	} },	
/*18*/		{ 2, { 0,	0,	0,	0,	0,	0,	0,	0	} },	
/*19*/		{ 3, { 0,	0,	0,	0,	0,	0,	0,	0	} },	
/*20*/		{ 4, { 0,	0,	0,	0,	0,	0,	0,	0	} },	
/*21*/		{ 5, { 0,	0,	0,	0,	0,	0,	0,	0	} },	
/*22*/		{ 6, { 0,	0,	0,	0,	0,	0,	0,	0	} },	
/*23*/		{ 7, { 0,	0,	0,	0,	0,	0,	0,	0	} },	
/*24*/		{ 8, { 0,	0,	0,	0,	0,	0,	0,	0	} },	
/*25*/		{ 9, { 0,	0,	0,	0,	0,	0,	0,	0	} },	
/*26*/		{ 10, { 0,	0,	0,	0,	0,	0,	0,	0	} },	
/*27*/		{ 11, { 0,	0,	0,	0,	0,	0,	0,	0	} },	
/*28*/		{ 12, { 0,	0,	0,	0,	0,	0,	0,	0	} },	
/*29*/		{ 13, { 0,	0,	0,	0,	0,	0,	0,	0	} },	
/*30*/		{ 14, { 0,	0,	0,	0,	0,	0,	0,	0	} },	
/*31*/		{ 15, { 0,	0,	0,	0,	0,	0,	0,	0	} },	
/*32*/		{ 1, { 0,	0,	0,	0,	0,	0,	0,	0	} },	
/*33*/		{ 8, { 1,	1,	1,	0,	1,	0,	0,	0	} },	
/*34*/		{ 8, { 0,	0,	0,	0,	1,	0,	0,	0	} },	
/*35*/		{ 8, { 0,	10,	31,	10,	10,	31,	10,	0	} },	
/*36*/		{ 8, { 0,	4,	31,	5,	31,	20,	31,	4	} },	
/*37*/		{ 8, { 9,	4,	6,	2,	9,	0,	0,	0	} },	
/*38*/		{ 8, { 0,	4,	10,	4,	26,	9,	22,	0	} },	
/*39*/		{ 7, { 0,	4,	2,	0,	0,	0,	0,	0	} },	
/*40*/		{ 8, { 2,	1,	1,	1,	2,	0,	0,	0	} },	
/*41*/		{ 8, { 1,	2,	2,	2,	1,	0,	0,	0	} },	
/*42*/		{ 8, { 0,	0,	10,	4,	31,	4,	10,	0	} },	
/*43*/		{ 8, { 0,	2,	7,	2,	0,	0,	0,	0	} },	
/*44*/		{ 8, { 0,	0,	0,	2,	1,	0,	0,	0	} },	
/*45*/		{ 8, { 0,	0,	7,	0,	0,	0,	0,	0	} },	
/*46*/		{ 8, { 0,	0,	0,	0,	1,	0,	0,	0	} },	
/*47*/		{ 8, { 0,	2,	2,	1,	1,	0,	0,	0	} },	
/*48*/		{ 8, { 7,	5,	5,	5,	7,	0,	0,	0	} },	
/*49*/		{ 8, { 3,	2,	2,	2,	7,	0,	0,	0	} },	
/*50*/		{ 8, { 7,	4,	7,	1,	7,	0,	0,	0	} },	
/*51*/		{ 8, { 7,	4,	7,	4,	7,	0,	0,	0	} },	
/*52*/		{ 8, { 5,	5,	7,	4,	4,	0,	0,	0	} },	
/*53*/		{ 8, { 7,	1,	7,	4,	7,	0,	0,	0	} },	
/*54*/		{ 8, { 7,	1,	7,	5,	7,	0,	0,	0	} },	
/*55*/		{ 8, { 7,	4,	2,	1,	1,	0,	0,	0	} },	
/*56*/		{ 8, { 7,	5,	7,	5,	7,	0,	0,	0	} },	
/*57*/		{ 8, { 7,	5,	7,	4,	7,	0,	0,	0	} },	
/*58*/		{ 8, { 1,	0,	0,	0,	1,	0,	0,	0	} },	
/*59*/		{ 7, { 0,	0,	4,	0,	0,	4,	4,	2	} },	
/*60*/		{ 8, { 5,	5,	0,	0,	0,	0,	0,	0	} },	
/*61*/		{ 8, { 0,	3,	0,	3,	0,	0,	0,	0	} },	
/*62*/		{ 8, { 1,	2,	4,	2,	1,	0,	0,	0	} },	
/*63*/		{ 8, { 0,	14,	17,	8,	4,	0,	4,	0	} },	
/*64*/		{ 8, { 0,	14,	25,	21,	13,	1,	14,	0	} },	
/*65*/		{ 8, { 7,	5,	7,	5,	5,	0,	0,	0	} },	
/*66*/		{ 8, { 7,	5,	3,	5,	7,	0,	0,	0	} },	
/*67*/		{ 8, { 7,	1,	1,	1,	7,	0,	0,	0	} },	
/*68*/		{ 8, { 3,	5,	5,	5,	3,	0,	0,	0	} },	
/*69*/		{ 8, { 7,	1,	7,	1,	7,	0,	0,	0	} },	
/*70*/		{ 8, { 7,	1,	7,	1,	1,	0,	0,	0	} },	
/*71*/		{ 8, { 7,	1,	1,	5,	7,	0,	0,	0	} },	
/*72*/		{ 8, { 5,	5,	7,	5,	5,	0,	0,	0	} },	
/*73*/		{ 8, { 7,	2,	2,	2,	7,	0,	0,	0	} },	
/*74*/		{ 8, { 4,	4,	4,	5,	7,	0,	0,	0	} },	
/*75*/		{ 8, { 5,	3,	1,	3,	5,	0,	0,	0	} },	
/*76*/		{ 8, { 1,	1,	1,	1,	7,	0,	0,	0	} },	
/*77*/		{ 8, { 17,	27,	21,	17,	17,	0,	0,	0	} },	
/*78*/		{ 8, { 9,	11,	13,	9,	9,	0,	0,	0	} },	
/*79*/		{ 8, { 7,	5,	5,	5,	7,	0,	0,	0	} },	
/*80*/		{ 8, { 7,	5,	7,	1,	1,	0,	0,	0	} },	
/*81*/		{ 8, { 7,	5,	5,	13,	7,	0,	0,	0	} },	
/*82*/		{ 8, { 7,	5,	7,	3,	5,	0,	0,	0	} },	
/*83*/		{ 8, { 7,	1,	7,	4,	7,	0,	0,	0	} },	
/*84*/		{ 8, { 7,	2,	2,	2,	2,	0,	0,	0	} },	
/*85*/		{ 8, { 5,	5,	5,	5,	7,	0,	0,	0	} },	
/*86*/		{ 8, { 5,	5,	5,	7,	2,	0,	0,	0	} },	
/*87*/		{ 8, { 17,	17,	17,	21,	10,	0,	0,	0	} },	
/*88*/		{ 8, { 9,	6,	2,	6,	9,	0,	0,	0	} },	
/*89*/		{ 8, { 5,	5,	5,	2,	2,	0,	0,	0	} },	
/*90*/		{ 8, { 15,	8,	4,	2,	15,	0,	0,	0	} },	
/*91*/		{ 8, { 3,	1,	1,	1,	3,	0,	0,	0	} },	
/*92*/		{ 8, { 0,	0,	1,	2,	4,	8,	16,	0	} },	
/*93*/		{ 8, { 3,	2,	2,	2,	3,	0,	0,	0	} },	
/*94*/		{ 8, { 0,	4,	14,	21,	4,	4,	4,	0	} },	
/*95*/		{ 8, { 0,	0,	0,	0,	7,	0,	0,	0	} },	
/*96*/		{ 8, { 0,	12,	18,	7,	2,	2,	31,	0	} },	
/*97*/		{ 8, { 7,	5,	7,	5,	5,	0,	0,	0	} },	
/*98*/		{ 8, { 7,	5,	3,	5,	7,	0,	0,	0	} },	
/*99*/		{ 8, { 7,	1,	1,	1,	7,	0,	0,	0	} },	
/*100*/		{ 8, { 3,	5,	5,	5,	3,	0,	0,	0	} },	
/*101*/		{ 8, { 7,	1,	7,	1,	7,	0,	0,	0	} },	
/*102*/		{ 8, { 7,	1,	3,	1,	1,	0,	0,	0	} },	
/*103*/		{ 8, { 7,	1,	1,	5,	7,	0,	0,	0	} },	
/*104*/		{ 8, { 5,	5,	7,	5,	5,	0,	0,	0	} },	
/*105*/		{ 8, { 7,	2,	2,	2,	7,	0,	0,	0	} },	
/*106*/		{ 8, { 4,	4,	4,	5,	7,	0,	0,	0	} },	
/*107*/		{ 8, { 5,	3,	1,	3,	5,	0,	0,	0	} },	
/*108*/		{ 8, { 1,	1,	1,	1,	7,	0,	0,	0	} },	
/*109*/		{ 8, { 17,	27,	21,	17,	17,	0,	0,	0	} },	
/*110*/		{ 8, { 9,	11,	13,	9,	9,	0,	0,	0	} },	
/*111*/		{ 8, { 7,	5,	5,	5,	7,	0,	0,	0	} },	
/*112*/		{ 8, { 7,	5,	7,	1,	1,	0,	0,	0	} },	
/*113*/		{ 8, { 7,	5,	5,	13,	7,	0,	0,	0	} },	
/*114*/		{ 8, { 7,	5,	7,	3,	5,	0,	0,	0	} },	
/*115*/		{ 8, { 7,	1,	7,	4,	7,	0,	0,	0	} },	
/*116*/		{ 8, { 7,	2,	2,	2,	2,	0,	0,	0	} },	
/*117*/		{ 8, { 5,	5,	5,	5,	7,	0,	0,	0	} },	
/*118*/		{ 8, { 5,	5,	5,	5,	2,	0,	0,	0	} },	
/*119*/		{ 8, { 17,	17,	17,	21,	10,	0,	0,	0	} },	
/*120*/		{ 8, { 17,	10,	4,	10,	17,	0,	0,	0	} },	
/*121*/		{ 8, { 5,	5,	7,	2,	2,	0,	0,	0	} },	
/*122*/		{ 8, { 15,	8,	4,	2,	15,	0,	0,	0	} },	
/*123*/		{ 8, { 0,	28,	4,	3,	4,	4,	28,	0	} },	
/*124*/		{ 6, { 0,	4,	4,	4,	4,	4,	4,	0	} },	
/*125*/		{ 8, { 0,	7,	4,	24,	4,	4,	7,	0	} },	
/*126*/		{ 7, { 0,	20,	10,	0,	0,	0,	0,	0	} },	
/*127*/		{ 0, { 0,	0,	0,	0,	0,	0,	0,	0	} },	
/*128*/		{ 0, { 0,	0,	0,	0,	0,	0,	0,	0	} },	
/*129*/		{ 0, { 0,	0,	0,	0,	0,	0,	0,	0	} },	
/*130*/		{ 0, { 0,	0,	0,	0,	0,	0,	0,	0	} },	
/*131*/		{ 0, { 0,	0,	0,	0,	0,	0,	0,	0	} },	
/*132*/		{ 0, { 0,	0,	0,	0,	0,	0,	0,	0	} },	
/*133*/		{ 0, { 0,	0,	0,	0,	0,	0,	0,	0	} },	
/*134*/		{ 0, { 0,	0,	0,	0,	0,	0,	0,	0	} },	
/*135*/		{ 0, { 0,	0,	0,	0,	0,	0,	0,	0	} },	
/*136*/		{ 8, { 0,	0,	0,	63,	0,	0,	0,	0	} },	
/*137*/		{ 8, { 63,	0,	63,	0,	0,	0,	0,	0	} },	
/*138*/		{ 0, { 0,	0,	0,	0,	0,	0,	0,	0	} },	
/*139*/		{ 0, { 0,	0,	0,	0,	0,	0,	0,	0	} },	
/*140*/		{ 0, { 0,	0,	0,	0,	0,	0,	0,	0	} },	
/*141*/		{ 0, { 0,	0,	0,	0,	0,	0,	0,	0	} },	
/*142*/		{ 0, { 0,	0,	0,	0,	0,	0,	0,	0	} },	
/*143*/		{ 0, { 0,	0,	0,	0,	0,	0,	0,	0	} },	
/*144*/		{ 8, { 0,	8,	8,	8,	8,	127,	0,	0	} },	
/*145*/		{ 8, { 0,	0,	6,	73,	48,	0,	0,	0	} },	
/*146*/		{ 8, { 0,	0,	127,	0,	107,	0,	0,	0	} },	
/*147*/		{ 8, { 0,	0,	3,	0,	0,	0,	0,	0	} },	
/*148*/		{ 0, { 0,	0,	0,	0,	0,	0,	0,	0	} },	
/*149*/		{ 0, { 0,	0,	0,	0,	0,	0,	0,	0	} },	
/*150*/		{ 0, { 0,	0,	0,	0,	0,	0,	0,	0	} },	
/*151*/		{ 0, { 0,	0,	0,	0,	0,	0,	0,	0	} },	
/*152*/		{ 0, { 0,	0,	0,	0,	0,	0,	0,	0	} },	
/*153*/		{ 0, { 0,	0,	0,	0,	0,	0,	0,	0	} },	
/*154*/		{ 0, { 0,	0,	0,	0,	0,	0,	0,	0	} },	
/*155*/		{ 0, { 0,	0,	0,	0,	0,	0,	0,	0	} },	
/*156*/		{ 0, { 0,	0,	0,	0,	0,	0,	0,	0	} },	
/*157*/		{ 0, { 0,	0,	0,	0,	0,	0,	0,	0	} },	
/*158*/		{ 0, { 0,	0,	0,	0,	0,	0,	0,	0	} },	
/*159*/		{ 0, { 0,	0,	0,	0,	0,	0,	0,	0	} },	
/*160*/		{ 8, { 0,	7,	7,	1,	7,	0,	0,	0	} },	
/*161*/		{ 8, { 24,	36,	66,	129,	0,	0,	0,	0	} },	
/*162*/		{ 8, { 0,	0,	0,	0,	129,	66,	36,	24	} },	
/*163*/		{ 8, { 24,	60,	126,	255,	0,	0,	0,	0	} },	
/*164*/		{ 8, { 0,	0,	0,	0,	255,	126,	60,	24	} },	
/*165*/		{ 8, { 1,	0,	0,	0,	1,	0,	0,	0	} },	
/*166*/		{ 8, { 7,	4,	14,	4,	28,	0,	0,	0	} },	
/*167*/		{ 8, { 28,	4,	14,	4,	7,	0,	0,	0	} },	
/*168*/		{ 8, { 1,	0,	0,	0,	1,	0,	0,	0	} },	
/*169*/		{ 8, { 15,	33,	49,	249,	49,	33,	15,	0	} },	
/*170*/		{ 0, { 0,	0,	0,	0,	0,	0,	0,	0	} },	
/*171*/		{ 0, { 0,	0,	0,	0,	0,	0,	0,	0	} },	
/*172*/		{ 0, { 0,	0,	0,	0,	0,	0,	0,	0	} },	
/*173*/		{ 0, { 0,	0,	0,	0,	0,	0,	0,	0	} },	
/*174*/		{ 0, { 0,	0,	0,	0,	0,	0,	0,	0	} },	
/*175*/		{ 0, { 0,	0,	0,	0,	0,	0,	0,	0	} },	
/*176*/		{ 8, { 0,	7,	7,	1,	7,	0,	0,	0	} },	
/*177*/		{ 8, { 0,	0,	0,	0,	0,	0,	255,	0	} },	
/*178*/		{ 8, { 62,	65,	65,	65,	65,	65,	128,	0	} },	
/*179*/		{ 8, { 124,	130,	130,	130,	130,	130,	1,	0	} },	
/*180*/		{ 8, { 0,	0,	0,	0,	0,	0,	255,	0	} },	
/*181*/		{ 8, { 252,	2,	2,	2,	2,	2,	1,	0	} },	
/*182*/		{ 8, { 63,	64,	64,	64,	64,	64,	128,	0	} },	
/*183*/		{ 0, { 0,	0,	0,	0,	0,	0,	0,	0	} },	
/*184*/		{ 0, { 0,	0,	0,	0,	0,	0,	0,	0	} },	
/*185*/		{ 0, { 0,	0,	0,	0,	0,	0,	0,	0	} },	
/*186*/		{ 0, { 0,	0,	0,	0,	0,	0,	0,	0	} },	
/*187*/		{ 0, { 0,	0,	0,	0,	0,	0,	0,	0	} },	
/*188*/		{ 0, { 0,	0,	0,	0,	0,	0,	0,	0	} },	
/*189*/		{ 0, { 0,	0,	0,	0,	0,	0,	0,	0	} },	
/*190*/		{ 0, { 0,	0,	0,	0,	0,	0,	0,	0	} },	
/*191*/		{ 0, { 0,	0,	0,	0,	0,	0,	0,	0	} },	
/*192*/		{ 8, { 7,	5,	7,	5,	5,	0,	0,	0	} },	
/*193*/		{ 8, { 7,	1,	7,	5,	7,	0,	0,	0	} },	
/*194*/		{ 8, { 7,	5,	3,	5,	7,	0,	0,	0	} },	
/*195*/		{ 8, { 7,	1,	1,	1,	1,	0,	0,	0	} },	
/*196*/		{ 8, { 14,	10,	10,	31,	17,	0,	0,	0	} },	
/*197*/		{ 8, { 7,	1,	7,	1,	7,	0,	0,	0	} },	
/*198*/		{ 8, { 9,	6,	15,	6,	9,	0,	0,	0	} },	
/*199*/		{ 8, { 7,	4,	2,	4,	7,	0,	0,	0	} },	
/*200*/		{ 8, { 9,	13,	11,	9,	9,	0,	0,	0	} },	
/*201*/		{ 8, { 9,	13,	11,	9,	9,	0,	0,	0	} },	
/*202*/		{ 8, { 5,	3,	1,	3,	5,	0,	0,	0	} },	
/*203*/		{ 8, { 6,	5,	5,	5,	5,	0,	0,	0	} },	
/*204*/		{ 8, { 17,	27,	21,	17,	17,	0,	0,	0	} },	
/*205*/		{ 8, { 5,	5,	7,	5,	5,	0,	0,	0	} },	
/*206*/		{ 8, { 7,	5,	5,	5,	7,	0,	0,	0	} },	
/*207*/		{ 8, { 7,	5,	5,	5,	5,	0,	0,	0	} },	
/*208*/		{ 8, { 7,	5,	7,	1,	1,	0,	0,	0	} },	
/*209*/		{ 8, { 7,	1,	1,	1,	7,	0,	0,	0	} },	
/*210*/		{ 8, { 7,	2,	2,	2,	2,	0,	0,	0	} },	
/*211*/		{ 8, { 5,	5,	7,	4,	7,	0,	0,	0	} },	
/*212*/		{ 8, { 31,	21,	21,	31,	4,	0,	0,	0	} },	
/*213*/		{ 8, { 9,	6,	6,	6,	9,	0,	0,	0	} },	
/*214*/		{ 8, { 5,	5,	5,	5,	15,	0,	0,	0	} },	
/*215*/		{ 8, { 5,	5,	7,	4,	4,	0,	0,	0	} },	
/*216*/		{ 8, { 21,	21,	21,	21,	31,	0,	0,	0	} },	
/*217*/		{ 8, { 21,	21,	21,	21,	63,	0,	0,	0	} },	
/*218*/		{ 8, { 3,	2,	14,	10,	14,	0,	0,	0	} },	
/*219*/		{ 8, { 17,	17,	23,	21,	23,	0,	0,	0	} },	
/*220*/		{ 8, { 1,	1,	7,	5,	7,	0,	0,	0	} },	
/*221*/		{ 8, { 7,	4,	7,	4,	7,	0,	0,	0	} },	
/*222*/		{ 8, { 29,	21,	23,	21,	29,	0,	0,	0	} },	
/*223*/		{ 8, { 15,	9,	15,	10,	9,	0,	0,	0	} },	
/*224*/		{ 8, { 7,	5,	7,	5,	5,	0,	0,	0	} },	
/*225*/		{ 8, { 7,	1,	7,	5,	7,	0,	0,	0	} },	
/*226*/		{ 8, { 7,	5,	3,	5,	7,	0,	0,	0	} },	
/*227*/		{ 8, { 7,	1,	1,	1,	1,	0,	0,	0	} },	
/*228*/		{ 8, { 14,	10,	10,	31,	17,	0,	0,	0	} },	
/*229*/		{ 8, { 7,	1,	7,	1,	7,	0,	0,	0	} },	
/*230*/		{ 8, { 9,	6,	15,	6,	9,	0,	0,	0	} },	
/*231*/		{ 8, { 7,	4,	2,	4,	7,	0,	0,	0	} },	
/*232*/		{ 8, { 9,	13,	11,	9,	9,	0,	0,	0	} },	
/*233*/		{ 8, { 9,	13,	11,	9,	9,	0,	0,	0	} },	
/*234*/		{ 8, { 5,	3,	1,	3,	5,	0,	0,	0	} },	
/*235*/		{ 8, { 6,	5,	5,	5,	5,	0,	0,	0	} },	
/*236*/		{ 8, { 17,	27,	21,	17,	17,	0,	0,	0	} },	
/*237*/		{ 8, { 5,	5,	7,	5,	5,	0,	0,	0	} },	
/*238*/		{ 8, { 7,	5,	5,	5,	7,	0,	0,	0	} },	
/*239*/		{ 8, { 7,	5,	5,	5,	5,	0,	0,	0	} },	
/*240*/		{ 8, { 7,	5,	7,	1,	1,	0,	0,	0	} },	
/*241*/		{ 8, { 7,	1,	1,	1,	7,	0,	0,	0	} },	
/*242*/		{ 8, { 7,	2,	2,	2,	2,	0,	0,	0	} },	
/*243*/		{ 8, { 5,	5,	7,	4,	7,	0,	0,	0	} },	
/*244*/		{ 8, { 31,	21,	21,	31,	4,	0,	0,	0	} },	
/*245*/		{ 8, { 9,	6,	6,	6,	9,	0,	0,	0	} },	
/*246*/		{ 8, { 5,	5,	5,	5,	15,	0,	0,	0	} },	
/*247*/		{ 8, { 5,	5,	7,	4,	4,	0,	0,	0	} },	
/*248*/		{ 8, { 21,	21,	21,	21,	31,	0,	0,	0	} },	
/*249*/		{ 8, { 21,	21,	21,	21,	63,	0,	0,	0	} },	
/*250*/		{ 8, { 3,	2,	14,	10,	14,	0,	0,	0	} },	
/*251*/		{ 8, { 17,	17,	23,	21,	23,	0,	0,	0	} },	
/*252*/		{ 8, { 1,	1,	7,	5,	7,	0,	0,	0	} },	
/*253*/		{ 8, { 7,	4,	7,	4,	7,	0,	0,	0	} },	
/*254*/		{ 8, { 29,	21,	23,	21,	29,	0,	0,	0	} },	
/*255*/		{ 8, { 15,	9,	15,	10,	9,	0,	0,	0	} }	
} };
