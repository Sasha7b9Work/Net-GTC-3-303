#include "font.h"
const Font fontUGO = {
	8, {
/*0*/		{ 0, { 0,	0,	0,	0,	0,	0,	0,	0	} },	
/*1*/		{ 0, { 0,	0,	0,	0,	0,	0,	0,	0	} },	
/*2*/		{ 0, { 0,	0,	0,	0,	0,	0,	0,	0	} },	
/*3*/		{ 0, { 0,	0,	0,	0,	0,	0,	0,	0	} },	
/*4*/		{ 0, { 0,	0,	0,	0,	0,	0,	0,	0	} },	
/*5*/		{ 0, { 0,	0,	0,	0,	0,	0,	0,	0	} },	
/*6*/		{ 0, { 0,	0,	0,	0,	0,	0,	0,	0	} },	
/*7*/		{ 0, { 0,	0,	0,	0,	0,	0,	0,	0	} },	
/*8*/		{ 0, { 0,	0,	0,	0,	0,	0,	0,	0	} },	
/*9*/		{ 0, { 0,	0,	0,	0,	0,	0,	0,	0	} },	
/*10*/		{ 0, { 0,	0,	0,	0,	0,	0,	0,	0	} },	
/*11*/		{ 0, { 0,	0,	0,	0,	0,	0,	0,	0	} },	
/*12*/		{ 0, { 0,	0,	0,	0,	0,	0,	0,	0	} },	
/*13*/		{ 0, { 0,	0,	0,	0,	0,	0,	0,	0	} },	
/*14*/		{ 0, { 0,	0,	0,	0,	0,	0,	0,	0	} },	
/*15*/		{ 0, { 0,	0,	0,	0,	0,	0,	0,	0	} },	
/*16*/		{ 0, { 0,	0,	0,	0,	0,	0,	0,	0	} },	
/*17*/		{ 1, { 0,	0,	0,	0,	0,	0,	0,	0	} },	
/*18*/		{ 2, { 0,	0,	0,	0,	0,	0,	0,	0	} },	
/*19*/		{ 3, { 0,	0,	0,	0,	0,	0,	0,	0	} },	
/*20*/		{ 4, { 0,	0,	0,	0,	0,	0,	0,	0	} },	
/*21*/		{ 5, { 0,	0,	0,	0,	0,	0,	0,	0	} },	
/*22*/		{ 6, { 0,	0,	0,	0,	0,	0,	0,	0	} },	
/*23*/		{ 7, { 0,	0,	0,	0,	0,	0,	0,	0	} },	
/*24*/		{ 8, { 0,	0,	0,	0,	0,	0,	0,	0	} },	
/*25*/		{ 9, { 0,	0,	0,	0,	0,	0,	0,	0	} },	
/*26*/		{ 10, { 0,	0,	0,	0,	0,	0,	0,	0	} },	
/*27*/		{ 11, { 0,	0,	0,	0,	0,	0,	0,	0	} },	
/*28*/		{ 12, { 0,	0,	0,	0,	0,	0,	0,	0	} },	
/*29*/		{ 13, { 0,	0,	0,	0,	0,	0,	0,	0	} },	
/*30*/		{ 14, { 0,	0,	0,	0,	0,	0,	0,	0	} },	
/*31*/		{ 15, { 0,	0,	0,	0,	0,	0,	0,	0	} },	
/*32*/		{ 8, { 68,	14,	31,	4,	4,	4,	4,	196	} },	
/*33*/		{ 8, { 85,	96,	208,	144,	16,	16,	16,	19	} },	
/*34*/		{ 8, { 85,	0,	31,	49,	32,	32,	32,	96	} },	
/*35*/		{ 8, { 85,	192,	160,	32,	32,	32,	32,	32	} },	
/*36*/		{ 8, { 85,	0,	63,	99,	64,	64,	64,	192	} },	
/*37*/		{ 2, { 0,	0,	0,	0,	0,	0,	0,	192	} },	
/*38*/		{ 8, { 0,	96,	208,	144,	16,	16,	16,	19	} },	
/*39*/		{ 8, { 0,	0,	31,	49,	32,	32,	32,	96	} },	
/*40*/		{ 6, { 0,	0,	128,	128,	128,	128,	128,	196	} },	
/*41*/		{ 8, { 0,	3,	60,	96,	64,	64,	64,	64	} },	
/*42*/		{ 8, { 68,	14,	31,	4,	4,	4,	4,	4	} },	
/*43*/		{ 8, { 85,	48,	232,	8,	8,	8,	8,	8	} },	
/*44*/		{ 8, { 85,	0,	3,	4,	4,	4,	4,	12	} },	
/*45*/		{ 8, { 85,	56,	236,	4,	4,	4,	4,	4	} },	
/*46*/		{ 8, { 85,	0,	1,	6,	4,	4,	4,	4	} },	
/*47*/		{ 0, { 0,	0,	0,	0,	0,	0,	0,	0	} },	
/*48*/		{ 8, { 4,	4,	4,	4,	4,	4,	4,	31	} },	
/*49*/		{ 7, { 22,	12,	0,	0,	0,	0,	0,	0	} },	
/*50*/		{ 2, { 64,	128,	0,	0,	0,	0,	0,	0	} },	
/*51*/		{ 8, { 38,	47,	24,	0,	0,	0,	0,	0	} },	
/*52*/		{ 1, { 128,	0,	0,	0,	0,	0,	0,	0	} },	
/*53*/		{ 8, { 0,	0,	68,	14,	31,	4,	4,	31	} },	
/*54*/		{ 8, { 22,	12,	85,	0,	0,	0,	0,	0	} },	
/*55*/		{ 8, { 192,	0,	85,	0,	0,	0,	0,	0	} },	
/*56*/		{ 8, { 79,	56,	85,	0,	0,	0,	0,	0	} },	
/*57*/		{ 8, { 64,	128,	85,	0,	0,	0,	0,	0	} },	
/*58*/		{ 8, { 4,	223,	14,	68,	0,	0,	0,	0	} },	
/*59*/		{ 8, { 8,	13,	3,	85,	0,	0,	0,	0	} },	
/*60*/		{ 8, { 8,	56,	224,	85,	0,	0,	0,	0	} },	
/*61*/		{ 8, { 4,	6,	3,	85,	0,	0,	0,	0	} },	
/*62*/		{ 8, { 4,	228,	56,	85,	0,	0,	0,	0	} },	
/*63*/		{ 0, { 0,	0,	0,	0,	0,	0,	0,	0	} },	
/*64*/		{ 8, { 0,	0,	68,	14,	31,	4,	4,	196	} },	
/*65*/		{ 8, { 64,	96,	213,	144,	16,	16,	16,	19	} },	
/*66*/		{ 8, { 0,	0,	95,	49,	32,	32,	32,	96	} },	
/*67*/		{ 8, { 128,	224,	117,	32,	32,	32,	32,	32	} },	
/*68*/		{ 8, { 0,	0,	63,	98,	64,	64,	64,	192	} },	
/*69*/		{ 6, { 0,	0,	0,	0,	0,	0,	0,	196	} },	
/*70*/		{ 8, { 64,	96,	208,	144,	16,	16,	16,	87	} },	
/*71*/		{ 8, { 0,	0,	15,	25,	16,	16,	16,	245	} },	
/*72*/		{ 8, { 32,	96,	208,	144,	16,	16,	24,	95	} },	
/*73*/		{ 8, { 0,	16,	31,	21,	16,	16,	16,	117	} },	
/*74*/		{ 8, { 0,	0,	68,	14,	31,	4,	4,	4	} },	
/*75*/		{ 8, { 64,	96,	181,	16,	16,	16,	16,	16	} },	
/*76*/		{ 8, { 0,	0,	95,	32,	32,	32,	32,	32	} },	
/*77*/		{ 8, { 32,	224,	213,	16,	16,	16,	16,	16	} },	
/*78*/		{ 8, { 0,	0,	95,	32,	32,	32,	32,	32	} },	
/*79*/		{ 0, { 0,	0,	0,	0,	0,	0,	0,	0	} },	
/*80*/		{ 8, { 4,	4,	4,	4,	4,	4,	4,	31	} },	
/*81*/		{ 7, { 22,	12,	0,	0,	0,	0,	0,	0	} },	
/*82*/		{ 2, { 64,	128,	0,	0,	0,	0,	0,	0	} },	
/*83*/		{ 8, { 38,	47,	24,	0,	0,	0,	0,	0	} },	
/*84*/		{ 1, { 128,	0,	0,	0,	0,	0,	0,	0	} },	
/*85*/		{ 8, { 14,	31,	4,	4,	4,	4,	4,	31	} },	
/*86*/		{ 7, { 22,	12,	0,	0,	0,	0,	0,	0	} },	
/*87*/		{ 2, { 192,	0,	0,	0,	0,	0,	0,	0	} },	
/*88*/		{ 8, { 9,	0,	0,	0,	0,	0,	0,	0	} },	
/*89*/		{ 2, { 192,	0,	0,	0,	0,	0,	0,	0	} },	
/*90*/		{ 8, { 31,	14,	196,	0,	0,	0,	0,	0	} },	
/*91*/		{ 8, { 16,	16,	95,	12,	0,	0,	0,	0	} },	
/*92*/		{ 8, { 32,	32,	213,	0,	0,	0,	0,	0	} },	
/*93*/		{ 8, { 16,	16,	95,	14,	8,	0,	0,	0	} },	
/*94*/		{ 8, { 32,	32,	213,	0,	0,	0,	0,	0	} },	
/*95*/		{ 0, { 0,	0,	0,	0,	0,	0,	0,	0	} },	
/*96*/		{ 7, { 0,	0,	128,	128,	64,	224,	68,	14	} },	
/*97*/		{ 8, { 6,	9,	16,	16,	32,	170,	32,	64	} },	
/*98*/		{ 7, { 128,	64,	32,	32,	16,	186,	16,	8	} },	
/*99*/		{ 8, { 1,	2,	4,	4,	8,	170,	8,	16	} },	
/*100*/		{ 7, { 96,	144,	8,	8,	4,	174,	4,	2	} },	
/*101*/		{ 8, { 0,	0,	164,	142,	95,	68,	68,	4	} },	
/*102*/		{ 8, { 6,	9,	186,	16,	32,	32,	32,	64	} },	
/*103*/		{ 7, { 128,	64,	170,	32,	16,	16,	16,	8	} },	
/*104*/		{ 8, { 1,	2,	174,	4,	8,	8,	8,	16	} },	
/*105*/		{ 7, { 96,	144,	170,	8,	4,	4,	4,	2	} },	
/*106*/		{ 8, { 164,	14,	31,	4,	31,	14,	164,	0	} },	
/*107*/		{ 7, { 170,	0,	0,	0,	0,	0,	170,	0	} },	
/*108*/		{ 8, { 170,	5,	5,	37,	85,	85,	85,	85	} },	
/*109*/		{ 8, { 170,	0,	0,	0,	0,	0,	255,	1	} },	
/*110*/		{ 8, { 170,	0,	0,	0,	0,	0,	255,	0	} },	
/*111*/		{ 0, { 0,	0,	0,	0,	0,	0,	0,	0	} },	
/*112*/		{ 8, { 31,	4,	4,	4,	4,	4,	4,	31	} },	
/*113*/		{ 2, { 64,	128,	0,	0,	0,	0,	0,	0	} },	
/*114*/		{ 8, { 8,	4,	3,	0,	0,	0,	0,	0	} },	
/*115*/		{ 4, { 16,	32,	192,	0,	0,	0,	0,	0	} },	
/*116*/		{ 8, { 2,	1,	0,	0,	0,	0,	0,	0	} },	
/*117*/		{ 8, { 4,	4,	4,	4,	4,	4,	4,	31	} },	
/*118*/		{ 2, { 64,	128,	0,	0,	0,	0,	0,	0	} },	
/*119*/		{ 8, { 8,	4,	3,	0,	0,	0,	0,	0	} },	
/*120*/		{ 4, { 16,	32,	192,	0,	0,	0,	0,	0	} },	
/*121*/		{ 8, { 2,	1,	0,	0,	0,	0,	0,	0	} },	
/*122*/		{ 3, { 0,	0,	0,	0,	224,	0,	0,	0	} },	
/*123*/		{ 8, { 0,	0,	0,	0,	127,	128,	0,	0	} },	
/*124*/		{ 8, { 149,	21,	9,	1,	1,	0,	0,	0	} },	
/*125*/		{ 0, { 0,	0,	0,	0,	0,	0,	0,	0	} },	
/*126*/		{ 0, { 0,	0,	0,	0,	0,	0,	0,	0	} },	
/*127*/		{ 0, { 0,	0,	0,	0,	0,	0,	0,	0	} },	
/*128*/		{ 8, { 0,	0,	255,	0,	0,	0,	0,	0	} },	
/*129*/		{ 8, { 0,	0,	255,	128,	128,	128,	128,	128	} },	
/*130*/		{ 7, { 0,	0,	0,	0,	0,	0,	4,	74	} },	
/*131*/		{ 0, { 0,	0,	0,	0,	0,	0,	0,	0	} },	
/*132*/		{ 0, { 0,	0,	0,	0,	0,	0,	0,	0	} },	
/*133*/		{ 3, { 128,	128,	128,	128,	224,	128,	128,	128	} },	
/*134*/		{ 8, { 255,	128,	128,	128,	131,	128,	128,	128	} },	
/*135*/		{ 3, { 128,	128,	128,	128,	224,	128,	128,	128	} },	
/*136*/		{ 8, { 255,	128,	128,	128,	131,	128,	128,	128	} },	
/*137*/		{ 0, { 0,	0,	0,	0,	0,	0,	0,	0	} },	
/*138*/		{ 7, { 254,	128,	128,	128,	224,	128,	134,	132	} },	
/*139*/		{ 8, { 128,	128,	128,	128,	131,	128,	128,	128	} },	
/*140*/		{ 8, { 255,	128,	128,	128,	224,	128,	128,	128	} },	
/*141*/		{ 8, { 128,	128,	128,	128,	131,	128,	128,	128	} },	
/*142*/		{ 8, { 255,	0,	0,	0,	0,	0,	0,	0	} },	
/*143*/		{ 0, { 0,	0,	0,	0,	0,	0,	0,	0	} },	
/*144*/		{ 7, { 168,	28,	62,	0,	62,	28,	72,	0	} },	
/*145*/		{ 8, { 170,	128,	128,	128,	128,	128,	85,	0	} },	
/*146*/		{ 8, { 170,	42,	42,	42,	18,	2,	1,	0	} },	
/*147*/		{ 8, { 255,	0,	0,	0,	0,	0,	0,	0	} },	
/*148*/		{ 8, { 255,	0,	0,	0,	0,	0,	0,	0	} },	
/*149*/		{ 7, { 254,	0,	0,	0,	128,	0,	0,	0	} },	
/*150*/		{ 8, { 128,	0,	2,	3,	255,	3,	2,	0	} },	
/*151*/		{ 8, { 255,	0,	32,	96,	255,	96,	32,	0	} },	
/*152*/		{ 1, { 128,	0,	0,	0,	0,	0,	0,	0	} },	
/*153*/		{ 8, { 255,	0,	0,	0,	0,	0,	0,	0	} },	
/*154*/		{ 7, { 132,	4,	78,	32,	144,	8,	4,	0	} },	
/*155*/		{ 8, { 255,	0,	2,	3,	255,	3,	2,	0	} },	
/*156*/		{ 8, { 128,	0,	32,	96,	255,	96,	32,	0	} },	
/*157*/		{ 8, { 255,	0,	0,	0,	0,	0,	0,	0	} },	
/*158*/		{ 0, { 0,	0,	0,	0,	0,	0,	0,	0	} },	
/*159*/		{ 0, { 0,	0,	0,	0,	0,	0,	0,	0	} },	
/*160*/		{ 0, { 0,	0,	0,	0,	0,	0,	0,	0	} },	
/*161*/		{ 0, { 0,	0,	0,	0,	0,	0,	0,	0	} },	
/*162*/		{ 4, { 0,	0,	128,	0,	128,	64,	32,	16	} },	
/*163*/		{ 8, { 248,	4,	15,	1,	0,	0,	0,	0	} },	
/*164*/		{ 8, { 255,	0,	0,	0,	0,	0,	0,	0	} },	
/*165*/		{ 8, { 255,	0,	0,	0,	0,	0,	0,	0	} },	
/*166*/		{ 8, { 63,	64,	224,	0,	0,	0,	0,	0	} },	
/*167*/		{ 8, { 0,	0,	3,	1,	2,	4,	8,	16	} },	
/*168*/		{ 0, { 0,	0,	0,	0,	0,	0,	0,	0	} },	
/*169*/		{ 0, { 0,	0,	0,	0,	0,	0,	0,	0	} },	
/*170*/		{ 2, { 0,	0,	0,	0,	192,	0,	0,	0	} },	
/*171*/		{ 8, { 255,	1,	1,	1,	7,	1,	1,	1	} },	
/*172*/		{ 8, { 127,	64,	64,	64,	240,	64,	64,	64	} },	
/*173*/		{ 8, { 0,	0,	0,	0,	1,	0,	0,	0	} },	
/*174*/		{ 0, { 0,	0,	0,	0,	0,	0,	0,	0	} },	
/*175*/		{ 0, { 0,	0,	0,	0,	0,	0,	0,	0	} },	
/*176*/		{ 8, { 0,	0,	0,	0,	255,	0,	0,	0	} },	
/*177*/		{ 8, { 0,	0,	128,	0,	255,	0,	0,	0	} },	
/*178*/		{ 8, { 136,	196,	239,	193,	128,	0,	0,	0	} },	
/*179*/		{ 8, { 2,	6,	15,	6,	2,	0,	0,	0	} },	
/*180*/		{ 0, { 0,	0,	0,	0,	0,	0,	0,	0	} },	
/*181*/		{ 0, { 0,	0,	0,	0,	0,	0,	0,	0	} },	
/*182*/		{ 3, { 128,	192,	224,	192,	128,	0,	0,	0	} },	
/*183*/		{ 8, { 34,	70,	239,	6,	2,	0,	0,	0	} },	
/*184*/		{ 8, { 0,	0,	3,	1,	254,	0,	0,	0	} },	
/*185*/		{ 8, { 0,	0,	0,	0,	255,	0,	0,	0	} },	
/*186*/		{ 8, { 255,	0,	0,	0,	0,	0,	0,	0	} },	
/*187*/		{ 8, { 1,	0,	4,	6,	255,	6,	4,	0	} },	
/*188*/		{ 8, { 192,	0,	16,	48,	127,	48,	16,	0	} },	
/*189*/		{ 8, { 255,	0,	0,	0,	0,	0,	0,	0	} },	
/*190*/		{ 8, { 255,	0,	0,	0,	0,	0,	0,	0	} },	
/*191*/		{ 0, { 0,	0,	0,	0,	0,	0,	0,	0	} },	
/*192*/		{ 8, { 255,	0,	0,	0,	192,	0,	0,	0	} },	
/*193*/		{ 8, { 1,	1,	1,	1,	7,	1,	1,	1	} },	
/*194*/		{ 4, { 192,	64,	64,	64,	240,	64,	64,	64	} },	
/*195*/		{ 8, { 255,	0,	0,	0,	1,	0,	0,	0	} },	
/*196*/		{ 8, { 255,	0,	0,	0,	0,	0,	0,	0	} },	
/*197*/		{ 2, { 0,	0,	0,	0,	192,	0,	0,	0	} },	
/*198*/		{ 8, { 255,	1,	1,	1,	7,	1,	1,	1	} },	
/*199*/		{ 8, { 127,	64,	64,	64,	240,	64,	64,	64	} },	
/*200*/		{ 8, { 128,	128,	128,	128,	129,	128,	128,	128	} },	
/*201*/		{ 8, { 255,	0,	0,	0,	0,	0,	0,	0	} },	
/*202*/		{ 8, { 255,	0,	0,	0,	192,	0,	0,	0	} },	
/*203*/		{ 8, { 1,	1,	1,	1,	7,	1,	1,	1	} },	
/*204*/		{ 4, { 192,	64,	64,	64,	240,	64,	64,	64	} },	
/*205*/		{ 8, { 255,	128,	128,	128,	129,	128,	128,	128	} },	
/*206*/		{ 0, { 0,	0,	0,	0,	0,	0,	0,	0	} },	
/*207*/		{ 0, { 0,	0,	0,	0,	0,	0,	0,	0	} },	
/*208*/		{ 0, { 0,	0,	0,	0,	0,	0,	0,	0	} },	
/*209*/		{ 8, { 255,	0,	4,	6,	255,	6,	4,	0	} },	
/*210*/		{ 8, { 127,	0,	16,	48,	127,	48,	16,	0	} },	
/*211*/		{ 0, { 0,	0,	0,	0,	0,	0,	0,	0	} },	
/*212*/		{ 0, { 0,	0,	0,	0,	0,	0,	0,	0	} },	
/*213*/		{ 8, { 255,	0,	0,	0,	0,	0,	0,	0	} },	
/*214*/		{ 8, { 1,	0,	4,	6,	255,	6,	4,	0	} },	
/*215*/		{ 8, { 192,	0,	16,	48,	127,	48,	16,	0	} },	
/*216*/		{ 8, { 255,	0,	0,	0,	0,	0,	0,	0	} },	
/*217*/		{ 0, { 0,	0,	0,	0,	0,	0,	0,	0	} },	
/*218*/		{ 0, { 0,	0,	0,	0,	0,	0,	0,	0	} },	
/*219*/		{ 8, { 255,	0,	4,	6,	255,	6,	4,	0	} },	
/*220*/		{ 8, { 127,	0,	16,	48,	127,	48,	16,	0	} },	
/*221*/		{ 1, { 128,	0,	0,	0,	0,	0,	0,	0	} },	
/*222*/		{ 8, { 255,	0,	0,	0,	0,	0,	0,	0	} },	
/*223*/		{ 0, { 0,	0,	0,	0,	0,	0,	0,	0	} },	
/*224*/		{ 2, { 0,	0,	0,	0,	192,	128,	128,	128	} },	
/*225*/		{ 6, { 252,	4,	4,	4,	68,	100,	244,	100	} },	
/*226*/		{ 8, { 255,	0,	0,	0,	0,	0,	255,	0	} },	
/*227*/		{ 8, { 255,	0,	224,	32,	162,	38,	175,	166	} },	
/*228*/		{ 8, { 255,	0,	255,	0,	3,	2,	3,	0	} },	
/*229*/		{ 8, { 255,	0,	255,	0,	192,	128,	128,	128	} },	
/*230*/		{ 8, { 255,	0,	7,	4,	68,	100,	244,	100	} },	
/*231*/		{ 8, { 255,	0,	0,	0,	0,	0,	255,	0	} },	
/*232*/		{ 8, { 63,	32,	32,	32,	162,	38,	175,	166	} },	
/*233*/		{ 8, { 0,	0,	0,	0,	3,	2,	3,	0	} },	
/*234*/		{ 0, { 0,	0,	0,	0,	0,	0,	0,	0	} },	
/*235*/		{ 0, { 0,	0,	0,	0,	0,	0,	0,	0	} },	
/*236*/		{ 0, { 0,	0,	0,	0,	0,	0,	0,	0	} },	
/*237*/		{ 0, { 0,	0,	0,	0,	0,	0,	0,	0	} },	
/*238*/		{ 0, { 0,	0,	0,	0,	0,	0,	0,	0	} },	
/*239*/		{ 0, { 0,	0,	0,	0,	0,	0,	0,	0	} },	
/*240*/		{ 8, { 192,	0,	255,	0,	255,	0,	0,	0	} },	
/*241*/		{ 8, { 69,	4,	7,	0,	255,	0,	0,	0	} },	
/*242*/		{ 8, { 0,	0,	0,	0,	255,	0,	0,	0	} },	
/*243*/		{ 8, { 162,	32,	32,	32,	63,	0,	0,	0	} },	
/*244*/		{ 8, { 3,	0,	0,	0,	0,	0,	0,	0	} },	
/*245*/		{ 2, { 192,	0,	0,	0,	0,	0,	0,	0	} },	
/*246*/		{ 8, { 69,	4,	4,	4,	252,	0,	0,	0	} },	
/*247*/		{ 8, { 0,	0,	0,	0,	255,	0,	0,	0	} },	
/*248*/		{ 8, { 162,	32,	224,	0,	255,	0,	0,	0	} },	
/*249*/		{ 8, { 3,	0,	255,	0,	255,	0,	0,	0	} },	
/*250*/		{ 0, { 0,	0,	0,	0,	0,	0,	0,	0	} },	
/*251*/		{ 0, { 0,	0,	0,	0,	0,	0,	0,	0	} },	
/*252*/		{ 0, { 0,	0,	0,	0,	0,	0,	0,	0	} },	
/*253*/		{ 0, { 0,	0,	0,	0,	0,	0,	0,	0	} },	
/*254*/		{ 0, { 0,	0,	0,	0,	0,	0,	0,	0	} },	
/*255*/		{ 0, { 0,	0,	0,	0,	0,	0,	0,	0	} }	
} };
