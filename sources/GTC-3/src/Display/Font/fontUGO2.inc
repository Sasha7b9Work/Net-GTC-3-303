#include "font.h"
const Font fontUGO2 = {
	8, {
/*0*/		{ 0, { 0,	0,	0,	0,	0,	0,	0,	0	} },	
/*1*/		{ 0, { 0,	0,	0,	0,	0,	0,	0,	0	} },	
/*2*/		{ 0, { 0,	0,	0,	0,	0,	0,	0,	0	} },	
/*3*/		{ 0, { 0,	0,	0,	0,	0,	0,	0,	0	} },	
/*4*/		{ 0, { 0,	0,	0,	0,	0,	0,	0,	0	} },	
/*5*/		{ 0, { 0,	0,	0,	0,	0,	0,	0,	0	} },	
/*6*/		{ 0, { 0,	0,	0,	0,	0,	0,	0,	0	} },	
/*7*/		{ 0, { 0,	0,	0,	0,	0,	0,	0,	0	} },	
/*8*/		{ 0, { 0,	0,	0,	0,	0,	0,	0,	0	} },	
/*9*/		{ 0, { 0,	0,	0,	0,	0,	0,	0,	0	} },	
/*10*/		{ 0, { 0,	0,	0,	0,	0,	0,	0,	0	} },	
/*11*/		{ 0, { 0,	0,	0,	0,	0,	0,	0,	0	} },	
/*12*/		{ 0, { 0,	0,	0,	0,	0,	0,	0,	0	} },	
/*13*/		{ 0, { 0,	0,	0,	0,	0,	0,	0,	0	} },	
/*14*/		{ 0, { 0,	0,	0,	0,	0,	0,	0,	0	} },	
/*15*/		{ 0, { 0,	0,	0,	0,	0,	0,	0,	0	} },	
/*16*/		{ 8, { 255,	1,	1,	1,	1,	1,	1,	0	} },	
/*17*/		{ 8, { 1,	1,	1,	1,	1,	1,	255,	0	} },	
/*18*/		{ 8, { 255,	255,	255,	255,	1,	1,	1,	0	} },	
/*19*/		{ 8, { 128,	128,	128,	255,	255,	255,	255,	0	} },	
/*20*/		{ 0, { 0,	0,	0,	0,	0,	0,	0,	0	} },	
/*21*/		{ 0, { 0,	0,	0,	0,	0,	0,	0,	0	} },	
/*22*/		{ 0, { 0,	0,	0,	0,	0,	0,	0,	0	} },	
/*23*/		{ 0, { 0,	0,	0,	0,	0,	0,	0,	0	} },	
/*24*/		{ 0, { 0,	0,	0,	0,	0,	0,	0,	0	} },	
/*25*/		{ 0, { 0,	0,	0,	0,	0,	0,	0,	0	} },	
/*26*/		{ 0, { 0,	0,	0,	0,	0,	0,	0,	0	} },	
/*27*/		{ 0, { 0,	0,	0,	0,	0,	0,	0,	0	} },	
/*28*/		{ 0, { 0,	0,	0,	0,	0,	0,	0,	0	} },	
/*29*/		{ 0, { 0,	0,	0,	0,	0,	0,	0,	0	} },	
/*30*/		{ 0, { 0,	0,	0,	0,	0,	0,	0,	0	} },	
/*31*/		{ 0, { 0,	0,	0,	0,	0,	0,	0,	0	} },	
/*32*/		{ 8, { 0,	0,	0,	16,	24,	20,	18,	241	} },	
/*33*/		{ 8, { 0,	0,	0,	0,	0,	0,	0,	255	} },	
/*34*/		{ 4, { 0,	0,	0,	0,	16,	32,	64,	128	} },	
/*35*/		{ 8, { 0,	0,	0,	0,	8,	4,	2,	1	} },	
/*36*/		{ 8, { 0,	0,	0,	0,	72,	68,	66,	95	} },	
/*37*/		{ 8, { 0,	0,	0,	0,	9,	17,	33,	125	} },	
/*38*/		{ 4, { 240,	16,	16,	240,	128,	128,	128,	128	} },	
/*39*/		{ 8, { 7,	4,	4,	7,	0,	0,	0,	0	} },	
/*40*/		{ 7, { 0,	240,	8,	4,	2,	2,	2,	2	} },	
/*41*/		{ 8, { 0,	1,	2,	4,	8,	8,	8,	8	} },	
/*42*/		{ 7, { 0,	222,	24,	20,	18,	2,	2,	0	} },	
/*43*/		{ 8, { 0,	9,	10,	12,	15,	0,	8,	8	} },	
/*44*/		{ 7, { 0,	252,	10,	10,	10,	10,	10,	10	} },	
/*45*/		{ 8, { 0,	63,	80,	80,	80,	80,	80,	80	} },	
/*46*/		{ 8, { 0,	192,	96,	48,	152,	204,	102,	51	} },	
/*47*/		{ 8, { 0,	204,	102,	51,	25,	12,	6,	3	} },	
/*48*/		{ 7, { 18,	20,	24,	16,	0,	0,	0,	0	} },	
/*49*/		{ 0, { 0,	0,	0,	0,	0,	0,	0,	0	} },	
/*50*/		{ 4, { 128,	64,	32,	16,	0,	0,	0,	0	} },	
/*51*/		{ 8, { 1,	2,	4,	8,	0,	0,	0,	0	} },	
/*52*/		{ 7, { 66,	68,	72,	0,	0,	0,	0,	0	} },	
/*53*/		{ 8, { 33,	17,	9,	0,	0,	0,	0,	0	} },	
/*54*/		{ 4, { 128,	128,	144,	160,	192,	128,	0,	0	} },	
/*55*/		{ 8, { 0,	0,	4,	2,	1,	0,	0,	0	} },	
/*56*/		{ 7, { 2,	4,	8,	240,	0,	0,	0,	0	} },	
/*57*/		{ 8, { 8,	4,	2,	1,	0,	0,	0,	0	} },	
/*58*/		{ 7, { 30,	6,	10,	114,	0,	0,	0,	0	} },	
/*59*/		{ 8, { 9,	5,	3,	15,	0,	0,	0,	0	} },	
/*60*/		{ 7, { 10,	250,	2,	2,	130,	130,	252,	0	} },	
/*61*/		{ 8, { 80,	95,	64,	64,	79,	72,	63,	0	} },	
/*62*/		{ 8, { 51,	102,	204,	152,	48,	96,	192,	0	} },	
/*63*/		{ 8, { 3,	6,	12,	25,	51,	102,	204,	0	} },	
/*64*/		{ 7, { 0,	0,	72,	72,	72,	254,	2,	2	} },	
/*65*/		{ 8, { 0,	0,	18,	18,	18,	127,	64,	64	} },	
/*66*/		{ 6, { 224,	16,	16,	248,	4,	4,	4,	132	} },	
/*67*/		{ 8, { 7,	8,	8,	31,	32,	32,	33,	35	} },	
/*68*/		{ 6, { 0,	0,	12,	28,	56,	112,	224,	192	} },	
/*69*/		{ 8, { 0,	0,	48,	56,	28,	14,	7,	3	} },	
/*70*/		{ 6, { 0,	0,	0,	0,	120,	132,	4,	132	} },	
/*71*/		{ 8, { 0,	0,	0,	0,	0,	63,	64,	127	} },	
/*72*/		{ 8, { 0,	0,	16,	40,	68,	130,	199,	40	} },	
/*73*/		{ 8, { 0,	0,	0,	0,	0,	0,	1,	0	} },	
/*74*/		{ 8, { 0,	254,	1,	254,	0,	0,	0,	0	} },	
/*75*/		{ 8, { 0,	15,	16,	19,	20,	20,	20,	20	} },	
/*76*/		{ 8, { 128,	64,	32,	16,	8,	4,	2,	255	} },	
/*77*/		{ 8, { 0,	1,	2,	4,	8,	16,	32,	127	} },	
/*78*/		{ 8, { 255,	2,	4,	8,	16,	32,	64,	128	} },	
/*79*/		{ 8, { 127,	32,	16,	8,	4,	2,	1,	0	} },	
/*80*/		{ 7, { 2,	2,	254,	72,	72,	72,	0,	0	} },	
/*81*/		{ 8, { 64,	64,	127,	18,	18,	18,	0,	0	} },	
/*82*/		{ 6, { 52,	52,	68,	132,	4,	4,	4,	248	} },	
/*83*/		{ 8, { 33,	45,	45,	35,	33,	32,	32,	31	} },	
/*84*/		{ 6, { 192,	224,	112,	56,	28,	12,	0,	0	} },	
/*85*/		{ 8, { 3,	7,	14,	28,	56,	48,	0,	0	} },	
/*86*/		{ 6, { 68,	36,	20,	12,	12,	248,	0,	0	} },	
/*87*/		{ 8, { 128,	128,	128,	64,	32,	31,	0,	0	} },	
/*88*/		{ 5, { 40,	40,	40,	200,	8,	240,	0,	0	} },	
/*89*/		{ 8, { 0,	0,	0,	127,	128,	127,	0,	0	} },	
/*90*/		{ 1, { 128,	0,	0,	0,	0,	0,	0,	0	} },	
/*91*/		{ 8, { 227,	65,	34,	20,	8,	0,	0,	0	} },	
/*92*/		{ 0, { 0,	0,	0,	0,	0,	0,	0,	0	} },	
/*93*/		{ 0, { 0,	0,	0,	0,	0,	0,	0,	0	} },	
/*94*/		{ 0, { 0,	0,	0,	0,	0,	0,	0,	0	} },	
/*95*/		{ 0, { 0,	0,	0,	0,	0,	0,	0,	0	} },	
/*96*/		{ 5, { 0,	0,	24,	24,	120,	120,	152,	152	} },	
/*97*/		{ 8, { 0,	0,	24,	24,	30,	30,	25,	25	} },	
/*98*/		{ 8, { 48,	72,	80,	82,	141,	1,	142,	80	} },	
/*99*/		{ 8, { 24,	40,	72,	132,	226,	17,	8,	4	} },	
/*100*/		{ 8, { 0,	0,	0,	0,	0,	0,	0,	255	} },	
/*101*/		{ 8, { 0,	0,	0,	8,	24,	40,	72,	143	} },	
/*102*/		{ 8, { 0,	254,	130,	130,	130,	130,	130,	131	} },	
/*103*/		{ 0, { 0,	0,	0,	0,	0,	0,	0,	0	} },	
/*104*/		{ 8, { 1,	254,	134,	138,	146,	162,	194,	131	} },	
/*105*/		{ 8, { 128,	64,	32,	16,	8,	4,	2,	1	} },	
/*106*/		{ 8, { 0,	0,	0,	0,	223,	68,	68,	196	} },	
/*107*/		{ 8, { 0,	0,	0,	0,	75,	40,	24,	9	} },	
/*108*/		{ 7, { 0,	0,	0,	0,	158,	82,	80,	72	} },	
/*109*/		{ 8, { 0,	0,	0,	0,	123,	74,	74,	74	} },	
/*110*/		{ 8, { 0,	17,	25,	21,	243,	21,	25,	17	} },	
/*111*/		{ 8, { 0,	0,	0,	0,	255,	0,	0,	0	} },	
/*112*/		{ 5, { 24,	24,	24,	24,	0,	0,	0,	0	} },	
/*113*/		{ 5, { 24,	24,	24,	24,	0,	0,	0,	0	} },	
/*114*/		{ 8, { 32,	16,	136,	71,	33,	18,	20,	24	} },	
/*115*/		{ 8, { 10,	113,	128,	177,	74,	10,	18,	12	} },	
/*116*/		{ 0, { 0,	0,	0,	0,	0,	0,	0,	0	} },	
/*117*/		{ 5, { 72,	40,	24,	8,	0,	0,	0,	0	} },	
/*118*/		{ 1, { 128,	128,	128,	128,	128,	128,	128,	0	} },	
/*119*/		{ 8, { 224,	32,	32,	32,	32,	32,	63,	0	} },	
/*120*/		{ 8, { 128,	192,	160,	144,	136,	132,	130,	1	} },	
/*121*/		{ 8, { 225,	34,	36,	40,	48,	32,	127,	128	} },	
/*122*/		{ 6, { 68,	68,	196,	0,	0,	0,	0,	0	} },	
/*123*/		{ 8, { 24,	40,	75,	0,	0,	0,	0,	0	} },	
/*124*/		{ 7, { 208,	82,	94,	0,	0,	0,	0,	0	} },	
/*125*/		{ 8, { 75,	74,	74,	0,	0,	0,	0,	0	} },	
/*126*/		{ 8, { 0,	0,	0,	255,	0,	0,	0,	0	} },	
/*127*/		{ 8, { 136,	152,	168,	207,	168,	152,	136,	0	} },	
/*128*/		{ 8, { 254,	1,	1,	1,	1,	1,	1,	1	} },	
/*129*/		{ 8, { 7,	8,	56,	40,	40,	40,	56,	8	} },	
/*130*/		{ 8, { 248,	136,	248,	32,	255,	4,	223,	81	} },	
/*131*/		{ 8, { 0,	0,	0,	0,	7,	1,	7,	4	} },	
/*132*/		{ 8, { 192,	224,	16,	9,	255,	65,	128,	0	} },	
/*133*/		{ 8, { 0,	0,	0,	0,	63,	0,	28,	31	} },	
/*134*/		{ 0, { 0,	0,	0,	0,	0,	0,	0,	0	} },	
/*135*/		{ 8, { 0,	127,	65,	65,	65,	65,	65,	193	} },	
/*136*/		{ 8, { 1,	1,	1,	1,	1,	1,	1,	1	} },	
/*137*/		{ 8, { 128,	255,	225,	209,	201,	197,	195,	193	} },	
/*138*/		{ 8, { 1,	2,	4,	136,	80,	32,	80,	136	} },	
/*139*/		{ 8, { 4,	2,	1,	0,	0,	0,	0,	0	} },	
/*140*/		{ 8, { 0,	0,	0,	0,	239,	41,	41,	233	} },	
/*141*/		{ 8, { 0,	0,	0,	0,	57,	36,	36,	37	} },	
/*142*/		{ 0, { 0,	0,	0,	0,	0,	0,	0,	0	} },	
/*143*/		{ 0, { 0,	0,	0,	0,	0,	0,	0,	0	} },	
/*144*/		{ 7, { 254,	0,	0,	0,	0,	0,	0,	0	} },	
/*145*/		{ 8, { 7,	0,	0,	0,	0,	0,	0,	0	} },	
/*146*/		{ 8, { 223,	0,	0,	0,	0,	0,	0,	0	} },	
/*147*/		{ 8, { 7,	0,	0,	0,	0,	0,	0,	0	} },	
/*148*/		{ 0, { 0,	0,	0,	0,	0,	0,	0,	0	} },	
/*149*/		{ 6, { 28,	0,	0,	0,	0,	0,	0,	0	} },	
/*150*/		{ 8, { 7,	4,	4,	4,	4,	4,	252,	0	} },	
/*151*/		{ 8, { 1,	1,	1,	1,	1,	1,	1,	0	} },	
/*152*/		{ 8, { 135,	69,	37,	21,	13,	5,	255,	1	} },	
/*153*/		{ 8, { 129,	129,	129,	129,	129,	129,	129,	128	} },	
/*154*/		{ 8, { 4,	2,	1,	0,	0,	0,	0,	0	} },	
/*155*/		{ 8, { 1,	2,	4,	0,	0,	0,	0,	0	} },	
/*156*/		{ 8, { 41,	41,	239,	0,	0,	0,	0,	0	} },	
/*157*/		{ 8, { 61,	37,	37,	0,	0,	0,	0,	0	} },	
/*158*/		{ 0, { 0,	0,	0,	0,	0,	0,	0,	0	} },	
/*159*/		{ 0, { 0,	0,	0,	0,	0,	0,	0,	0	} },	
/*160*/		{ 0, { 0,	0,	0,	0,	0,	0,	0,	0	} },	
/*161*/		{ 0, { 0,	0,	0,	0,	0,	0,	0,	0	} },	
/*162*/		{ 0, { 0,	0,	0,	0,	0,	0,	0,	0	} },	
/*163*/		{ 0, { 0,	0,	0,	0,	0,	0,	0,	0	} },	
/*164*/		{ 0, { 0,	0,	0,	0,	0,	0,	0,	0	} },	
/*165*/		{ 0, { 0,	0,	0,	0,	0,	0,	0,	0	} },	
/*166*/		{ 0, { 0,	0,	0,	0,	0,	0,	0,	0	} },	
/*167*/		{ 0, { 0,	0,	0,	0,	0,	0,	0,	0	} },	
/*168*/		{ 0, { 0,	0,	0,	0,	0,	0,	0,	0	} },	
/*169*/		{ 0, { 0,	0,	0,	0,	0,	0,	0,	0	} },	
/*170*/		{ 0, { 0,	0,	0,	0,	0,	0,	0,	0	} },	
/*171*/		{ 0, { 0,	0,	0,	0,	0,	0,	0,	0	} },	
/*172*/		{ 0, { 0,	0,	0,	0,	0,	0,	0,	0	} },	
/*173*/		{ 0, { 0,	0,	0,	0,	0,	0,	0,	0	} },	
/*174*/		{ 0, { 0,	0,	0,	0,	0,	0,	0,	0	} },	
/*175*/		{ 0, { 0,	0,	0,	0,	0,	0,	0,	0	} },	
/*176*/		{ 0, { 0,	0,	0,	0,	0,	0,	0,	0	} },	
/*177*/		{ 0, { 0,	0,	0,	0,	0,	0,	0,	0	} },	
/*178*/		{ 0, { 0,	0,	0,	0,	0,	0,	0,	0	} },	
/*179*/		{ 0, { 0,	0,	0,	0,	0,	0,	0,	0	} },	
/*180*/		{ 0, { 0,	0,	0,	0,	0,	0,	0,	0	} },	
/*181*/		{ 0, { 0,	0,	0,	0,	0,	0,	0,	0	} },	
/*182*/		{ 0, { 0,	0,	0,	0,	0,	0,	0,	0	} },	
/*183*/		{ 0, { 0,	0,	0,	0,	0,	0,	0,	0	} },	
/*184*/		{ 0, { 0,	0,	0,	0,	0,	0,	0,	0	} },	
/*185*/		{ 0, { 0,	0,	0,	0,	0,	0,	0,	0	} },	
/*186*/		{ 0, { 0,	0,	0,	0,	0,	0,	0,	0	} },	
/*187*/		{ 0, { 0,	0,	0,	0,	0,	0,	0,	0	} },	
/*188*/		{ 0, { 0,	0,	0,	0,	0,	0,	0,	0	} },	
/*189*/		{ 0, { 0,	0,	0,	0,	0,	0,	0,	0	} },	
/*190*/		{ 0, { 0,	0,	0,	0,	0,	0,	0,	0	} },	
/*191*/		{ 0, { 0,	0,	0,	0,	0,	0,	0,	0	} },	
/*192*/		{ 0, { 0,	0,	0,	0,	0,	0,	0,	0	} },	
/*193*/		{ 0, { 0,	0,	0,	0,	0,	0,	0,	0	} },	
/*194*/		{ 0, { 0,	0,	0,	0,	0,	0,	0,	0	} },	
/*195*/		{ 0, { 0,	0,	0,	0,	0,	0,	0,	0	} },	
/*196*/		{ 0, { 0,	0,	0,	0,	0,	0,	0,	0	} },	
/*197*/		{ 0, { 0,	0,	0,	0,	0,	0,	0,	0	} },	
/*198*/		{ 0, { 0,	0,	0,	0,	0,	0,	0,	0	} },	
/*199*/		{ 0, { 0,	0,	0,	0,	0,	0,	0,	0	} },	
/*200*/		{ 0, { 0,	0,	0,	0,	0,	0,	0,	0	} },	
/*201*/		{ 0, { 0,	0,	0,	0,	0,	0,	0,	0	} },	
/*202*/		{ 0, { 0,	0,	0,	0,	0,	0,	0,	0	} },	
/*203*/		{ 0, { 0,	0,	0,	0,	0,	0,	0,	0	} },	
/*204*/		{ 0, { 0,	0,	0,	0,	0,	0,	0,	0	} },	
/*205*/		{ 0, { 0,	0,	0,	0,	0,	0,	0,	0	} },	
/*206*/		{ 0, { 0,	0,	0,	0,	0,	0,	0,	0	} },	
/*207*/		{ 0, { 0,	0,	0,	0,	0,	0,	0,	0	} },	
/*208*/		{ 0, { 0,	0,	0,	0,	0,	0,	0,	0	} },	
/*209*/		{ 0, { 0,	0,	0,	0,	0,	0,	0,	0	} },	
/*210*/		{ 0, { 0,	0,	0,	0,	0,	0,	0,	0	} },	
/*211*/		{ 0, { 0,	0,	0,	0,	0,	0,	0,	0	} },	
/*212*/		{ 0, { 0,	0,	0,	0,	0,	0,	0,	0	} },	
/*213*/		{ 0, { 0,	0,	0,	0,	0,	0,	0,	0	} },	
/*214*/		{ 0, { 0,	0,	0,	0,	0,	0,	0,	0	} },	
/*215*/		{ 0, { 0,	0,	0,	0,	0,	0,	0,	0	} },	
/*216*/		{ 0, { 0,	0,	0,	0,	0,	0,	0,	0	} },	
/*217*/		{ 0, { 0,	0,	0,	0,	0,	0,	0,	0	} },	
/*218*/		{ 0, { 0,	0,	0,	0,	0,	0,	0,	0	} },	
/*219*/		{ 0, { 0,	0,	0,	0,	0,	0,	0,	0	} },	
/*220*/		{ 0, { 0,	0,	0,	0,	0,	0,	0,	0	} },	
/*221*/		{ 0, { 0,	0,	0,	0,	0,	0,	0,	0	} },	
/*222*/		{ 0, { 0,	0,	0,	0,	0,	0,	0,	0	} },	
/*223*/		{ 0, { 0,	0,	0,	0,	0,	0,	0,	0	} },	
/*224*/		{ 0, { 0,	0,	0,	0,	0,	0,	0,	0	} },	
/*225*/		{ 0, { 0,	0,	0,	0,	0,	0,	0,	0	} },	
/*226*/		{ 0, { 0,	0,	0,	0,	0,	0,	0,	0	} },	
/*227*/		{ 0, { 0,	0,	0,	0,	0,	0,	0,	0	} },	
/*228*/		{ 0, { 0,	0,	0,	0,	0,	0,	0,	0	} },	
/*229*/		{ 0, { 0,	0,	0,	0,	0,	0,	0,	0	} },	
/*230*/		{ 0, { 0,	0,	0,	0,	0,	0,	0,	0	} },	
/*231*/		{ 0, { 0,	0,	0,	0,	0,	0,	0,	0	} },	
/*232*/		{ 0, { 0,	0,	0,	0,	0,	0,	0,	0	} },	
/*233*/		{ 0, { 0,	0,	0,	0,	0,	0,	0,	0	} },	
/*234*/		{ 0, { 0,	0,	0,	0,	0,	0,	0,	0	} },	
/*235*/		{ 0, { 0,	0,	0,	0,	0,	0,	0,	0	} },	
/*236*/		{ 0, { 0,	0,	0,	0,	0,	0,	0,	0	} },	
/*237*/		{ 0, { 0,	0,	0,	0,	0,	0,	0,	0	} },	
/*238*/		{ 0, { 0,	0,	0,	0,	0,	0,	0,	0	} },	
/*239*/		{ 0, { 0,	0,	0,	0,	0,	0,	0,	0	} },	
/*240*/		{ 0, { 0,	0,	0,	0,	0,	0,	0,	0	} },	
/*241*/		{ 0, { 0,	0,	0,	0,	0,	0,	0,	0	} },	
/*242*/		{ 0, { 0,	0,	0,	0,	0,	0,	0,	0	} },	
/*243*/		{ 0, { 0,	0,	0,	0,	0,	0,	0,	0	} },	
/*244*/		{ 0, { 0,	0,	0,	0,	0,	0,	0,	0	} },	
/*245*/		{ 0, { 0,	0,	0,	0,	0,	0,	0,	0	} },	
/*246*/		{ 0, { 0,	0,	0,	0,	0,	0,	0,	0	} },	
/*247*/		{ 0, { 0,	0,	0,	0,	0,	0,	0,	0	} },	
/*248*/		{ 0, { 0,	0,	0,	0,	0,	0,	0,	0	} },	
/*249*/		{ 0, { 0,	0,	0,	0,	0,	0,	0,	0	} },	
/*250*/		{ 0, { 0,	0,	0,	0,	0,	0,	0,	0	} },	
/*251*/		{ 0, { 0,	0,	0,	0,	0,	0,	0,	0	} },	
/*252*/		{ 0, { 0,	0,	0,	0,	0,	0,	0,	0	} },	
/*253*/		{ 0, { 0,	0,	0,	0,	0,	0,	0,	0	} },	
/*254*/		{ 0, { 0,	0,	0,	0,	0,	0,	0,	0	} },	
/*255*/		{ 0, { 0,	0,	0,	0,	0,	0,	0,	0	} }	
} };
