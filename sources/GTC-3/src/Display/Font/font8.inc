#include "Font.h"
const Font8 font8 = {
	8, {
/*0*/		{ 0, { 0,	0,	0,	0,	0,	0,	0,	0	} },	
/*1*/		{ 0, { 0,	0,	0,	0,	0,	0,	0,	0	} },	
/*2*/		{ 0, { 0,	0,	0,	0,	0,	0,	0,	0	} },	
/*3*/		{ 0, { 0,	0,	0,	0,	0,	0,	0,	0	} },	
/*4*/		{ 0, { 0,	0,	0,	0,	0,	0,	0,	0	} },	
/*5*/		{ 0, { 0,	0,	0,	0,	0,	0,	0,	0	} },	
/*6*/		{ 0, { 0,	0,	0,	0,	0,	0,	0,	0	} },	
/*7*/		{ 0, { 0,	0,	0,	0,	0,	0,	0,	0	} },	
/*8*/		{ 0, { 0,	0,	0,	0,	0,	0,	0,	0	} },	
/*9*/		{ 0, { 0,	0,	0,	0,	0,	0,	0,	0	} },	
/*10*/		{ 0, { 0,	0,	0,	0,	0,	0,	0,	0	} },	
/*11*/		{ 0, { 0,	0,	0,	0,	0,	0,	0,	0	} },	
/*12*/		{ 0, { 0,	0,	0,	0,	0,	0,	0,	0	} },	
/*13*/		{ 8, { 4,	14,	31,	4,	4,	31,	14,	4	} },	
/*14*/		{ 8, { 124,	130,	5,	9,	17,	1,	1,	130	} },	
/*15*/		{ 8, { 0,	0,	1,	1,	1,	1,	1,	0	} },	
/*16*/		{ 0, { 0,	0,	0,	0,	0,	0,	0,	0	} },	
/*17*/		{ 1, { 0,	0,	0,	0,	0,	0,	0,	0	} },	
/*18*/		{ 2, { 0,	0,	0,	0,	0,	0,	0,	0	} },	
/*19*/		{ 3, { 0,	0,	0,	0,	0,	0,	0,	0	} },	
/*20*/		{ 4, { 0,	0,	0,	0,	0,	0,	0,	0	} },	
/*21*/		{ 5, { 0,	0,	0,	0,	0,	0,	0,	0	} },	
/*22*/		{ 6, { 0,	0,	0,	0,	0,	0,	0,	0	} },	
/*23*/		{ 7, { 0,	0,	0,	0,	0,	0,	0,	0	} },	
/*24*/		{ 8, { 0,	0,	0,	0,	0,	0,	0,	0	} },	
/*25*/		{ 9, { 0,	0,	0,	0,	0,	0,	0,	0	} },	
/*26*/		{ 10, { 0,	0,	0,	0,	0,	0,	0,	0	} },	
/*27*/		{ 11, { 0,	0,	0,	0,	0,	0,	0,	0	} },	
/*28*/		{ 12, { 0,	0,	0,	0,	0,	0,	0,	0	} },	
/*29*/		{ 13, { 0,	0,	0,	0,	0,	0,	0,	0	} },	
/*30*/		{ 14, { 124,	0,	0,	0,	0,	0,	0,	0	} },	
/*31*/		{ 15, { 0,	0,	0,	0,	0,	0,	0,	0	} },	
/*32*/		{ 2, { 0,	0,	0,	0,	0,	0,	0,	0	} },	
/*33*/		{ 6, { 4,	4,	4,	4,	4,	0,	4,	0	} },	
/*34*/		{ 8, { 5,	5,	0,	0,	0,	0,	0,	0	} },	
/*35*/		{ 8, { 0,	10,	31,	10,	10,	31,	10,	0	} },	
/*36*/		{ 8, { 0,	4,	31,	5,	31,	20,	31,	4	} },	
/*37*/		{ 8, { 0,	35,	19,	8,	4,	50,	49,	0	} },	
/*38*/		{ 8, { 0,	4,	10,	4,	26,	9,	22,	0	} },	
/*39*/		{ 7, { 0,	4,	2,	0,	0,	0,	0,	0	} },	
/*40*/		{ 8, { 2,	2,	1,	1,	1,	2,	2,	0	} },	
/*41*/		{ 8, { 1,	1,	2,	2,	2,	1,	1,	0	} },	
/*42*/		{ 8, { 0,	0,	5,	2,	5,	0,	0,	0	} },	
/*43*/		{ 8, { 0,	0,	2,	7,	2,	0,	0,	0	} },	
/*44*/		{ 6, { 0,	0,	0,	0,	0,	8,	4,	0	} },	
/*45*/		{ 8, { 0,	0,	0,	7,	0,	0,	0,	0	} },	
/*46*/		{ 8, { 0,	0,	0,	0,	0,	0,	1,	0	} },	
/*47*/		{ 8, { 0,	4,	4,	2,	2,	1,	1,	0	} },	
/*48*/		{ 8, { 15,	9,	9,	9,	9,	9,	15,	0	} },	
/*49*/		{ 7, { 6,	4,	4,	4,	4,	4,	14,	0	} },	
/*50*/		{ 8, { 15,	8,	8,	15,	1,	1,	15,	0	} },	
/*51*/		{ 8, { 15,	8,	8,	15,	8,	8,	15,	0	} },	
/*52*/		{ 8, { 9,	9,	9,	15,	8,	8,	8,	0	} },	
/*53*/		{ 8, { 15,	1,	1,	15,	8,	8,	15,	0	} },	
/*54*/		{ 8, { 15,	1,	1,	15,	9,	9,	15,	0	} },	
/*55*/		{ 8, { 15,	8,	4,	2,	1,	1,	1,	0	} },	
/*56*/		{ 8, { 15,	9,	9,	15,	9,	9,	15,	0	} },	
/*57*/		{ 8, { 15,	9,	9,	15,	8,	8,	15,	0	} },	
/*58*/		{ 8, { 0,	1,	0,	0,	0,	1,	0,	0	} },	
/*59*/		{ 7, { 0,	0,	4,	0,	0,	4,	4,	2	} },	
/*60*/		{ 8, { 0,	36,	18,	9,	18,	36,	0,	0	} },	
/*61*/		{ 8, { 0,	0,	7,	0,	7,	0,	0,	0	} },	
/*62*/		{ 8, { 0,	9,	18,	36,	18,	9,	0,	0	} },	
/*63*/		{ 8, { 0,	14,	17,	8,	4,	0,	4,	0	} },	
/*64*/		{ 8, { 9,	0,	15,	9,	15,	1,	15,	0	} },	
/*65*/		{ 8, { 15,	9,	9,	9,	15,	9,	9,	0	} },	
/*66*/		{ 8, { 7,	9,	9,	7,	9,	9,	7,	0	} },	
/*67*/		{ 8, { 15,	1,	1,	1,	1,	1,	15,	0	} },	
/*68*/		{ 8, { 7,	9,	9,	9,	9,	9,	7,	0	} },	
/*69*/		{ 8, { 15,	1,	1,	7,	1,	1,	15,	0	} },	
/*70*/		{ 8, { 15,	1,	1,	7,	1,	1,	1,	0	} },	
/*71*/		{ 8, { 14,	17,	1,	1,	25,	17,	14,	0	} },	
/*72*/		{ 8, { 17,	17,	17,	31,	17,	17,	17,	0	} },	
/*73*/		{ 8, { 31,	4,	4,	4,	4,	4,	31,	0	} },	
/*74*/		{ 8, { 8,	8,	8,	8,	9,	9,	6,	0	} },	
/*75*/		{ 8, { 17,	9,	5,	3,	5,	9,	17,	0	} },	
/*76*/		{ 8, { 1,	1,	1,	1,	1,	9,	15,	0	} },	
/*77*/		{ 8, { 17,	27,	21,	17,	17,	17,	17,	0	} },	
/*78*/		{ 8, { 17,	17,	19,	21,	21,	25,	17,	0	} },	
/*79*/		{ 8, { 14,	17,	17,	17,	17,	17,	14,	0	} },	
/*80*/		{ 8, { 15,	17,	17,	17,	15,	1,	1,	0	} },	
/*81*/		{ 8, { 14,	17,	17,	17,	21,	9,	22,	0	} },	
/*82*/		{ 8, { 15,	17,	17,	17,	15,	9,	17,	0	} },	
/*83*/		{ 8, { 15,	1,	1,	15,	8,	8,	15,	0	} },	
/*84*/		{ 8, { 31,	4,	4,	4,	4,	4,	4,	0	} },	
/*85*/		{ 8, { 17,	17,	17,	17,	17,	17,	14,	0	} },	
/*86*/		{ 8, { 17,	17,	17,	17,	17,	10,	4,	0	} },	
/*87*/		{ 8, { 17,	17,	17,	17,	17,	21,	10,	0	} },	
/*88*/		{ 8, { 17,	10,	4,	4,	4,	10,	17,	0	} },	
/*89*/		{ 8, { 17,	17,	17,	10,	4,	4,	4,	0	} },	
/*90*/		{ 8, { 31,	16,	8,	4,	2,	1,	31,	0	} },	
/*91*/		{ 7, { 0,	14,	2,	2,	2,	2,	14,	0	} },	
/*92*/		{ 8, { 0,	0,	1,	2,	4,	8,	16,	0	} },	
/*93*/		{ 7, { 0,	14,	8,	8,	8,	8,	14,	0	} },	
/*94*/		{ 8, { 0,	4,	14,	21,	4,	4,	4,	0	} },	
/*95*/		{ 8, { 0,	0,	0,	0,	0,	0,	0,	63	} },	
/*96*/		{ 8, { 6,	2,	7,	2,	2,	2,	2,	0	} },	
/*97*/		{ 8, { 0,	0,	15,	8,	15,	9,	15,	0	} },	
/*98*/		{ 8, { 1,	1,	15,	9,	9,	9,	15,	0	} },	
/*99*/		{ 8, { 0,	0,	15,	1,	1,	1,	15,	0	} },	
/*100*/		{ 8, { 8,	8,	15,	9,	9,	9,	15,	0	} },	
/*101*/		{ 8, { 0,	0,	15,	9,	15,	1,	15,	0	} },	
/*102*/		{ 8, { 6,	2,	7,	2,	2,	2,	2,	0	} },	
/*103*/		{ 8, { 0,	0,	15,	9,	9,	15,	8,	15	} },	
/*104*/		{ 8, { 1,	1,	15,	9,	9,	9,	9,	0	} },	
/*105*/		{ 8, { 1,	0,	1,	1,	1,	1,	1,	0	} },	
/*106*/		{ 8, { 0,	8,	0,	8,	8,	8,	9,	6	} },	
/*107*/		{ 8, { 1,	1,	9,	5,	3,	5,	9,	0	} },	
/*108*/		{ 8, { 1,	1,	1,	1,	1,	1,	3,	0	} },	
/*109*/		{ 8, { 0,	0,	11,	21,	21,	21,	21,	0	} },	
/*110*/		{ 8, { 0,	0,	7,	9,	9,	9,	9,	0	} },	
/*111*/		{ 8, { 0,	0,	15,	9,	9,	9,	15,	0	} },	
/*112*/		{ 8, { 0,	0,	15,	9,	9,	15,	1,	1	} },	
/*113*/		{ 8, { 0,	0,	15,	9,	9,	15,	8,	24	} },	
/*114*/		{ 8, { 0,	0,	7,	1,	1,	1,	1,	0	} },	
/*115*/		{ 8, { 0,	0,	15,	1,	15,	8,	15,	0	} },	
/*116*/		{ 8, { 2,	2,	7,	2,	2,	2,	6,	0	} },	
/*117*/		{ 8, { 0,	0,	9,	9,	9,	9,	15,	0	} },	
/*118*/		{ 8, { 0,	0,	17,	17,	10,	10,	4,	0	} },	
/*119*/		{ 8, { 0,	0,	17,	21,	21,	21,	10,	0	} },	
/*120*/		{ 8, { 0,	0,	17,	10,	4,	10,	17,	0	} },	
/*121*/		{ 8, { 0,	0,	9,	9,	9,	15,	8,	15	} },	
/*122*/		{ 8, { 0,	0,	31,	8,	4,	2,	31,	0	} },	
/*123*/		{ 8, { 31,	4,	4,	4,	4,	116,	84,	112	} },	
/*124*/		{ 8, { 15,	1,	1,	7,	1,	113,	33,	32	} },	
/*125*/		{ 8, { 31,	4,	4,	4,	4,	116,	36,	32	} },	
/*126*/		{ 8, { 0,	0,	6,	73,	48,	0,	0,	0	} },	
/*127*/		{ 8, { 0,	0,	2,	1,	1,	0,	0,	0	} },	
/*128*/		{ 8, { 0,	4,	6,	7,	6,	4,	0,	0	} },	
/*129*/		{ 8, { 0,	1,	3,	7,	3,	1,	0,	0	} },	
/*130*/		{ 8, { 15,	33,	49,	249,	49,	33,	15,	0	} },	
/*131*/		{ 8, { 135,	69,	39,	16,	8,	228,	162,	225	} },	
/*132*/		{ 7, { 62,	34,	54,	54,	28,	8,	0,	0	} },	
/*133*/		{ 8, { 127,	127,	127,	127,	62,	28,	8,	0	} },	
/*134*/		{ 7, { 0,	248,	140,	222,	220,	248,	0,	0	} },	
/*135*/		{ 8, { 0,	31,	49,	123,	59,	31,	0,	0	} },	
/*136*/		{ 8, { 65,	34,	20,	8,	20,	34,	65,	0	} },	
/*137*/		{ 0, { 0,	0,	0,	0,	0,	0,	0,	0	} },	
/*138*/		{ 7, { 62,	34,	42,	34,	62,	0,	0,	0	} },	
/*139*/		{ 8, { 127,	127,	127,	127,	127,	127,	0,	0	} },	
/*140*/		{ 8, { 124,	130,	1,	1,	17,	9,	5,	130	} },	
/*141*/		{ 8, { 0,	0,	1,	1,	1,	1,	1,	0	} },	
/*142*/		{ 8, { 7,	2,	2,	18,	26,	18,	18,	16	} },	
/*143*/		{ 8, { 7,	2,	2,	58,	42,	34,	18,	56	} },	
/*144*/		{ 8, { 0,	8,	8,	8,	8,	127,	0,	0	} },	
/*145*/		{ 8, { 0,	0,	6,	73,	48,	0,	0,	0	} },	
/*146*/		{ 8, { 0,	0,	127,	0,	107,	0,	0,	0	} },	
/*147*/		{ 8, { 31,	63,	127,	255,	127,	63,	31,	0	} },	
/*148*/		{ 8, { 248,	252,	254,	255,	254,	252,	248,	0	} },	
/*149*/		{ 8, { 31,	31,	31,	31,	31,	31,	31,	14	} },	
/*150*/		{ 8, { 14,	31,	31,	31,	31,	31,	31,	31	} },	
/*151*/		{ 8, { 0,	36,	102,	255,	102,	36,	0,	0	} },	
/*152*/		{ 0, { 0,	0,	0,	0,	0,	0,	0,	0	} },	
/*153*/		{ 8, { 0,	8,	16,	63,	16,	8,	0,	0	} },	
/*154*/		{ 8, { 0,	4,	4,	31,	4,	4,	0,	0	} },	
/*155*/		{ 8, { 0,	0,	0,	31,	0,	0,	0,	0	} },	
/*156*/		{ 6, { 124,	0,	0,	0,	0,	0,	0,	0	} },	
/*157*/		{ 0, { 0,	0,	0,	0,	0,	0,	0,	0	} },	
/*158*/		{ 8, { 5,	5,	5,	37,	53,	37,	35,	32	} },	
/*159*/		{ 8, { 5,	5,	5,	117,	85,	69,	35,	112	} },	
/*160*/		{ 8, { 20,	20,	84,	85,	65,	65,	66,	36	} },	
/*161*/		{ 8, { 24,	36,	66,	129,	0,	0,	0,	0	} },	
/*162*/		{ 8, { 0,	0,	0,	0,	129,	66,	36,	24	} },	
/*163*/		{ 8, { 4,	14,	31,	0,	0,	0,	0,	0	} },	
/*164*/		{ 8, { 31,	14,	4,	0,	0,	0,	0,	0	} },	
/*165*/		{ 8, { 0,	1,	0,	0,	0,	1,	0,	0	} },	
/*166*/		{ 8, { 15,	8,	8,	28,	8,	8,	120,	0	} },	
/*167*/		{ 8, { 120,	8,	8,	28,	8,	8,	15,	0	} },	
/*168*/		{ 8, { 6,	9,	9,	6,	0,	0,	0,	0	} },	
/*169*/		{ 0, { 0,	0,	0,	0,	0,	0,	0,	0	} },	
/*170*/		{ 8, { 124,	130,	65,	33,	17,	1,	1,	130	} },	
/*171*/		{ 8, { 0,	0,	1,	1,	1,	1,	1,	0	} },	
/*172*/		{ 8, { 124,	130,	1,	1,	17,	33,	65,	130	} },	
/*173*/		{ 8, { 0,	0,	1,	1,	1,	1,	1,	0	} },	
/*174*/		{ 8, { 3,	15,	63,	255,	255,	255,	255,	255	} },	
/*175*/		{ 8, { 0,	0,	0,	0,	3,	15,	63,	255	} },	
/*176*/		{ 8, { 2,	2,	2,	2,	2,	2,	127,	0	} },	
/*177*/		{ 8, { 168,	2,	0,	2,	0,	2,	255,	0	} },	
/*178*/		{ 8, { 62,	65,	65,	65,	65,	65,	128,	0	} },	
/*179*/		{ 8, { 124,	130,	130,	130,	130,	130,	1,	0	} },	
/*180*/		{ 8, { 21,	64,	0,	64,	0,	64,	255,	0	} },	
/*181*/		{ 8, { 252,	2,	2,	2,	2,	2,	1,	0	} },	
/*182*/		{ 8, { 63,	64,	64,	64,	64,	64,	128,	0	} },	
/*183*/		{ 8, { 42,	42,	42,	42,	42,	42,	127,	0	} },	
/*184*/		{ 8, { 9,	0,	15,	9,	15,	1,	15,	0	} },	
/*185*/		{ 0, { 0,	0,	0,	0,	0,	0,	0,	0	} },	
/*186*/		{ 6, { 124,	0,	0,	0,	0,	0,	0,	0	} },	
/*187*/		{ 0, { 0,	0,	0,	0,	0,	0,	0,	0	} },	
/*188*/		{ 6, { 124,	0,	0,	0,	0,	0,	0,	0	} },	
/*189*/		{ 0, { 0,	0,	0,	0,	0,	0,	0,	0	} },	
/*190*/		{ 8, { 255,	255,	255,	255,	63,	15,	3,	0	} },	
/*191*/		{ 8, { 63,	15,	3,	0,	0,	0,	0,	0	} },	
/*192*/		{ 8, { 31,	17,	17,	31,	17,	17,	17,	0	} },	
/*193*/		{ 8, { 31,	1,	1,	31,	17,	17,	31,	0	} },	
/*194*/		{ 8, { 31,	17,	17,	15,	17,	17,	31,	0	} },	
/*195*/		{ 8, { 15,	1,	1,	1,	1,	1,	1,	0	} },	
/*196*/		{ 8, { 30,	18,	18,	18,	18,	18,	63,	33	} },	
/*197*/		{ 8, { 31,	1,	1,	15,	1,	1,	31,	0	} },	
/*198*/		{ 8, { 21,	21,	21,	14,	21,	21,	21,	0	} },	
/*199*/		{ 8, { 31,	17,	16,	12,	16,	17,	31,	0	} },	
/*200*/		{ 8, { 17,	25,	21,	19,	17,	17,	17,	0	} },	
/*201*/		{ 8, { 21,	25,	21,	19,	17,	17,	17,	0	} },	
/*202*/		{ 8, { 17,	9,	5,	3,	5,	9,	17,	0	} },	
/*203*/		{ 8, { 28,	18,	17,	17,	17,	17,	17,	0	} },	
/*204*/		{ 8, { 17,	27,	21,	17,	17,	17,	17,	0	} },	
/*205*/		{ 8, { 17,	17,	17,	31,	17,	17,	17,	0	} },	
/*206*/		{ 8, { 31,	17,	17,	17,	17,	17,	31,	0	} },	
/*207*/		{ 8, { 31,	17,	17,	17,	17,	17,	17,	0	} },	
/*208*/		{ 8, { 31,	17,	17,	17,	31,	1,	1,	0	} },	
/*209*/		{ 8, { 31,	17,	1,	1,	1,	17,	31,	0	} },	
/*210*/		{ 8, { 31,	4,	4,	4,	4,	4,	4,	0	} },	
/*211*/		{ 8, { 17,	17,	17,	31,	16,	16,	31,	0	} },	
/*212*/		{ 8, { 127,	73,	73,	73,	127,	8,	8,	0	} },	
/*213*/		{ 8, { 17,	10,	10,	4,	10,	10,	17,	0	} },	
/*214*/		{ 8, { 17,	17,	17,	17,	17,	17,	63,	32	} },	
/*215*/		{ 8, { 17,	17,	17,	17,	31,	16,	16,	0	} },	
/*216*/		{ 8, { 21,	21,	21,	21,	21,	21,	31,	0	} },	
/*217*/		{ 8, { 21,	21,	21,	21,	21,	21,	63,	32	} },	
/*218*/		{ 8, { 3,	2,	2,	30,	18,	18,	30,	0	} },	
/*219*/		{ 8, { 33,	33,	33,	47,	41,	41,	47,	0	} },	
/*220*/		{ 8, { 1,	1,	1,	15,	9,	9,	15,	0	} },	
/*221*/		{ 8, { 31,	16,	16,	31,	16,	16,	31,	0	} },	
/*222*/		{ 8, { 61,	37,	37,	39,	37,	37,	61,	0	} },	
/*223*/		{ 8, { 31,	17,	17,	17,	30,	18,	17,	0	} },	
/*224*/		{ 8, { 0,	0,	15,	8,	15,	9,	15,	0	} },	
/*225*/		{ 8, { 0,	0,	15,	1,	15,	9,	15,	0	} },	
/*226*/		{ 8, { 0,	0,	15,	9,	7,	9,	15,	0	} },	
/*227*/		{ 8, { 0,	0,	7,	1,	1,	1,	1,	0	} },	
/*228*/		{ 8, { 0,	0,	30,	18,	18,	18,	63,	33	} },	
/*229*/		{ 8, { 0,	0,	15,	9,	15,	1,	15,	0	} },	
/*230*/		{ 8, { 0,	0,	21,	21,	14,	21,	21,	0	} },	
/*231*/		{ 8, { 0,	0,	15,	9,	4,	9,	15,	0	} },	
/*232*/		{ 8, { 0,	0,	9,	13,	11,	9,	9,	0	} },	
/*233*/		{ 8, { 0,	4,	9,	13,	11,	9,	9,	0	} },	
/*234*/		{ 8, { 0,	0,	9,	5,	3,	5,	9,	0	} },	
/*235*/		{ 8, { 0,	0,	14,	9,	9,	9,	9,	0	} },	
/*236*/		{ 8, { 0,	0,	17,	27,	21,	17,	17,	0	} },	
/*237*/		{ 8, { 0,	0,	9,	9,	15,	9,	9,	0	} },	
/*238*/		{ 8, { 0,	0,	15,	9,	9,	9,	15,	0	} },	
/*239*/		{ 8, { 0,	0,	15,	9,	9,	9,	9,	0	} },	
/*240*/		{ 8, { 0,	0,	15,	9,	9,	15,	1,	1	} },	
/*241*/		{ 8, { 0,	0,	15,	9,	1,	9,	15,	0	} },	
/*242*/		{ 8, { 0,	0,	7,	2,	2,	2,	2,	0	} },	
/*243*/		{ 8, { 0,	0,	9,	9,	15,	8,	15,	0	} },	
/*244*/		{ 8, { 0,	0,	31,	21,	21,	31,	4,	0	} },	
/*245*/		{ 8, { 0,	0,	17,	10,	4,	10,	17,	0	} },	
/*246*/		{ 8, { 0,	0,	9,	9,	9,	9,	31,	16	} },	
/*247*/		{ 8, { 0,	0,	9,	9,	15,	8,	8,	0	} },	
/*248*/		{ 8, { 0,	0,	21,	21,	21,	21,	31,	0	} },	
/*249*/		{ 8, { 0,	0,	21,	21,	21,	21,	63,	32	} },	
/*250*/		{ 8, { 0,	0,	3,	2,	30,	18,	30,	0	} },	
/*251*/		{ 8, { 0,	0,	17,	17,	23,	21,	23,	0	} },	
/*252*/		{ 8, { 0,	0,	1,	1,	15,	9,	15,	0	} },	
/*253*/		{ 8, { 0,	0,	15,	8,	15,	8,	15,	0	} },	
/*254*/		{ 8, { 0,	0,	29,	21,	23,	21,	29,	0	} },	
/*255*/		{ 8, { 0,	0,	15,	9,	14,	10,	9,	0	} }	
} };
