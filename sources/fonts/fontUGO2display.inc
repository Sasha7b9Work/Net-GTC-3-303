const BYTE fontUGO2display[3080] = {
/* Orient = 0x00, FontID = 0x00 */ 0x00, 0x00,
/* First character ID */           0x00, 0x00,
/* Last  character ID */           0xff, 0xff,
/* Height */                       0x08, 0x00,

/* Table of characters */

/* 0 */	        0, 8, 4, 0,
/* 1 */	        0, 16, 4, 0,
/* 2 */	        0, 24, 4, 0,
/* 3 */	        0, 32, 4, 0,
/* 4 */	        0, 40, 4, 0,
/* 5 */	        0, 48, 4, 0,
/* 6 */	        0, 56, 4, 0,
/* 7 */	        0, 64, 4, 0,
/* 8 */	        0, 72, 4, 0,
/* 9 */	        0, 80, 4, 0,
/* 10 */	        0, 88, 4, 0,
/* 11 */	        0, 96, 4, 0,
/* 12 */	        0, 104, 4, 0,
/* 13 */	        0, 112, 4, 0,
/* 14 */	        0, 120, 4, 0,
/* 15 */	        0, 128, 4, 0,
/* 16 */	        8, 136, 4, 0,
/* 17 */	        8, 144, 4, 0,
/* 18 */	        8, 152, 4, 0,
/* 19 */	        8, 160, 4, 0,
/* 20 */	        0, 168, 4, 0,
/* 21 */	        0, 176, 4, 0,
/* 22 */	        0, 184, 4, 0,
/* 23 */	        0, 192, 4, 0,
/* 24 */	        0, 200, 4, 0,
/* 25 */	        0, 208, 4, 0,
/* 26 */	        0, 216, 4, 0,
/* 27 */	        0, 224, 4, 0,
/* 28 */	        0, 232, 4, 0,
/* 29 */	        0, 240, 4, 0,
/* 30 */	        0, 248, 4, 0,
/* 31 */	        0, 0, 5, 0,
/* 32 */	        8, 8, 5, 0,
/* 33 */	        8, 16, 5, 0,
/* 34 */	        4, 24, 5, 0,
/* 35 */	        8, 32, 5, 0,
/* 36 */	        8, 40, 5, 0,
/* 37 */	        8, 48, 5, 0,
/* 38 */	        4, 56, 5, 0,
/* 39 */	        8, 64, 5, 0,
/* 40 */	        7, 72, 5, 0,
/* 41 */	        8, 80, 5, 0,
/* 42 */	        7, 88, 5, 0,
/* 43 */	        8, 96, 5, 0,
/* 44 */	        7, 104, 5, 0,
/* 45 */	        8, 112, 5, 0,
/* 46 */	        8, 120, 5, 0,
/* 47 */	        8, 128, 5, 0,
/* 48 */	        7, 136, 5, 0,
/* 49 */	        0, 144, 5, 0,
/* 50 */	        4, 152, 5, 0,
/* 51 */	        8, 160, 5, 0,
/* 52 */	        7, 168, 5, 0,
/* 53 */	        8, 176, 5, 0,
/* 54 */	        4, 184, 5, 0,
/* 55 */	        8, 192, 5, 0,
/* 56 */	        7, 200, 5, 0,
/* 57 */	        8, 208, 5, 0,
/* 58 */	        7, 216, 5, 0,
/* 59 */	        8, 224, 5, 0,
/* 60 */	        7, 232, 5, 0,
/* 61 */	        8, 240, 5, 0,
/* 62 */	        8, 248, 5, 0,
/* 63 */	        8, 0, 6, 0,
/* 64 */	        7, 8, 6, 0,
/* 65 */	        8, 16, 6, 0,
/* 66 */	        6, 24, 6, 0,
/* 67 */	        8, 32, 6, 0,
/* 68 */	        6, 40, 6, 0,
/* 69 */	        8, 48, 6, 0,
/* 70 */	        6, 56, 6, 0,
/* 71 */	        8, 64, 6, 0,
/* 72 */	        8, 72, 6, 0,
/* 73 */	        8, 80, 6, 0,
/* 74 */	        8, 88, 6, 0,
/* 75 */	        8, 96, 6, 0,
/* 76 */	        8, 104, 6, 0,
/* 77 */	        8, 112, 6, 0,
/* 78 */	        8, 120, 6, 0,
/* 79 */	        8, 128, 6, 0,
/* 80 */	        7, 136, 6, 0,
/* 81 */	        8, 144, 6, 0,
/* 82 */	        6, 152, 6, 0,
/* 83 */	        8, 160, 6, 0,
/* 84 */	        6, 168, 6, 0,
/* 85 */	        8, 176, 6, 0,
/* 86 */	        6, 184, 6, 0,
/* 87 */	        8, 192, 6, 0,
/* 88 */	        5, 200, 6, 0,
/* 89 */	        8, 208, 6, 0,
/* 90 */	        1, 216, 6, 0,
/* 91 */	        8, 224, 6, 0,
/* 92 */	        0, 232, 6, 0,
/* 93 */	        0, 240, 6, 0,
/* 94 */	        0, 248, 6, 0,
/* 95 */	        0, 0, 7, 0,
/* 96 */	        5, 8, 7, 0,
/* 97 */	        8, 16, 7, 0,
/* 98 */	        8, 24, 7, 0,
/* 99 */	        8, 32, 7, 0,
/* 100 */	        8, 40, 7, 0,
/* 101 */	        8, 48, 7, 0,
/* 102 */	        8, 56, 7, 0,
/* 103 */	        0, 64, 7, 0,
/* 104 */	        8, 72, 7, 0,
/* 105 */	        8, 80, 7, 0,
/* 106 */	        8, 88, 7, 0,
/* 107 */	        8, 96, 7, 0,
/* 108 */	        7, 104, 7, 0,
/* 109 */	        8, 112, 7, 0,
/* 110 */	        8, 120, 7, 0,
/* 111 */	        8, 128, 7, 0,
/* 112 */	        5, 136, 7, 0,
/* 113 */	        5, 144, 7, 0,
/* 114 */	        8, 152, 7, 0,
/* 115 */	        8, 160, 7, 0,
/* 116 */	        0, 168, 7, 0,
/* 117 */	        5, 176, 7, 0,
/* 118 */	        1, 184, 7, 0,
/* 119 */	        8, 192, 7, 0,
/* 120 */	        8, 200, 7, 0,
/* 121 */	        8, 208, 7, 0,
/* 122 */	        6, 216, 7, 0,
/* 123 */	        8, 224, 7, 0,
/* 124 */	        7, 232, 7, 0,
/* 125 */	        8, 240, 7, 0,
/* 126 */	        8, 248, 7, 0,
/* 127 */	        8, 0, 8, 0,
/* 128 */	        8, 8, 8, 0,
/* 129 */	        8, 16, 8, 0,
/* 130 */	        8, 24, 8, 0,
/* 131 */	        8, 32, 8, 0,
/* 132 */	        8, 40, 8, 0,
/* 133 */	        8, 48, 8, 0,
/* 134 */	        0, 56, 8, 0,
/* 135 */	        8, 64, 8, 0,
/* 136 */	        8, 72, 8, 0,
/* 137 */	        8, 80, 8, 0,
/* 138 */	        8, 88, 8, 0,
/* 139 */	        8, 96, 8, 0,
/* 140 */	        8, 104, 8, 0,
/* 141 */	        8, 112, 8, 0,
/* 142 */	        0, 120, 8, 0,
/* 143 */	        0, 128, 8, 0,
/* 144 */	        7, 136, 8, 0,
/* 145 */	        8, 144, 8, 0,
/* 146 */	        8, 152, 8, 0,
/* 147 */	        8, 160, 8, 0,
/* 148 */	        0, 168, 8, 0,
/* 149 */	        6, 176, 8, 0,
/* 150 */	        8, 184, 8, 0,
/* 151 */	        8, 192, 8, 0,
/* 152 */	        8, 200, 8, 0,
/* 153 */	        8, 208, 8, 0,
/* 154 */	        8, 216, 8, 0,
/* 155 */	        8, 224, 8, 0,
/* 156 */	        8, 232, 8, 0,
/* 157 */	        8, 240, 8, 0,
/* 158 */	        0, 248, 8, 0,
/* 159 */	        0, 0, 9, 0,
/* 160 */	        0, 8, 9, 0,
/* 161 */	        0, 16, 9, 0,
/* 162 */	        0, 24, 9, 0,
/* 163 */	        0, 32, 9, 0,
/* 164 */	        0, 40, 9, 0,
/* 165 */	        0, 48, 9, 0,
/* 166 */	        0, 56, 9, 0,
/* 167 */	        0, 64, 9, 0,
/* 168 */	        0, 72, 9, 0,
/* 169 */	        0, 80, 9, 0,
/* 170 */	        0, 88, 9, 0,
/* 171 */	        0, 96, 9, 0,
/* 172 */	        0, 104, 9, 0,
/* 173 */	        0, 112, 9, 0,
/* 174 */	        0, 120, 9, 0,
/* 175 */	        0, 128, 9, 0,
/* 176 */	        0, 136, 9, 0,
/* 177 */	        0, 144, 9, 0,
/* 178 */	        0, 152, 9, 0,
/* 179 */	        0, 160, 9, 0,
/* 180 */	        0, 168, 9, 0,
/* 181 */	        0, 176, 9, 0,
/* 182 */	        0, 184, 9, 0,
/* 183 */	        0, 192, 9, 0,
/* 184 */	        0, 200, 9, 0,
/* 185 */	        0, 208, 9, 0,
/* 186 */	        0, 216, 9, 0,
/* 187 */	        0, 224, 9, 0,
/* 188 */	        0, 232, 9, 0,
/* 189 */	        0, 240, 9, 0,
/* 190 */	        0, 248, 9, 0,
/* 191 */	        0, 0, 10, 0,
/* 192 */	        0, 8, 10, 0,
/* 193 */	        0, 16, 10, 0,
/* 194 */	        0, 24, 10, 0,
/* 195 */	        0, 32, 10, 0,
/* 196 */	        0, 40, 10, 0,
/* 197 */	        0, 48, 10, 0,
/* 198 */	        0, 56, 10, 0,
/* 199 */	        0, 64, 10, 0,
/* 200 */	        0, 72, 10, 0,
/* 201 */	        0, 80, 10, 0,
/* 202 */	        0, 88, 10, 0,
/* 203 */	        0, 96, 10, 0,
/* 204 */	        0, 104, 10, 0,
/* 205 */	        0, 112, 10, 0,
/* 206 */	        0, 120, 10, 0,
/* 207 */	        0, 128, 10, 0,
/* 208 */	        0, 136, 10, 0,
/* 209 */	        0, 144, 10, 0,
/* 210 */	        0, 152, 10, 0,
/* 211 */	        0, 160, 10, 0,
/* 212 */	        0, 168, 10, 0,
/* 213 */	        0, 176, 10, 0,
/* 214 */	        0, 184, 10, 0,
/* 215 */	        0, 192, 10, 0,
/* 216 */	        0, 200, 10, 0,
/* 217 */	        0, 208, 10, 0,
/* 218 */	        0, 216, 10, 0,
/* 219 */	        0, 224, 10, 0,
/* 220 */	        0, 232, 10, 0,
/* 221 */	        0, 240, 10, 0,
/* 222 */	        0, 248, 10, 0,
/* 223 */	        0, 0, 11, 0,
/* 224 */	        0, 8, 11, 0,
/* 225 */	        0, 16, 11, 0,
/* 226 */	        0, 24, 11, 0,
/* 227 */	        0, 32, 11, 0,
/* 228 */	        0, 40, 11, 0,
/* 229 */	        0, 48, 11, 0,
/* 230 */	        0, 56, 11, 0,
/* 231 */	        0, 64, 11, 0,
/* 232 */	        0, 72, 11, 0,
/* 233 */	        0, 80, 11, 0,
/* 234 */	        0, 88, 11, 0,
/* 235 */	        0, 96, 11, 0,
/* 236 */	        0, 104, 11, 0,
/* 237 */	        0, 112, 11, 0,
/* 238 */	        0, 120, 11, 0,
/* 239 */	        0, 128, 11, 0,
/* 240 */	        0, 136, 11, 0,
/* 241 */	        0, 144, 11, 0,
/* 242 */	        0, 152, 11, 0,
/* 243 */	        0, 160, 11, 0,
/* 244 */	        0, 168, 11, 0,
/* 245 */	        0, 176, 11, 0,
/* 246 */	        0, 184, 11, 0,
/* 247 */	        0, 192, 11, 0,
/* 248 */	        0, 200, 11, 0,
/* 249 */	        0, 208, 11, 0,
/* 250 */	        0, 216, 11, 0,
/* 251 */	        0, 224, 11, 0,
/* 252 */	        0, 232, 11, 0,
/* 253 */	        0, 240, 11, 0,
/* 254 */	        0, 248, 11, 0,
/* 255 */	        0, 0, 12, 0,

/* Map of characters */

/* 0 */	       0,0,0,0,0,0,0,0,
/* 1 */	       0,0,0,0,0,0,0,0,
/* 2 */	       0,0,0,0,0,0,0,0,
/* 3 */	       0,0,0,0,0,0,0,0,
/* 4 */	       0,0,0,0,0,0,0,0,
/* 5 */	       0,0,0,0,0,0,0,0,
/* 6 */	       0,0,0,0,0,0,0,0,
/* 7 */	       0,0,0,0,0,0,0,0,
/* 8 */	       0,0,0,0,0,0,0,0,
/* 9 */	       0,0,0,0,0,0,0,0,
/* 10 */	       0,0,0,0,0,0,0,0,
/* 11 */	       0,0,0,0,0,0,0,0,
/* 12 */	       0,0,0,0,0,0,0,0,
/* 13 */	       0,0,0,0,0,0,0,0,
/* 14 */	       0,0,0,0,0,0,0,0,
/* 15 */	       0,0,0,0,0,0,0,0,
/* 16 */	       255,128,128,128,128,128,128,0,
/* 17 */	       128,128,128,128,128,128,255,0,
/* 18 */	       255,255,255,255,128,128,128,0,
/* 19 */	       1,1,1,255,255,255,255,0,
/* 20 */	       0,0,0,0,0,0,0,0,
/* 21 */	       0,0,0,0,0,0,0,0,
/* 22 */	       0,0,0,0,0,0,0,0,
/* 23 */	       0,0,0,0,0,0,0,0,
/* 24 */	       0,0,0,0,0,0,0,0,
/* 25 */	       0,0,0,0,0,0,0,0,
/* 26 */	       0,0,0,0,0,0,0,0,
/* 27 */	       0,0,0,0,0,0,0,0,
/* 28 */	       0,0,0,0,0,0,0,0,
/* 29 */	       0,0,0,0,0,0,0,0,
/* 30 */	       0,0,0,0,0,0,0,0,
/* 31 */	       0,0,0,0,0,0,0,0,
/* 32 */	       0,0,0,8,24,40,72,143,
/* 33 */	       0,0,0,0,0,0,0,255,
/* 34 */	       0,0,0,0,8,4,2,1,
/* 35 */	       0,0,0,0,16,32,64,128,
/* 36 */	       0,0,0,0,18,34,66,250,
/* 37 */	       0,0,0,0,144,136,132,190,
/* 38 */	       15,8,8,15,1,1,1,1,
/* 39 */	       224,32,32,224,0,0,0,0,
/* 40 */	       0,15,16,32,64,64,64,64,
/* 41 */	       0,128,64,32,16,16,16,16,
/* 42 */	       0,123,24,40,72,64,64,0,
/* 43 */	       0,144,80,48,240,0,16,16,
/* 44 */	       0,63,80,80,80,80,80,80,
/* 45 */	       0,252,10,10,10,10,10,10,
/* 46 */	       0,3,6,12,25,51,102,204,
/* 47 */	       0,51,102,204,152,48,96,192,
/* 48 */	       72,40,24,8,0,0,0,0,
/* 49 */	       0,0,0,0,0,0,0,0,
/* 50 */	       1,2,4,8,0,0,0,0,
/* 51 */	       128,64,32,16,0,0,0,0,
/* 52 */	       66,34,18,0,0,0,0,0,
/* 53 */	       132,136,144,0,0,0,0,0,
/* 54 */	       1,1,9,5,3,1,0,0,
/* 55 */	       0,0,32,64,128,0,0,0,
/* 56 */	       64,32,16,15,0,0,0,0,
/* 57 */	       16,32,64,128,0,0,0,0,
/* 58 */	       120,96,80,78,0,0,0,0,
/* 59 */	       144,160,192,240,0,0,0,0,
/* 60 */	       80,95,64,64,65,65,63,0,
/* 61 */	       10,250,2,2,242,18,252,0,
/* 62 */	       204,102,51,25,12,6,3,0,
/* 63 */	       192,96,48,152,204,102,51,0,
/* 64 */	       0,0,18,18,18,127,64,64,
/* 65 */	       0,0,72,72,72,254,2,2,
/* 66 */	       7,8,8,31,32,32,32,33,
/* 67 */	       224,16,16,248,4,4,132,196,
/* 68 */	       0,0,48,56,28,14,7,3,
/* 69 */	       0,0,12,28,56,112,224,192,
/* 70 */	       0,0,0,0,30,33,32,33,
/* 71 */	       0,0,0,0,0,252,2,254,
/* 72 */	       0,0,8,20,34,65,227,20,
/* 73 */	       0,0,0,0,0,0,128,0,
/* 74 */	       0,127,128,127,0,0,0,0,
/* 75 */	       0,240,8,200,40,40,40,40,
/* 76 */	       1,2,4,8,16,32,64,255,
/* 77 */	       0,128,64,32,16,8,4,254,
/* 78 */	       255,64,32,16,8,4,2,1,
/* 79 */	       254,4,8,16,32,64,128,0,
/* 80 */	       64,64,127,18,18,18,0,0,
/* 81 */	       2,2,254,72,72,72,0,0,
/* 82 */	       44,44,34,33,32,32,32,31,
/* 83 */	       132,180,180,196,132,4,4,248,
/* 84 */	       3,7,14,28,56,48,0,0,
/* 85 */	       192,224,112,56,28,12,0,0,
/* 86 */	       34,36,40,48,48,31,0,0,
/* 87 */	       1,1,1,2,4,248,0,0,
/* 88 */	       20,20,20,19,16,15,0,0,
/* 89 */	       0,0,0,254,1,254,0,0,
/* 90 */	       1,0,0,0,0,0,0,0,
/* 91 */	       199,130,68,40,16,0,0,0,
/* 92 */	       0,0,0,0,0,0,0,0,
/* 93 */	       0,0,0,0,0,0,0,0,
/* 94 */	       0,0,0,0,0,0,0,0,
/* 95 */	       0,0,0,0,0,0,0,0,
/* 96 */	       0,0,24,24,30,30,25,25,
/* 97 */	       0,0,24,24,120,120,152,152,
/* 98 */	       12,18,10,74,177,128,113,10,
/* 99 */	       24,20,18,33,71,136,16,32,
/* 100 */	       0,0,0,0,0,0,0,255,
/* 101 */	       0,0,0,16,24,20,18,241,
/* 102 */	       0,127,65,65,65,65,65,193,
/* 103 */	       0,0,0,0,0,0,0,0,
/* 104 */	       128,127,97,81,73,69,67,193,
/* 105 */	       1,2,4,8,16,32,64,128,
/* 106 */	       0,0,0,0,251,34,34,35,
/* 107 */	       0,0,0,0,210,20,24,144,
/* 108 */	       0,0,0,0,121,74,10,18,
/* 109 */	       0,0,0,0,222,82,82,82,
/* 110 */	       0,136,152,168,207,168,152,136,
/* 111 */	       0,0,0,0,255,0,0,0,
/* 112 */	       24,24,24,24,0,0,0,0,
/* 113 */	       24,24,24,24,0,0,0,0,
/* 114 */	       4,8,17,226,132,72,40,24,
/* 115 */	       80,142,1,141,82,80,72,48,
/* 116 */	       0,0,0,0,0,0,0,0,
/* 117 */	       18,20,24,16,0,0,0,0,
/* 118 */	       1,1,1,1,1,1,1,0,
/* 119 */	       7,4,4,4,4,4,252,0,
/* 120 */	       1,3,5,9,17,33,65,128,
/* 121 */	       135,68,36,20,12,4,254,1,
/* 122 */	       34,34,35,0,0,0,0,0,
/* 123 */	       24,20,210,0,0,0,0,0,
/* 124 */	       11,74,122,0,0,0,0,0,
/* 125 */	       210,82,82,0,0,0,0,0,
/* 126 */	       0,0,0,255,0,0,0,0,
/* 127 */	       17,25,21,243,21,25,17,0,
/* 128 */	       127,128,128,128,128,128,128,128,
/* 129 */	       224,16,28,20,20,20,28,16,
/* 130 */	       31,17,31,4,255,32,251,138,
/* 131 */	       0,0,0,0,224,128,224,32,
/* 132 */	       3,7,8,144,255,130,1,0,
/* 133 */	       0,0,0,0,252,0,56,248,
/* 134 */	       0,0,0,0,0,0,0,0,
/* 135 */	       0,254,130,130,130,130,130,131,
/* 136 */	       128,128,128,128,128,128,128,128,
/* 137 */	       1,255,135,139,147,163,195,131,
/* 138 */	       128,64,32,17,10,4,10,17,
/* 139 */	       32,64,128,0,0,0,0,0,
/* 140 */	       0,0,0,0,247,148,148,151,
/* 141 */	       0,0,0,0,156,36,36,164,
/* 142 */	       0,0,0,0,0,0,0,0,
/* 143 */	       0,0,0,0,0,0,0,0,
/* 144 */	       127,0,0,0,0,0,0,0,
/* 145 */	       224,0,0,0,0,0,0,0,
/* 146 */	       251,0,0,0,0,0,0,0,
/* 147 */	       224,0,0,0,0,0,0,0,
/* 148 */	       0,0,0,0,0,0,0,0,
/* 149 */	       56,0,0,0,0,0,0,0,
/* 150 */	       224,32,32,32,32,32,63,0,
/* 151 */	       128,128,128,128,128,128,128,0,
/* 152 */	       225,162,164,168,176,160,255,128,
/* 153 */	       129,129,129,129,129,129,129,1,
/* 154 */	       32,64,128,0,0,0,0,0,
/* 155 */	       128,64,32,0,0,0,0,0,
/* 156 */	       148,148,247,0,0,0,0,0,
/* 157 */	       188,164,164,0,0,0,0,0,
/* 158 */	       0,0,0,0,0,0,0,0,
/* 159 */	       0,0,0,0,0,0,0,0,
/* 160 */	       0,0,0,0,0,0,0,0,
/* 161 */	       0,0,0,0,0,0,0,0,
/* 162 */	       0,0,0,0,0,0,0,0,
/* 163 */	       0,0,0,0,0,0,0,0,
/* 164 */	       0,0,0,0,0,0,0,0,
/* 165 */	       0,0,0,0,0,0,0,0,
/* 166 */	       0,0,0,0,0,0,0,0,
/* 167 */	       0,0,0,0,0,0,0,0,
/* 168 */	       0,0,0,0,0,0,0,0,
/* 169 */	       0,0,0,0,0,0,0,0,
/* 170 */	       0,0,0,0,0,0,0,0,
/* 171 */	       0,0,0,0,0,0,0,0,
/* 172 */	       0,0,0,0,0,0,0,0,
/* 173 */	       0,0,0,0,0,0,0,0,
/* 174 */	       0,0,0,0,0,0,0,0,
/* 175 */	       0,0,0,0,0,0,0,0,
/* 176 */	       0,0,0,0,0,0,0,0,
/* 177 */	       0,0,0,0,0,0,0,0,
/* 178 */	       0,0,0,0,0,0,0,0,
/* 179 */	       0,0,0,0,0,0,0,0,
/* 180 */	       0,0,0,0,0,0,0,0,
/* 181 */	       0,0,0,0,0,0,0,0,
/* 182 */	       0,0,0,0,0,0,0,0,
/* 183 */	       0,0,0,0,0,0,0,0,
/* 184 */	       0,0,0,0,0,0,0,0,
/* 185 */	       0,0,0,0,0,0,0,0,
/* 186 */	       0,0,0,0,0,0,0,0,
/* 187 */	       0,0,0,0,0,0,0,0,
/* 188 */	       0,0,0,0,0,0,0,0,
/* 189 */	       0,0,0,0,0,0,0,0,
/* 190 */	       0,0,0,0,0,0,0,0,
/* 191 */	       0,0,0,0,0,0,0,0,
/* 192 */	       0,0,0,0,0,0,0,0,
/* 193 */	       0,0,0,0,0,0,0,0,
/* 194 */	       0,0,0,0,0,0,0,0,
/* 195 */	       0,0,0,0,0,0,0,0,
/* 196 */	       0,0,0,0,0,0,0,0,
/* 197 */	       0,0,0,0,0,0,0,0,
/* 198 */	       0,0,0,0,0,0,0,0,
/* 199 */	       0,0,0,0,0,0,0,0,
/* 200 */	       0,0,0,0,0,0,0,0,
/* 201 */	       0,0,0,0,0,0,0,0,
/* 202 */	       0,0,0,0,0,0,0,0,
/* 203 */	       0,0,0,0,0,0,0,0,
/* 204 */	       0,0,0,0,0,0,0,0,
/* 205 */	       0,0,0,0,0,0,0,0,
/* 206 */	       0,0,0,0,0,0,0,0,
/* 207 */	       0,0,0,0,0,0,0,0,
/* 208 */	       0,0,0,0,0,0,0,0,
/* 209 */	       0,0,0,0,0,0,0,0,
/* 210 */	       0,0,0,0,0,0,0,0,
/* 211 */	       0,0,0,0,0,0,0,0,
/* 212 */	       0,0,0,0,0,0,0,0,
/* 213 */	       0,0,0,0,0,0,0,0,
/* 214 */	       0,0,0,0,0,0,0,0,
/* 215 */	       0,0,0,0,0,0,0,0,
/* 216 */	       0,0,0,0,0,0,0,0,
/* 217 */	       0,0,0,0,0,0,0,0,
/* 218 */	       0,0,0,0,0,0,0,0,
/* 219 */	       0,0,0,0,0,0,0,0,
/* 220 */	       0,0,0,0,0,0,0,0,
/* 221 */	       0,0,0,0,0,0,0,0,
/* 222 */	       0,0,0,0,0,0,0,0,
/* 223 */	       0,0,0,0,0,0,0,0,
/* 224 */	       0,0,0,0,0,0,0,0,
/* 225 */	       0,0,0,0,0,0,0,0,
/* 226 */	       0,0,0,0,0,0,0,0,
/* 227 */	       0,0,0,0,0,0,0,0,
/* 228 */	       0,0,0,0,0,0,0,0,
/* 229 */	       0,0,0,0,0,0,0,0,
/* 230 */	       0,0,0,0,0,0,0,0,
/* 231 */	       0,0,0,0,0,0,0,0,
/* 232 */	       0,0,0,0,0,0,0,0,
/* 233 */	       0,0,0,0,0,0,0,0,
/* 234 */	       0,0,0,0,0,0,0,0,
/* 235 */	       0,0,0,0,0,0,0,0,
/* 236 */	       0,0,0,0,0,0,0,0,
/* 237 */	       0,0,0,0,0,0,0,0,
/* 238 */	       0,0,0,0,0,0,0,0,
/* 239 */	       0,0,0,0,0,0,0,0,
/* 240 */	       0,0,0,0,0,0,0,0,
/* 241 */	       0,0,0,0,0,0,0,0,
/* 242 */	       0,0,0,0,0,0,0,0,
/* 243 */	       0,0,0,0,0,0,0,0,
/* 244 */	       0,0,0,0,0,0,0,0,
/* 245 */	       0,0,0,0,0,0,0,0,
/* 246 */	       0,0,0,0,0,0,0,0,
/* 247 */	       0,0,0,0,0,0,0,0,
/* 248 */	       0,0,0,0,0,0,0,0,
/* 249 */	       0,0,0,0,0,0,0,0,
/* 250 */	       0,0,0,0,0,0,0,0,
/* 251 */	       0,0,0,0,0,0,0,0,
/* 252 */	       0,0,0,0,0,0,0,0,
/* 253 */	       0,0,0,0,0,0,0,0,
/* 254 */	       0,0,0,0,0,0,0,0,
/* 255 */	       0,0,0,0,0,0,0,0
};
