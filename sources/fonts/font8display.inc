/* Main font height 8 */

const BYTE font8display[3080] = {

/* Orient = 0x00, FontID = 0x00 */ 0x00, 0x00,
/* First character ID */           0x00, 0x00,
/* Last  character ID */           0xff, 0xff,
/* Height */                       0x08, 0x00,

/* Table of characters */

/*  0  */	        0, 8, 4, 0,
/*  1  */	        0, 16, 4, 0,
/*  2  */	        0, 24, 4, 0,
/*  3  */	        0, 32, 4, 0,
/*  4  */	        0, 40, 4, 0,
/*  5  */	        0, 48, 4, 0,
/*  6  */	        0, 56, 4, 0,
/*  7  */	        0, 64, 4, 0,
/*  8  */	        0, 72, 4, 0,
/*  9  */	        0, 80, 4, 0,
/*  10  */	        0, 88, 4, 0,
/*  11  */	        0, 96, 4, 0,
/*  12  */	        0, 104, 4, 0,
/*  13  */	        8, 112, 4, 0,
/*  14  */	        8, 120, 4, 0,
/*  15  */	        8, 128, 4, 0,
/*  16  */	        0, 136, 4, 0,
/*  17  */	        1, 144, 4, 0,
/*  18  */	        2, 152, 4, 0,
/*  19  */	        3, 160, 4, 0,
/*  20  */	        4, 168, 4, 0,
/*  21  */	        5, 176, 4, 0,
/*  22  */	        6, 184, 4, 0,
/*  23  */	        7, 192, 4, 0,
/*  24  */	        8, 200, 4, 0,
/*  25  */	        9, 208, 4, 0,
/*  26  */	        10, 216, 4, 0,
/*  27  */	        11, 224, 4, 0,
/*  28  */	        12, 232, 4, 0,
/*  29  */	        13, 240, 4, 0,
/*  30  */	        14, 248, 4, 0,
/*  31  */	        15, 0, 5, 0,
/*  32  */	        2, 8, 5, 0,
/*  33  */	        6, 16, 5, 0,
/*  34  */	        8, 24, 5, 0,
/*  35  */	        8, 32, 5, 0,
/*  36  */	        8, 40, 5, 0,
/*  37  */	        8, 48, 5, 0,
/*  38  */	        8, 56, 5, 0,
/*  39  */	        7, 64, 5, 0,
/*  40  */	        8, 72, 5, 0,
/*  41  */	        8, 80, 5, 0,
/*  42  */	        8, 88, 5, 0,
/*  43  */	        8, 96, 5, 0,
/*  44  */	        6, 104, 5, 0,
/*  45  */	        8, 112, 5, 0,
/*  46  */	        8, 120, 5, 0,
/*  47  */	        8, 128, 5, 0,
/*  48  */	        8, 136, 5, 0,
/*  49  */	        7, 144, 5, 0,
/*  50  */	        8, 152, 5, 0,
/*  51  */	        8, 160, 5, 0,
/*  52  */	        8, 168, 5, 0,
/*  53  */	        8, 176, 5, 0,
/*  54  */	        8, 184, 5, 0,
/*  55  */	        8, 192, 5, 0,
/*  56  */	        8, 200, 5, 0,
/*  57  */	        8, 208, 5, 0,
/*  58  */	        8, 216, 5, 0,
/*  59  */	        7, 224, 5, 0,
/*  60  */	        8, 232, 5, 0,
/*  61  */	        8, 240, 5, 0,
/*  62  */	        8, 248, 5, 0,
/*  63  */	        8, 0, 6, 0,
/*  64  */	        8, 8, 6, 0,
/*  65  */	        8, 16, 6, 0,
/*  66  */	        8, 24, 6, 0,
/*  67  */	        8, 32, 6, 0,
/*  68  */	        8, 40, 6, 0,
/*  69  */	        8, 48, 6, 0,
/*  70  */	        8, 56, 6, 0,
/*  71  */	        8, 64, 6, 0,
/*  72  */	        8, 72, 6, 0,
/*  73  */	        8, 80, 6, 0,
/*  74  */	        8, 88, 6, 0,
/*  75  */	        8, 96, 6, 0,
/*  76  */	        8, 104, 6, 0,
/*  77  */	        8, 112, 6, 0,
/*  78  */	        8, 120, 6, 0,
/*  79  */	        8, 128, 6, 0,
/*  80  */	        8, 136, 6, 0,
/*  81  */	        8, 144, 6, 0,
/*  82  */	        8, 152, 6, 0,
/*  83  */	        8, 160, 6, 0,
/*  84  */	        8, 168, 6, 0,
/*  85  */	        8, 176, 6, 0,
/*  86  */	        8, 184, 6, 0,
/*  87  */	        8, 192, 6, 0,
/*  88  */	        8, 200, 6, 0,
/*  89  */	        8, 208, 6, 0,
/*  90  */	        8, 216, 6, 0,
/*  91  */	        7, 224, 6, 0,
/*  92  */	        8, 232, 6, 0,
/*  93  */	        7, 240, 6, 0,
/*  94  */	        8, 248, 6, 0,
/*  95  */	        8, 0, 7, 0,
/*  96  */	        8, 8, 7, 0,
/*  97  */	        8, 16, 7, 0,
/*  98  */	        8, 24, 7, 0,
/*  99  */	        8, 32, 7, 0,
/*  100  */	        8, 40, 7, 0,
/*  101  */	        8, 48, 7, 0,
/*  102  */	        8, 56, 7, 0,
/*  103  */	        8, 64, 7, 0,
/*  104  */	        8, 72, 7, 0,
/*  105  */	        8, 80, 7, 0,
/*  106  */	        8, 88, 7, 0,
/*  107  */	        8, 96, 7, 0,
/*  108  */	        8, 104, 7, 0,
/*  109  */	        8, 112, 7, 0,
/*  110  */	        8, 120, 7, 0,
/*  111  */	        8, 128, 7, 0,
/*  112  */	        8, 136, 7, 0,
/*  113  */	        8, 144, 7, 0,
/*  114  */	        8, 152, 7, 0,
/*  115  */	        8, 160, 7, 0,
/*  116  */	        8, 168, 7, 0,
/*  117  */	        8, 176, 7, 0,
/*  118  */	        8, 184, 7, 0,
/*  119  */	        8, 192, 7, 0,
/*  120  */	        8, 200, 7, 0,
/*  121  */	        8, 208, 7, 0,
/*  122  */	        8, 216, 7, 0,
/*  123  */	        8, 224, 7, 0,
/*  124  */	        8, 232, 7, 0,
/*  125  */	        8, 240, 7, 0,
/*  126  */	        8, 248, 7, 0,
/*  127  */	        8, 0, 8, 0,
/*  128  */	        8, 8, 8, 0,
/*  129  */	        8, 16, 8, 0,
/*  130  */	        8, 24, 8, 0,
/*  131  */	        8, 32, 8, 0,
/*  132  */	        7, 40, 8, 0,
/*  133  */	        8, 48, 8, 0,
/*  134  */	        7, 56, 8, 0,
/*  135  */	        8, 64, 8, 0,
/*  136  */	        8, 72, 8, 0,
/*  137  */	        0, 80, 8, 0,
/*  138  */	        7, 88, 8, 0,
/*  139  */	        8, 96, 8, 0,
/*  140  */	        8, 104, 8, 0,
/*  141  */	        8, 112, 8, 0,
/*  142  */	        8, 120, 8, 0,
/*  143  */	        8, 128, 8, 0,
/*  144  */	        8, 136, 8, 0,
/*  145  */	        8, 144, 8, 0,
/*  146  */	        8, 152, 8, 0,
/*  147  */	        8, 160, 8, 0,
/*  148  */	        8, 168, 8, 0,
/*  149  */	        8, 176, 8, 0,
/*  150  */	        8, 184, 8, 0,
/*  151  */	        8, 192, 8, 0,
/*  152  */	        0, 200, 8, 0,
/*  153  */	        8, 208, 8, 0,
/*  154  */	        8, 216, 8, 0,
/*  155  */	        8, 224, 8, 0,
/*  156  */	        6, 232, 8, 0,
/*  157  */	        0, 240, 8, 0,
/*  158  */	        8, 248, 8, 0,
/*  159  */	        8, 0, 9, 0,
/*  160  */	        8, 8, 9, 0,
/*  161  */	        8, 16, 9, 0,
/*  162  */	        8, 24, 9, 0,
/*  163  */	        8, 32, 9, 0,
/*  164  */	        8, 40, 9, 0,
/*  165  */	        8, 48, 9, 0,
/*  166  */	        8, 56, 9, 0,
/*  167  */	        8, 64, 9, 0,
/*  168  */	        8, 72, 9, 0,
/*  169  */	        0, 80, 9, 0,
/*  170  */	        8, 88, 9, 0,
/*  171  */	        8, 96, 9, 0,
/*  172  */	        8, 104, 9, 0,
/*  173  */	        8, 112, 9, 0,
/*  174  */	        8, 120, 9, 0,
/*  175  */	        8, 128, 9, 0,
/*  176  */	        8, 136, 9, 0,
/*  177  */	        8, 144, 9, 0,
/*  178  */	        8, 152, 9, 0,
/*  179  */	        8, 160, 9, 0,
/*  180  */	        8, 168, 9, 0,
/*  181  */	        8, 176, 9, 0,
/*  182  */	        8, 184, 9, 0,
/*  183  */	        8, 192, 9, 0,
/*  184  */	        8, 200, 9, 0,
/*  185  */	        0, 208, 9, 0,
/*  186  */	        6, 216, 9, 0,
/*  187  */	        0, 224, 9, 0,
/*  188  */	        6, 232, 9, 0,
/*  189  */	        0, 240, 9, 0,
/*  190  */	        8, 248, 9, 0,
/*  191  */	        8, 0, 10, 0,
/*  192  */	        8, 8, 10, 0,
/*  193  */	        8, 16, 10, 0,
/*  194  */	        8, 24, 10, 0,
/*  195  */	        8, 32, 10, 0,
/*  196  */	        8, 40, 10, 0,
/*  197  */	        8, 48, 10, 0,
/*  198  */	        8, 56, 10, 0,
/*  199  */	        8, 64, 10, 0,
/*  200  */	        8, 72, 10, 0,
/*  201  */	        8, 80, 10, 0,
/*  202  */	        8, 88, 10, 0,
/*  203  */	        8, 96, 10, 0,
/*  204  */	        8, 104, 10, 0,
/*  205  */	        8, 112, 10, 0,
/*  206  */	        8, 120, 10, 0,
/*  207  */	        8, 128, 10, 0,
/*  208  */	        8, 136, 10, 0,
/*  209  */	        8, 144, 10, 0,
/*  210  */	        8, 152, 10, 0,
/*  211  */	        8, 160, 10, 0,
/*  212  */	        8, 168, 10, 0,
/*  213  */	        8, 176, 10, 0,
/*  214  */	        8, 184, 10, 0,
/*  215  */	        8, 192, 10, 0,
/*  216  */	        8, 200, 10, 0,
/*  217  */	        8, 208, 10, 0,
/*  218  */	        8, 216, 10, 0,
/*  219  */	        8, 224, 10, 0,
/*  220  */	        8, 232, 10, 0,
/*  221  */	        8, 240, 10, 0,
/*  222  */	        8, 248, 10, 0,
/*  223  */	        8, 0, 11, 0,
/*  224  */	        8, 8, 11, 0,
/*  225  */	        8, 16, 11, 0,
/*  226  */	        8, 24, 11, 0,
/*  227  */	        8, 32, 11, 0,
/*  228  */	        8, 40, 11, 0,
/*  229  */	        8, 48, 11, 0,
/*  230  */	        8, 56, 11, 0,
/*  231  */	        8, 64, 11, 0,
/*  232  */	        8, 72, 11, 0,
/*  233  */	        8, 80, 11, 0,
/*  234  */	        8, 88, 11, 0,
/*  235  */	        8, 96, 11, 0,
/*  236  */	        8, 104, 11, 0,
/*  237  */	        8, 112, 11, 0,
/*  238  */	        8, 120, 11, 0,
/*  239  */	        8, 128, 11, 0,
/*  240  */	        8, 136, 11, 0,
/*  241  */	        8, 144, 11, 0,
/*  242  */	        8, 152, 11, 0,
/*  243  */	        8, 160, 11, 0,
/*  244  */	        8, 168, 11, 0,
/*  245  */	        8, 176, 11, 0,
/*  246  */	        8, 184, 11, 0,
/*  247  */	        8, 192, 11, 0,
/*  248  */	        8, 200, 11, 0,
/*  249  */	        8, 208, 11, 0,
/*  250  */	        8, 216, 11, 0,
/*  251  */	        8, 224, 11, 0,
/*  252  */	        8, 232, 11, 0,
/*  253  */	        8, 240, 11, 0,
/*  254  */	        8, 248, 11, 0,
/*  255  */	        8, 0, 12, 0,

/* Map of characters */

/*  0  */	        0,0,0,0,0,0,0,0,
/*  1  */	        0,0,0,0,0,0,0,0,
/*  2  */	        0,0,0,0,0,0,0,0,
/*  3  */	        0,0,0,0,0,0,0,0,
/*  4  */	        0,0,0,0,0,0,0,0,
/*  5  */	        0,0,0,0,0,0,0,0,
/*  6  */	        0,0,0,0,0,0,0,0,
/*  7  */	        0,0,0,0,0,0,0,0,
/*  8  */	        0,0,0,0,0,0,0,0,
/*  9  */	        0,0,0,0,0,0,0,0,
/*  10  */	        0,0,0,0,0,0,0,0,
/*  11  */	        0,0,0,0,0,0,0,0,
/*  12  */	        0,0,0,0,0,0,0,0,
/*  13  */	        32,112,248,32,32,248,112,32,
/*  14  */	        62,65,160,144,136,128,128,65,
/*  15  */	        0,0,128,128,128,128,128,0,
/*  16  */	        0,0,0,0,0,0,0,0,
/*  17  */	        0,0,0,0,0,0,0,0,
/*  18  */	        0,0,0,0,0,0,0,0,
/*  19  */	        0,0,0,0,0,0,0,0,
/*  20  */	        0,0,0,0,0,0,0,0,
/*  21  */	        0,0,0,0,0,0,0,0,
/*  22  */	        0,0,0,0,0,0,0,0,
/*  23  */	        0,0,0,0,0,0,0,0,
/*  24  */	        0,0,0,0,0,0,0,0,
/*  25  */	        0,0,0,0,0,0,0,0,
/*  26  */	        0,0,0,0,0,0,0,0,
/*  27  */	        0,0,0,0,0,0,0,0,
/*  28  */	        0,0,0,0,0,0,0,0,
/*  29  */	        0,0,0,0,0,0,0,0,
/*  30  */	        62,0,0,0,0,0,0,0,
/*  31  */	        0,0,0,0,0,0,0,0,
/*  32  */	        0,0,0,0,0,0,0,0,
/*  33  */	        32,32,32,32,32,0,32,0,
/*  34  */	        160,160,0,0,0,0,0,0,
/*  35  */	        0,80,248,80,80,248,80,0,
/*  36  */	        0,32,248,160,248,40,248,32,
/*  37  */	        0,196,200,16,32,76,140,0,
/*  38  */	        0,32,80,32,88,144,104,0,
/*  39  */	        0,32,64,0,0,0,0,0,
/*  40  */	        64,64,128,128,128,64,64,0,
/*  41  */	        128,128,64,64,64,128,128,0,
/*  42  */	        0,0,160,64,160,0,0,0,
/*  43  */	        0,0,64,224,64,0,0,0,
/*  44  */	        0,0,0,0,0,16,32,0,
/*  45  */	        0,0,0,224,0,0,0,0,
/*  46  */	        0,0,0,0,0,0,128,0,
/*  47  */	        0,32,32,64,64,128,128,0,
/*  48  */	        240,144,144,144,144,144,240,0,
/*  49  */	        96,32,32,32,32,32,112,0,
/*  50  */	        240,16,16,240,128,128,240,0,
/*  51  */	        240,16,16,240,16,16,240,0,
/*  52  */	        144,144,144,240,16,16,16,0,
/*  53  */	        240,128,128,240,16,16,240,0,
/*  54  */	        240,128,128,240,144,144,240,0,
/*  55  */	        240,16,32,64,128,128,128,0,
/*  56  */	        240,144,144,240,144,144,240,0,
/*  57  */	        240,144,144,240,16,16,240,0,
/*  58  */	        0,128,0,0,0,128,0,0,
/*  59  */	        0,0,32,0,0,32,32,64,
/*  60  */	        0,36,72,144,72,36,0,0,
/*  61  */	        0,0,224,0,224,0,0,0,
/*  62  */	        0,144,72,36,72,144,0,0,
/*  63  */	        0,112,136,16,32,0,32,0,
/*  64  */	        144,0,240,144,240,128,240,0,
/*  65  */	        240,144,144,144,240,144,144,0,
/*  66  */	        224,144,144,224,144,144,224,0,
/*  67  */	        240,128,128,128,128,128,240,0,
/*  68  */	        224,144,144,144,144,144,224,0,
/*  69  */	        240,128,128,224,128,128,240,0,
/*  70  */	        240,128,128,224,128,128,128,0,
/*  71  */	        112,136,128,128,152,136,112,0,
/*  72  */	        136,136,136,248,136,136,136,0,
/*  73  */	        248,32,32,32,32,32,248,0,
/*  74  */	        16,16,16,16,144,144,96,0,
/*  75  */	        136,144,160,192,160,144,136,0,
/*  76  */	        128,128,128,128,128,144,240,0,
/*  77  */	        136,216,168,136,136,136,136,0,
/*  78  */	        136,136,200,168,168,152,136,0,
/*  79  */	        112,136,136,136,136,136,112,0,
/*  80  */	        240,136,136,136,240,128,128,0,
/*  81  */	        112,136,136,136,168,144,104,0,
/*  82  */	        240,136,136,136,240,144,136,0,
/*  83  */	        240,128,128,240,16,16,240,0,
/*  84  */	        248,32,32,32,32,32,32,0,
/*  85  */	        136,136,136,136,136,136,112,0,
/*  86  */	        136,136,136,136,136,80,32,0,
/*  87  */	        136,136,136,136,136,168,80,0,
/*  88  */	        136,80,32,32,32,80,136,0,
/*  89  */	        136,136,136,80,32,32,32,0,
/*  90  */	        248,8,16,32,64,128,248,0,
/*  91  */	        0,112,64,64,64,64,112,0,
/*  92  */	        0,0,128,64,32,16,8,0,
/*  93  */	        0,112,16,16,16,16,112,0,
/*  94  */	        0,32,112,168,32,32,32,0,
/*  95  */	        0,0,0,0,0,0,0,252,
/*  96  */	        96,64,224,64,64,64,64,0,
/*  97  */	        0,0,240,16,240,144,240,0,
/*  98  */	        128,128,240,144,144,144,240,0,
/*  99  */	        0,0,240,128,128,128,240,0,
/*  100  */	        16,16,240,144,144,144,240,0,
/*  101  */	        0,0,240,144,240,128,240,0,
/*  102  */	        96,64,224,64,64,64,64,0,
/*  103  */	        0,0,240,144,144,240,16,240,
/*  104  */	        128,128,240,144,144,144,144,0,
/*  105  */	        128,0,128,128,128,128,128,0,
/*  106  */	        0,16,0,16,16,16,144,96,
/*  107  */	        128,128,144,160,192,160,144,0,
/*  108  */	        128,128,128,128,128,128,192,0,
/*  109  */	        0,0,208,168,168,168,168,0,
/*  110  */	        0,0,224,144,144,144,144,0,
/*  111  */	        0,0,240,144,144,144,240,0,
/*  112  */	        0,0,240,144,144,240,128,128,
/*  113  */	        0,0,240,144,144,240,16,24,
/*  114  */	        0,0,224,128,128,128,128,0,
/*  115  */	        0,0,240,128,240,16,240,0,
/*  116  */	        64,64,224,64,64,64,96,0,
/*  117  */	        0,0,144,144,144,144,240,0,
/*  118  */	        0,0,136,136,80,80,32,0,
/*  119  */	        0,0,136,168,168,168,80,0,
/*  120  */	        0,0,136,80,32,80,136,0,
/*  121  */	        0,0,144,144,144,240,16,240,
/*  122  */	        0,0,248,16,32,64,248,0,
/*  123  */	        248,32,32,32,32,46,42,14,
/*  124  */	        240,128,128,224,128,142,132,4,
/*  125  */	        248,32,32,32,32,46,36,4,
/*  126  */	        0,0,96,146,12,0,0,0,
/*  127  */	        0,0,64,128,128,0,0,0,
/*  128  */	        0,32,96,224,96,32,0,0,
/*  129  */	        0,128,192,224,192,128,0,0,
/*  130  */	        240,132,140,159,140,132,240,0,
/*  131  */	        225,162,228,8,16,39,69,135,
/*  132  */	        124,68,108,108,56,16,0,0,
/*  133  */	        254,254,254,254,124,56,16,0,
/*  134  */	        0,31,49,123,59,31,0,0,
/*  135  */	        0,248,140,222,220,248,0,0,
/*  136  */	        130,68,40,16,40,68,130,0,
/*  137  */	        0,0,0,0,0,0,0,0,
/*  138  */	        124,68,84,68,124,0,0,0,
/*  139  */	        254,254,254,254,254,254,0,0,
/*  140  */	        62,65,128,128,136,144,160,65,
/*  141  */	        0,0,128,128,128,128,128,0,
/*  142  */	        224,64,64,72,88,72,72,8,
/*  143  */	        224,64,64,92,84,68,72,28,
/*  144  */	        0,16,16,16,16,254,0,0,
/*  145  */	        0,0,96,146,12,0,0,0,
/*  146  */	        0,0,254,0,214,0,0,0,
/*  147  */	        248,252,254,255,254,252,248,0,
/*  148  */	        31,63,127,255,127,63,31,0,
/*  149  */	        248,248,248,248,248,248,248,112,
/*  150  */	        112,248,248,248,248,248,248,248,
/*  151  */	        0,36,102,255,102,36,0,0,
/*  152  */	        0,0,0,0,0,0,0,0,
/*  153  */	        0,16,8,252,8,16,0,0,
/*  154  */	        0,32,32,248,32,32,0,0,
/*  155  */	        0,0,0,248,0,0,0,0,
/*  156  */	        62,0,0,0,0,0,0,0,
/*  157  */	        0,0,0,0,0,0,0,0,
/*  158  */	        160,160,160,164,172,164,196,4,
/*  159  */	        160,160,160,174,170,162,196,14,
/*  160  */	        40,40,42,170,130,130,66,36,
/*  161  */	        24,36,66,129,0,0,0,0,
/*  162  */	        0,0,0,0,129,66,36,24,
/*  163  */	        32,112,248,0,0,0,0,0,
/*  164  */	        248,112,32,0,0,0,0,0,
/*  165  */	        0,128,0,0,0,128,0,0,
/*  166  */	        240,16,16,56,16,16,30,0,
/*  167  */	        30,16,16,56,16,16,240,0,
/*  168  */	        96,144,144,96,0,0,0,0,
/*  169  */	        0,0,0,0,0,0,0,0,
/*  170  */	        62,65,130,132,136,128,128,65,
/*  171  */	        0,0,128,128,128,128,128,0,
/*  172  */	        62,65,128,128,136,132,130,65,
/*  173  */	        0,0,128,128,128,128,128,0,
/*  174  */	        192,240,252,255,255,255,255,255,
/*  175  */	        0,0,0,0,192,240,252,255,
/*  176  */	        64,64,64,64,64,64,254,0,
/*  177  */	        21,64,0,64,0,64,255,0,
/*  178  */	        124,130,130,130,130,130,1,0,
/*  179  */	        62,65,65,65,65,65,128,0,
/*  180  */	        168,2,0,2,0,2,255,0,
/*  181  */	        63,64,64,64,64,64,128,0,
/*  182  */	        252,2,2,2,2,2,1,0,
/*  183  */	        84,84,84,84,84,84,254,0,
/*  184  */	        144,0,240,144,240,128,240,0,
/*  185  */	        0,0,0,0,0,0,0,0,
/*  186  */	        62,0,0,0,0,0,0,0,
/*  187  */	        0,0,0,0,0,0,0,0,
/*  188  */	        62,0,0,0,0,0,0,0,
/*  189  */	        0,0,0,0,0,0,0,0,
/*  190  */	        255,255,255,255,252,240,192,0,
/*  191  */	        252,240,192,0,0,0,0,0,
/*  192  */	        248,136,136,248,136,136,136,0,
/*  193  */	        248,128,128,248,136,136,248,0,
/*  194  */	        248,136,136,240,136,136,248,0,
/*  195  */	        240,128,128,128,128,128,128,0,
/*  196  */	        120,72,72,72,72,72,252,132,
/*  197  */	        248,128,128,240,128,128,248,0,
/*  198  */	        168,168,168,112,168,168,168,0,
/*  199  */	        248,136,8,48,8,136,248,0,
/*  200  */	        136,152,168,200,136,136,136,0,
/*  201  */	        168,152,168,200,136,136,136,0,
/*  202  */	        136,144,160,192,160,144,136,0,
/*  203  */	        56,72,136,136,136,136,136,0,
/*  204  */	        136,216,168,136,136,136,136,0,
/*  205  */	        136,136,136,248,136,136,136,0,
/*  206  */	        248,136,136,136,136,136,248,0,
/*  207  */	        248,136,136,136,136,136,136,0,
/*  208  */	        248,136,136,136,248,128,128,0,
/*  209  */	        248,136,128,128,128,136,248,0,
/*  210  */	        248,32,32,32,32,32,32,0,
/*  211  */	        136,136,136,248,8,8,248,0,
/*  212  */	        254,146,146,146,254,16,16,0,
/*  213  */	        136,80,80,32,80,80,136,0,
/*  214  */	        136,136,136,136,136,136,252,4,
/*  215  */	        136,136,136,136,248,8,8,0,
/*  216  */	        168,168,168,168,168,168,248,0,
/*  217  */	        168,168,168,168,168,168,252,4,
/*  218  */	        192,64,64,120,72,72,120,0,
/*  219  */	        132,132,132,244,148,148,244,0,
/*  220  */	        128,128,128,240,144,144,240,0,
/*  221  */	        248,8,8,248,8,8,248,0,
/*  222  */	        188,164,164,228,164,164,188,0,
/*  223  */	        248,136,136,136,120,72,136,0,
/*  224  */	        0,0,240,16,240,144,240,0,
/*  225  */	        0,0,240,128,240,144,240,0,
/*  226  */	        0,0,240,144,224,144,240,0,
/*  227  */	        0,0,224,128,128,128,128,0,
/*  228  */	        0,0,120,72,72,72,252,132,
/*  229  */	        0,0,240,144,240,128,240,0,
/*  230  */	        0,0,168,168,112,168,168,0,
/*  231  */	        0,0,240,144,32,144,240,0,
/*  232  */	        0,0,144,176,208,144,144,0,
/*  233  */	        0,32,144,176,208,144,144,0,
/*  234  */	        0,0,144,160,192,160,144,0,
/*  235  */	        0,0,112,144,144,144,144,0,
/*  236  */	        0,0,136,216,168,136,136,0,
/*  237  */	        0,0,144,144,240,144,144,0,
/*  238  */	        0,0,240,144,144,144,240,0,
/*  239  */	        0,0,240,144,144,144,144,0,
/*  240  */	        0,0,240,144,144,240,128,128,
/*  241  */	        0,0,240,144,128,144,240,0,
/*  242  */	        0,0,224,64,64,64,64,0,
/*  243  */	        0,0,144,144,240,16,240,0,
/*  244  */	        0,0,248,168,168,248,32,0,
/*  245  */	        0,0,136,80,32,80,136,0,
/*  246  */	        0,0,144,144,144,144,248,8,
/*  247  */	        0,0,144,144,240,16,16,0,
/*  248  */	        0,0,168,168,168,168,248,0,
/*  249  */	        0,0,168,168,168,168,252,4,
/*  250  */	        0,0,192,64,120,72,120,0,
/*  251  */	        0,0,136,136,232,168,232,0,
/*  252  */	        0,0,128,128,240,144,240,0,
/*  253  */	        0,0,240,16,240,16,240,0,
/*  254  */	        0,0,184,168,232,168,184,0,
/*  255  */	        0,0,240,144,112,80,144,0
};
