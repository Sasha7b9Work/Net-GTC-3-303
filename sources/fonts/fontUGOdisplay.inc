const BYTE fontUGOdisplay[3080] = {
/* Orient = 0x00, FontID = 0x00 */ 0x00, 0x00,
/* First character ID */           0x00, 0x00,
/* Last  character ID */           0xff, 0xff,
/* Height */                       0x08, 0x00,

/* Table of characters */

/* 0 */	        0, 8, 4, 0,
/* 1 */	        0, 16, 4, 0,
/* 2 */	        0, 24, 4, 0,
/* 3 */	        0, 32, 4, 0,
/* 4 */	        0, 40, 4, 0,
/* 5 */	        0, 48, 4, 0,
/* 6 */	        0, 56, 4, 0,
/* 7 */	        0, 64, 4, 0,
/* 8 */	        0, 72, 4, 0,
/* 9 */	        0, 80, 4, 0,
/* 10 */	        0, 88, 4, 0,
/* 11 */	        0, 96, 4, 0,
/* 12 */	        0, 104, 4, 0,
/* 13 */	        0, 112, 4, 0,
/* 14 */	        0, 120, 4, 0,
/* 15 */	        0, 128, 4, 0,
/* 16 */	        0, 136, 4, 0,
/* 17 */	        1, 144, 4, 0,
/* 18 */	        2, 152, 4, 0,
/* 19 */	        3, 160, 4, 0,
/* 20 */	        4, 168, 4, 0,
/* 21 */	        5, 176, 4, 0,
/* 22 */	        6, 184, 4, 0,
/* 23 */	        7, 192, 4, 0,
/* 24 */	        8, 200, 4, 0,
/* 25 */	        9, 208, 4, 0,
/* 26 */	        10, 216, 4, 0,
/* 27 */	        11, 224, 4, 0,
/* 28 */	        12, 232, 4, 0,
/* 29 */	        13, 240, 4, 0,
/* 30 */	        14, 248, 4, 0,
/* 31 */	        15, 0, 5, 0,
/* 32 */	        8, 8, 5, 0,
/* 33 */	        8, 16, 5, 0,
/* 34 */	        8, 24, 5, 0,
/* 35 */	        8, 32, 5, 0,
/* 36 */	        8, 40, 5, 0,
/* 37 */	        2, 48, 5, 0,
/* 38 */	        8, 56, 5, 0,
/* 39 */	        8, 64, 5, 0,
/* 40 */	        6, 72, 5, 0,
/* 41 */	        8, 80, 5, 0,
/* 42 */	        8, 88, 5, 0,
/* 43 */	        8, 96, 5, 0,
/* 44 */	        8, 104, 5, 0,
/* 45 */	        8, 112, 5, 0,
/* 46 */	        8, 120, 5, 0,
/* 47 */	        0, 128, 5, 0,
/* 48 */	        8, 136, 5, 0,
/* 49 */	        7, 144, 5, 0,
/* 50 */	        2, 152, 5, 0,
/* 51 */	        8, 160, 5, 0,
/* 52 */	        1, 168, 5, 0,
/* 53 */	        8, 176, 5, 0,
/* 54 */	        8, 184, 5, 0,
/* 55 */	        8, 192, 5, 0,
/* 56 */	        8, 200, 5, 0,
/* 57 */	        8, 208, 5, 0,
/* 58 */	        8, 216, 5, 0,
/* 59 */	        8, 224, 5, 0,
/* 60 */	        8, 232, 5, 0,
/* 61 */	        8, 240, 5, 0,
/* 62 */	        8, 248, 5, 0,
/* 63 */	        0, 0, 6, 0,
/* 64 */	        8, 8, 6, 0,
/* 65 */	        8, 16, 6, 0,
/* 66 */	        8, 24, 6, 0,
/* 67 */	        8, 32, 6, 0,
/* 68 */	        8, 40, 6, 0,
/* 69 */	        6, 48, 6, 0,
/* 70 */	        8, 56, 6, 0,
/* 71 */	        8, 64, 6, 0,
/* 72 */	        8, 72, 6, 0,
/* 73 */	        8, 80, 6, 0,
/* 74 */	        8, 88, 6, 0,
/* 75 */	        8, 96, 6, 0,
/* 76 */	        8, 104, 6, 0,
/* 77 */	        8, 112, 6, 0,
/* 78 */	        8, 120, 6, 0,
/* 79 */	        0, 128, 6, 0,
/* 80 */	        8, 136, 6, 0,
/* 81 */	        7, 144, 6, 0,
/* 82 */	        2, 152, 6, 0,
/* 83 */	        8, 160, 6, 0,
/* 84 */	        1, 168, 6, 0,
/* 85 */	        8, 176, 6, 0,
/* 86 */	        7, 184, 6, 0,
/* 87 */	        2, 192, 6, 0,
/* 88 */	        8, 200, 6, 0,
/* 89 */	        2, 208, 6, 0,
/* 90 */	        8, 216, 6, 0,
/* 91 */	        8, 224, 6, 0,
/* 92 */	        8, 232, 6, 0,
/* 93 */	        8, 240, 6, 0,
/* 94 */	        8, 248, 6, 0,
/* 95 */	        0, 0, 7, 0,
/* 96 */	        7, 8, 7, 0,
/* 97 */	        8, 16, 7, 0,
/* 98 */	        7, 24, 7, 0,
/* 99 */	        8, 32, 7, 0,
/* 100 */	        7, 40, 7, 0,
/* 101 */	        8, 48, 7, 0,
/* 102 */	        8, 56, 7, 0,
/* 103 */	        7, 64, 7, 0,
/* 104 */	        8, 72, 7, 0,
/* 105 */	        7, 80, 7, 0,
/* 106 */	        8, 88, 7, 0,
/* 107 */	        7, 96, 7, 0,
/* 108 */	        8, 104, 7, 0,
/* 109 */	        8, 112, 7, 0,
/* 110 */	        8, 120, 7, 0,
/* 111 */	        0, 128, 7, 0,
/* 112 */	        8, 136, 7, 0,
/* 113 */	        2, 144, 7, 0,
/* 114 */	        8, 152, 7, 0,
/* 115 */	        4, 160, 7, 0,
/* 116 */	        8, 168, 7, 0,
/* 117 */	        8, 176, 7, 0,
/* 118 */	        2, 184, 7, 0,
/* 119 */	        8, 192, 7, 0,
/* 120 */	        4, 200, 7, 0,
/* 121 */	        8, 208, 7, 0,
/* 122 */	        3, 216, 7, 0,
/* 123 */	        8, 224, 7, 0,
/* 124 */	        8, 232, 7, 0,
/* 125 */	        0, 240, 7, 0,
/* 126 */	        0, 248, 7, 0,
/* 127 */	        0, 0, 8, 0,
/* 128 */	        8, 8, 8, 0,
/* 129 */	        8, 16, 8, 0,
/* 130 */	        7, 24, 8, 0,
/* 131 */	        0, 32, 8, 0,
/* 132 */	        0, 40, 8, 0,
/* 133 */	        3, 48, 8, 0,
/* 134 */	        8, 56, 8, 0,
/* 135 */	        3, 64, 8, 0,
/* 136 */	        8, 72, 8, 0,
/* 137 */	        0, 80, 8, 0,
/* 138 */	        7, 88, 8, 0,
/* 139 */	        8, 96, 8, 0,
/* 140 */	        8, 104, 8, 0,
/* 141 */	        8, 112, 8, 0,
/* 142 */	        8, 120, 8, 0,
/* 143 */	        0, 128, 8, 0,
/* 144 */	        7, 136, 8, 0,
/* 145 */	        8, 144, 8, 0,
/* 146 */	        8, 152, 8, 0,
/* 147 */	        8, 160, 8, 0,
/* 148 */	        8, 168, 8, 0,
/* 149 */	        7, 176, 8, 0,
/* 150 */	        8, 184, 8, 0,
/* 151 */	        8, 192, 8, 0,
/* 152 */	        1, 200, 8, 0,
/* 153 */	        8, 208, 8, 0,
/* 154 */	        7, 216, 8, 0,
/* 155 */	        8, 224, 8, 0,
/* 156 */	        8, 232, 8, 0,
/* 157 */	        8, 240, 8, 0,
/* 158 */	        0, 248, 8, 0,
/* 159 */	        0, 0, 9, 0,
/* 160 */	        0, 8, 9, 0,
/* 161 */	        0, 16, 9, 0,
/* 162 */	        4, 24, 9, 0,
/* 163 */	        8, 32, 9, 0,
/* 164 */	        8, 40, 9, 0,
/* 165 */	        8, 48, 9, 0,
/* 166 */	        8, 56, 9, 0,
/* 167 */	        8, 64, 9, 0,
/* 168 */	        0, 72, 9, 0,
/* 169 */	        0, 80, 9, 0,
/* 170 */	        2, 88, 9, 0,
/* 171 */	        8, 96, 9, 0,
/* 172 */	        8, 104, 9, 0,
/* 173 */	        8, 112, 9, 0,
/* 174 */	        0, 120, 9, 0,
/* 175 */	        0, 128, 9, 0,
/* 176 */	        8, 136, 9, 0,
/* 177 */	        8, 144, 9, 0,
/* 178 */	        8, 152, 9, 0,
/* 179 */	        8, 160, 9, 0,
/* 180 */	        0, 168, 9, 0,
/* 181 */	        0, 176, 9, 0,
/* 182 */	        3, 184, 9, 0,
/* 183 */	        8, 192, 9, 0,
/* 184 */	        8, 200, 9, 0,
/* 185 */	        8, 208, 9, 0,
/* 186 */	        8, 216, 9, 0,
/* 187 */	        8, 224, 9, 0,
/* 188 */	        8, 232, 9, 0,
/* 189 */	        8, 240, 9, 0,
/* 190 */	        8, 248, 9, 0,
/* 191 */	        0, 0, 10, 0,
/* 192 */	        8, 8, 10, 0,
/* 193 */	        8, 16, 10, 0,
/* 194 */	        4, 24, 10, 0,
/* 195 */	        8, 32, 10, 0,
/* 196 */	        8, 40, 10, 0,
/* 197 */	        2, 48, 10, 0,
/* 198 */	        8, 56, 10, 0,
/* 199 */	        8, 64, 10, 0,
/* 200 */	        8, 72, 10, 0,
/* 201 */	        8, 80, 10, 0,
/* 202 */	        8, 88, 10, 0,
/* 203 */	        8, 96, 10, 0,
/* 204 */	        4, 104, 10, 0,
/* 205 */	        8, 112, 10, 0,
/* 206 */	        0, 120, 10, 0,
/* 207 */	        0, 128, 10, 0,
/* 208 */	        0, 136, 10, 0,
/* 209 */	        8, 144, 10, 0,
/* 210 */	        8, 152, 10, 0,
/* 211 */	        0, 160, 10, 0,
/* 212 */	        0, 168, 10, 0,
/* 213 */	        8, 176, 10, 0,
/* 214 */	        8, 184, 10, 0,
/* 215 */	        8, 192, 10, 0,
/* 216 */	        8, 200, 10, 0,
/* 217 */	        0, 208, 10, 0,
/* 218 */	        0, 216, 10, 0,
/* 219 */	        8, 224, 10, 0,
/* 220 */	        8, 232, 10, 0,
/* 221 */	        1, 240, 10, 0,
/* 222 */	        8, 248, 10, 0,
/* 223 */	        0, 0, 11, 0,
/* 224 */	        2, 8, 11, 0,
/* 225 */	        6, 16, 11, 0,
/* 226 */	        8, 24, 11, 0,
/* 227 */	        8, 32, 11, 0,
/* 228 */	        8, 40, 11, 0,
/* 229 */	        8, 48, 11, 0,
/* 230 */	        8, 56, 11, 0,
/* 231 */	        8, 64, 11, 0,
/* 232 */	        8, 72, 11, 0,
/* 233 */	        8, 80, 11, 0,
/* 234 */	        0, 88, 11, 0,
/* 235 */	        0, 96, 11, 0,
/* 236 */	        0, 104, 11, 0,
/* 237 */	        0, 112, 11, 0,
/* 238 */	        0, 120, 11, 0,
/* 239 */	        0, 128, 11, 0,
/* 240 */	        8, 136, 11, 0,
/* 241 */	        8, 144, 11, 0,
/* 242 */	        8, 152, 11, 0,
/* 243 */	        8, 160, 11, 0,
/* 244 */	        8, 168, 11, 0,
/* 245 */	        2, 176, 11, 0,
/* 246 */	        8, 184, 11, 0,
/* 247 */	        8, 192, 11, 0,
/* 248 */	        8, 200, 11, 0,
/* 249 */	        8, 208, 11, 0,
/* 250 */	        0, 216, 11, 0,
/* 251 */	        0, 224, 11, 0,
/* 252 */	        0, 232, 11, 0,
/* 253 */	        0, 240, 11, 0,
/* 254 */	        0, 248, 11, 0,
/* 255 */	        0, 0, 12, 0,

/* Map of characters */

/* 0 */	       0,0,0,0,0,0,0,0,
/* 1 */	       0,0,0,0,0,0,0,0,
/* 2 */	       0,0,0,0,0,0,0,0,
/* 3 */	       0,0,0,0,0,0,0,0,
/* 4 */	       0,0,0,0,0,0,0,0,
/* 5 */	       0,0,0,0,0,0,0,0,
/* 6 */	       0,0,0,0,0,0,0,0,
/* 7 */	       0,0,0,0,0,0,0,0,
/* 8 */	       0,0,0,0,0,0,0,0,
/* 9 */	       0,0,0,0,0,0,0,0,
/* 10 */	       0,0,0,0,0,0,0,0,
/* 11 */	       0,0,0,0,0,0,0,0,
/* 12 */	       0,0,0,0,0,0,0,0,
/* 13 */	       0,0,0,0,0,0,0,0,
/* 14 */	       0,0,0,0,0,0,0,0,
/* 15 */	       0,0,0,0,0,0,0,0,
/* 16 */	       0,0,0,0,0,0,0,0,
/* 17 */	       0,0,0,0,0,0,0,0,
/* 18 */	       0,0,0,0,0,0,0,0,
/* 19 */	       0,0,0,0,0,0,0,0,
/* 20 */	       0,0,0,0,0,0,0,0,
/* 21 */	       0,0,0,0,0,0,0,0,
/* 22 */	       0,0,0,0,0,0,0,0,
/* 23 */	       0,0,0,0,0,0,0,0,
/* 24 */	       0,0,0,0,0,0,0,0,
/* 25 */	       0,0,0,0,0,0,0,0,
/* 26 */	       0,0,0,0,0,0,0,0,
/* 27 */	       0,0,0,0,0,0,0,0,
/* 28 */	       0,0,0,0,0,0,0,0,
/* 29 */	       0,0,0,0,0,0,0,0,
/* 30 */	       0,0,0,0,0,0,0,0,
/* 31 */	       0,0,0,0,0,0,0,0,
/* 32 */	       34,112,248,32,32,32,32,35,
/* 33 */	       170,6,11,9,8,8,8,200,
/* 34 */	       170,0,248,140,4,4,4,6,
/* 35 */	       170,3,5,4,4,4,4,4,
/* 36 */	       170,0,252,198,2,2,2,3,
/* 37 */	       0,0,0,0,0,0,0,3,
/* 38 */	       0,6,11,9,8,8,8,200,
/* 39 */	       0,0,248,140,4,4,4,6,
/* 40 */	       0,0,1,1,1,1,1,35,
/* 41 */	       0,192,60,6,2,2,2,2,
/* 42 */	       34,112,248,32,32,32,32,32,
/* 43 */	       170,12,23,16,16,16,16,16,
/* 44 */	       170,0,192,32,32,32,32,48,
/* 45 */	       170,28,55,32,32,32,32,32,
/* 46 */	       170,0,128,96,32,32,32,32,
/* 47 */	       0,0,0,0,0,0,0,0,
/* 48 */	       32,32,32,32,32,32,32,248,
/* 49 */	       104,48,0,0,0,0,0,0,
/* 50 */	       2,1,0,0,0,0,0,0,
/* 51 */	       100,244,24,0,0,0,0,0,
/* 52 */	       1,0,0,0,0,0,0,0,
/* 53 */	       0,0,34,112,248,32,32,248,
/* 54 */	       104,48,170,0,0,0,0,0,
/* 55 */	       3,0,170,0,0,0,0,0,
/* 56 */	       242,28,170,0,0,0,0,0,
/* 57 */	       2,1,170,0,0,0,0,0,
/* 58 */	       32,251,112,34,0,0,0,0,
/* 59 */	       16,176,192,170,0,0,0,0,
/* 60 */	       16,28,7,170,0,0,0,0,
/* 61 */	       32,96,192,170,0,0,0,0,
/* 62 */	       32,39,28,170,0,0,0,0,
/* 63 */	       0,0,0,0,0,0,0,0,
/* 64 */	       0,0,34,112,248,32,32,35,
/* 65 */	       2,6,171,9,8,8,8,200,
/* 66 */	       0,0,250,140,4,4,4,6,
/* 67 */	       1,7,174,4,4,4,4,4,
/* 68 */	       0,0,252,70,2,2,2,3,
/* 69 */	       0,0,0,0,0,0,0,35,
/* 70 */	       2,6,11,9,8,8,8,234,
/* 71 */	       0,0,240,152,8,8,8,175,
/* 72 */	       4,6,11,9,8,8,24,250,
/* 73 */	       0,8,248,168,8,8,8,174,
/* 74 */	       0,0,34,112,248,32,32,32,
/* 75 */	       2,6,173,8,8,8,8,8,
/* 76 */	       0,0,250,4,4,4,4,4,
/* 77 */	       4,7,171,8,8,8,8,8,
/* 78 */	       0,0,250,4,4,4,4,4,
/* 79 */	       0,0,0,0,0,0,0,0,
/* 80 */	       32,32,32,32,32,32,32,248,
/* 81 */	       104,48,0,0,0,0,0,0,
/* 82 */	       2,1,0,0,0,0,0,0,
/* 83 */	       100,244,24,0,0,0,0,0,
/* 84 */	       1,0,0,0,0,0,0,0,
/* 85 */	       112,248,32,32,32,32,32,248,
/* 86 */	       104,48,0,0,0,0,0,0,
/* 87 */	       3,0,0,0,0,0,0,0,
/* 88 */	       144,0,0,0,0,0,0,0,
/* 89 */	       3,0,0,0,0,0,0,0,
/* 90 */	       248,112,35,0,0,0,0,0,
/* 91 */	       8,8,250,48,0,0,0,0,
/* 92 */	       4,4,171,0,0,0,0,0,
/* 93 */	       8,8,250,112,16,0,0,0,
/* 94 */	       4,4,171,0,0,0,0,0,
/* 95 */	       0,0,0,0,0,0,0,0,
/* 96 */	       0,0,1,1,2,7,34,112,
/* 97 */	       96,144,8,8,4,85,4,2,
/* 98 */	       1,2,4,4,8,93,8,16,
/* 99 */	       128,64,32,32,16,85,16,8,
/* 100 */	       6,9,16,16,32,117,32,64,
/* 101 */	       0,0,37,113,250,34,34,32,
/* 102 */	       96,144,93,8,4,4,4,2,
/* 103 */	       1,2,85,4,8,8,8,16,
/* 104 */	       128,64,117,32,16,16,16,8,
/* 105 */	       6,9,85,16,32,32,32,64,
/* 106 */	       37,112,248,32,248,112,37,0,
/* 107 */	       85,0,0,0,0,0,85,0,
/* 108 */	       85,160,160,164,170,170,170,170,
/* 109 */	       85,0,0,0,0,0,255,128,
/* 110 */	       85,0,0,0,0,0,255,0,
/* 111 */	       0,0,0,0,0,0,0,0,
/* 112 */	       248,32,32,32,32,32,32,248,
/* 113 */	       2,1,0,0,0,0,0,0,
/* 114 */	       16,32,192,0,0,0,0,0,
/* 115 */	       8,4,3,0,0,0,0,0,
/* 116 */	       64,128,0,0,0,0,0,0,
/* 117 */	       32,32,32,32,32,32,32,248,
/* 118 */	       2,1,0,0,0,0,0,0,
/* 119 */	       16,32,192,0,0,0,0,0,
/* 120 */	       8,4,3,0,0,0,0,0,
/* 121 */	       64,128,0,0,0,0,0,0,
/* 122 */	       0,0,0,0,7,0,0,0,
/* 123 */	       0,0,0,0,254,1,0,0,
/* 124 */	       169,168,144,128,128,0,0,0,
/* 125 */	       0,0,0,0,0,0,0,0,
/* 126 */	       0,0,0,0,0,0,0,0,
/* 127 */	       0,0,0,0,0,0,0,0,
/* 128 */	       0,0,255,0,0,0,0,0,
/* 129 */	       0,0,255,1,1,1,1,1,
/* 130 */	       0,0,0,0,0,0,32,82,
/* 131 */	       0,0,0,0,0,0,0,0,
/* 132 */	       0,0,0,0,0,0,0,0,
/* 133 */	       1,1,1,1,7,1,1,1,
/* 134 */	       255,1,1,1,193,1,1,1,
/* 135 */	       1,1,1,1,7,1,1,1,
/* 136 */	       255,1,1,1,193,1,1,1,
/* 137 */	       0,0,0,0,0,0,0,0,
/* 138 */	       127,1,1,1,7,1,97,33,
/* 139 */	       1,1,1,1,193,1,1,1,
/* 140 */	       255,1,1,1,7,1,1,1,
/* 141 */	       1,1,1,1,193,1,1,1,
/* 142 */	       255,0,0,0,0,0,0,0,
/* 143 */	       0,0,0,0,0,0,0,0,
/* 144 */	       21,56,124,0,124,56,18,0,
/* 145 */	       85,1,1,1,1,1,170,0,
/* 146 */	       85,84,84,84,72,64,128,0,
/* 147 */	       255,0,0,0,0,0,0,0,
/* 148 */	       255,0,0,0,0,0,0,0,
/* 149 */	       127,0,0,0,1,0,0,0,
/* 150 */	       1,0,64,192,255,192,64,0,
/* 151 */	       255,0,4,6,255,6,4,0,
/* 152 */	       1,0,0,0,0,0,0,0,
/* 153 */	       255,0,0,0,0,0,0,0,
/* 154 */	       33,32,114,4,9,16,32,0,
/* 155 */	       255,0,64,192,255,192,64,0,
/* 156 */	       1,0,4,6,255,6,4,0,
/* 157 */	       255,0,0,0,0,0,0,0,
/* 158 */	       0,0,0,0,0,0,0,0,
/* 159 */	       0,0,0,0,0,0,0,0,
/* 160 */	       0,0,0,0,0,0,0,0,
/* 161 */	       0,0,0,0,0,0,0,0,
/* 162 */	       0,0,1,0,1,2,4,8,
/* 163 */	       31,32,240,128,0,0,0,0,
/* 164 */	       255,0,0,0,0,0,0,0,
/* 165 */	       255,0,0,0,0,0,0,0,
/* 166 */	       252,2,7,0,0,0,0,0,
/* 167 */	       0,0,192,128,64,32,16,8,
/* 168 */	       0,0,0,0,0,0,0,0,
/* 169 */	       0,0,0,0,0,0,0,0,
/* 170 */	       0,0,0,0,3,0,0,0,
/* 171 */	       255,128,128,128,224,128,128,128,
/* 172 */	       254,2,2,2,15,2,2,2,
/* 173 */	       0,0,0,0,128,0,0,0,
/* 174 */	       0,0,0,0,0,0,0,0,
/* 175 */	       0,0,0,0,0,0,0,0,
/* 176 */	       0,0,0,0,255,0,0,0,
/* 177 */	       0,0,1,0,255,0,0,0,
/* 178 */	       17,35,247,131,1,0,0,0,
/* 179 */	       64,96,240,96,64,0,0,0,
/* 180 */	       0,0,0,0,0,0,0,0,
/* 181 */	       0,0,0,0,0,0,0,0,
/* 182 */	       1,3,7,3,1,0,0,0,
/* 183 */	       68,98,247,96,64,0,0,0,
/* 184 */	       0,0,192,128,127,0,0,0,
/* 185 */	       0,0,0,0,255,0,0,0,
/* 186 */	       255,0,0,0,0,0,0,0,
/* 187 */	       128,0,32,96,255,96,32,0,
/* 188 */	       3,0,8,12,254,12,8,0,
/* 189 */	       255,0,0,0,0,0,0,0,
/* 190 */	       255,0,0,0,0,0,0,0,
/* 191 */	       0,0,0,0,0,0,0,0,
/* 192 */	       255,0,0,0,3,0,0,0,
/* 193 */	       128,128,128,128,224,128,128,128,
/* 194 */	       3,2,2,2,15,2,2,2,
/* 195 */	       255,0,0,0,128,0,0,0,
/* 196 */	       255,0,0,0,0,0,0,0,
/* 197 */	       0,0,0,0,3,0,0,0,
/* 198 */	       255,128,128,128,224,128,128,128,
/* 199 */	       254,2,2,2,15,2,2,2,
/* 200 */	       1,1,1,1,129,1,1,1,
/* 201 */	       255,0,0,0,0,0,0,0,
/* 202 */	       255,0,0,0,3,0,0,0,
/* 203 */	       128,128,128,128,224,128,128,128,
/* 204 */	       3,2,2,2,15,2,2,2,
/* 205 */	       255,1,1,1,129,1,1,1,
/* 206 */	       0,0,0,0,0,0,0,0,
/* 207 */	       0,0,0,0,0,0,0,0,
/* 208 */	       0,0,0,0,0,0,0,0,
/* 209 */	       255,0,32,96,255,96,32,0,
/* 210 */	       254,0,8,12,254,12,8,0,
/* 211 */	       0,0,0,0,0,0,0,0,
/* 212 */	       0,0,0,0,0,0,0,0,
/* 213 */	       255,0,0,0,0,0,0,0,
/* 214 */	       128,0,32,96,255,96,32,0,
/* 215 */	       3,0,8,12,254,12,8,0,
/* 216 */	       255,0,0,0,0,0,0,0,
/* 217 */	       0,0,0,0,0,0,0,0,
/* 218 */	       0,0,0,0,0,0,0,0,
/* 219 */	       255,0,32,96,255,96,32,0,
/* 220 */	       254,0,8,12,254,12,8,0,
/* 221 */	       1,0,0,0,0,0,0,0,
/* 222 */	       255,0,0,0,0,0,0,0,
/* 223 */	       0,0,0,0,0,0,0,0,
/* 224 */	       0,0,0,0,3,1,1,1,
/* 225 */	       63,32,32,32,34,38,47,38,
/* 226 */	       255,0,0,0,0,0,255,0,
/* 227 */	       255,0,7,4,69,100,245,101,
/* 228 */	       255,0,255,0,192,64,192,0,
/* 229 */	       255,0,255,0,3,1,1,1,
/* 230 */	       255,0,224,32,34,38,47,38,
/* 231 */	       255,0,0,0,0,0,255,0,
/* 232 */	       252,4,4,4,69,100,245,101,
/* 233 */	       0,0,0,0,192,64,192,0,
/* 234 */	       0,0,0,0,0,0,0,0,
/* 235 */	       0,0,0,0,0,0,0,0,
/* 236 */	       0,0,0,0,0,0,0,0,
/* 237 */	       0,0,0,0,0,0,0,0,
/* 238 */	       0,0,0,0,0,0,0,0,
/* 239 */	       0,0,0,0,0,0,0,0,
/* 240 */	       3,0,255,0,255,0,0,0,
/* 241 */	       162,32,224,0,255,0,0,0,
/* 242 */	       0,0,0,0,255,0,0,0,
/* 243 */	       69,4,4,4,252,0,0,0,
/* 244 */	       192,0,0,0,0,0,0,0,
/* 245 */	       3,0,0,0,0,0,0,0,
/* 246 */	       162,32,32,32,63,0,0,0,
/* 247 */	       0,0,0,0,255,0,0,0,
/* 248 */	       69,4,7,0,255,0,0,0,
/* 249 */	       192,0,255,0,255,0,0,0,
/* 250 */	       0,0,0,0,0,0,0,0,
/* 251 */	       0,0,0,0,0,0,0,0,
/* 252 */	       0,0,0,0,0,0,0,0,
/* 253 */	       0,0,0,0,0,0,0,0,
/* 254 */	       0,0,0,0,0,0,0,0,
/* 255 */	       0,0,0,0,0,0,0,0
};
