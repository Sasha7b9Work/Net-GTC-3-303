const BYTE font5display[3080] = {
/* Orient = 0x00, FontID = 0x00 */ 0x00, 0x00,
/* First character ID */           0x00, 0x00,
/* Last  character ID */           0xff, 0xff,
/* Height */                       0x05, 0x00,

/* Table of characters */

/* 0 */	    0, 8, 4, 0,
/* 1 */	    0, 16, 4, 0,
/* 2 */	    0, 24, 4, 0,
/* 3 */	    0, 32, 4, 0,
/* 4 */	    0, 40, 4, 0,
/* 5 */	    0, 48, 4, 0,
/* 6 */	    0, 56, 4, 0,
/* 7 */	    0, 64, 4, 0,
/* 8 */	    0, 72, 4, 0,
/* 9 */	    0, 80, 4, 0,
/* 10 */	    0, 88, 4, 0,
/* 11 */	    0, 96, 4, 0,
/* 12 */	    0, 104, 4, 0,
/* 13 */	    0, 112, 4, 0,
/* 14 */	    0, 120, 4, 0,
/* 15 */	    0, 128, 4, 0,
/* 16 */	    0, 136, 4, 0,
/* 17 */	    1, 144, 4, 0,
/* 18 */	    2, 152, 4, 0,
/* 19 */	    3, 160, 4, 0,
/* 20 */	    4, 168, 4, 0,
/* 21 */	    5, 176, 4, 0,
/* 22 */	    6, 184, 4, 0,
/* 23 */	    7, 192, 4, 0,
/* 24 */	    8, 200, 4, 0,
/* 25 */	    9, 208, 4, 0,
/* 26 */	    10, 216, 4, 0,
/* 27 */	    11, 224, 4, 0,
/* 28 */	    12, 232, 4, 0,
/* 29 */	    13, 240, 4, 0,
/* 30 */	    14, 248, 4, 0,
/* 31 */	    15, 0, 5, 0,
/* 32 */	    1, 8, 5, 0,
/* 33 */	    8, 16, 5, 0,
/* 34 */	    8, 24, 5, 0,
/* 35 */	    8, 32, 5, 0,
/* 36 */	    8, 40, 5, 0,
/* 37 */	    8, 48, 5, 0,
/* 38 */	    8, 56, 5, 0,
/* 39 */	    7, 64, 5, 0,
/* 40 */	    8, 72, 5, 0,
/* 41 */	    8, 80, 5, 0,
/* 42 */	    8, 88, 5, 0,
/* 43 */	    8, 96, 5, 0,
/* 44 */	    8, 104, 5, 0,
/* 45 */	    8, 112, 5, 0,
/* 46 */	    8, 120, 5, 0,
/* 47 */	    8, 128, 5, 0,
/* 48 */	    8, 136, 5, 0,
/* 49 */	    8, 144, 5, 0,
/* 50 */	    8, 152, 5, 0,
/* 51 */	    8, 160, 5, 0,
/* 52 */	    8, 168, 5, 0,
/* 53 */	    8, 176, 5, 0,
/* 54 */	    8, 184, 5, 0,
/* 55 */	    8, 192, 5, 0,
/* 56 */	    8, 200, 5, 0,
/* 57 */	    8, 208, 5, 0,
/* 58 */	    8, 216, 5, 0,
/* 59 */	    7, 224, 5, 0,
/* 60 */	    8, 232, 5, 0,
/* 61 */	    8, 240, 5, 0,
/* 62 */	    8, 248, 5, 0,
/* 63 */	    8, 0, 6, 0,
/* 64 */	    8, 8, 6, 0,
/* 65 */	    8, 16, 6, 0,
/* 66 */	    8, 24, 6, 0,
/* 67 */	    8, 32, 6, 0,
/* 68 */	    8, 40, 6, 0,
/* 69 */	    8, 48, 6, 0,
/* 70 */	    8, 56, 6, 0,
/* 71 */	    8, 64, 6, 0,
/* 72 */	    8, 72, 6, 0,
/* 73 */	    8, 80, 6, 0,
/* 74 */	    8, 88, 6, 0,
/* 75 */	    8, 96, 6, 0,
/* 76 */	    8, 104, 6, 0,
/* 77 */	    8, 112, 6, 0,
/* 78 */	    8, 120, 6, 0,
/* 79 */	    8, 128, 6, 0,
/* 80 */	    8, 136, 6, 0,
/* 81 */	    8, 144, 6, 0,
/* 82 */	    8, 152, 6, 0,
/* 83 */	    8, 160, 6, 0,
/* 84 */	    8, 168, 6, 0,
/* 85 */	    8, 176, 6, 0,
/* 86 */	    8, 184, 6, 0,
/* 87 */	    8, 192, 6, 0,
/* 88 */	    8, 200, 6, 0,
/* 89 */	    8, 208, 6, 0,
/* 90 */	    8, 216, 6, 0,
/* 91 */	    8, 224, 6, 0,
/* 92 */	    8, 232, 6, 0,
/* 93 */	    8, 240, 6, 0,
/* 94 */	    8, 248, 6, 0,
/* 95 */	    8, 0, 7, 0,
/* 96 */	    8, 8, 7, 0,
/* 97 */	    8, 16, 7, 0,
/* 98 */	    8, 24, 7, 0,
/* 99 */	    8, 32, 7, 0,
/* 100 */	    8, 40, 7, 0,
/* 101 */	    8, 48, 7, 0,
/* 102 */	    8, 56, 7, 0,
/* 103 */	    8, 64, 7, 0,
/* 104 */	    8, 72, 7, 0,
/* 105 */	    8, 80, 7, 0,
/* 106 */	    8, 88, 7, 0,
/* 107 */	    8, 96, 7, 0,
/* 108 */	    8, 104, 7, 0,
/* 109 */	    8, 112, 7, 0,
/* 110 */	    8, 120, 7, 0,
/* 111 */	    8, 128, 7, 0,
/* 112 */	    8, 136, 7, 0,
/* 113 */	    8, 144, 7, 0,
/* 114 */	    8, 152, 7, 0,
/* 115 */	    8, 160, 7, 0,
/* 116 */	    8, 168, 7, 0,
/* 117 */	    8, 176, 7, 0,
/* 118 */	    8, 184, 7, 0,
/* 119 */	    8, 192, 7, 0,
/* 120 */	    8, 200, 7, 0,
/* 121 */	    8, 208, 7, 0,
/* 122 */	    8, 216, 7, 0,
/* 123 */	    8, 224, 7, 0,
/* 124 */	    6, 232, 7, 0,
/* 125 */	    8, 240, 7, 0,
/* 126 */	    7, 248, 7, 0,
/* 127 */	    0, 0, 8, 0,
/* 128 */	    0, 8, 8, 0,
/* 129 */	    0, 16, 8, 0,
/* 130 */	    0, 24, 8, 0,
/* 131 */	    0, 32, 8, 0,
/* 132 */	    0, 40, 8, 0,
/* 133 */	    0, 48, 8, 0,
/* 134 */	    0, 56, 8, 0,
/* 135 */	    0, 64, 8, 0,
/* 136 */	    8, 72, 8, 0,
/* 137 */	    8, 80, 8, 0,
/* 138 */	    0, 88, 8, 0,
/* 139 */	    0, 96, 8, 0,
/* 140 */	    0, 104, 8, 0,
/* 141 */	    0, 112, 8, 0,
/* 142 */	    0, 120, 8, 0,
/* 143 */	    0, 128, 8, 0,
/* 144 */	    8, 136, 8, 0,
/* 145 */	    8, 144, 8, 0,
/* 146 */	    8, 152, 8, 0,
/* 147 */	    8, 160, 8, 0,
/* 148 */	    0, 168, 8, 0,
/* 149 */	    0, 176, 8, 0,
/* 150 */	    0, 184, 8, 0,
/* 151 */	    0, 192, 8, 0,
/* 152 */	    0, 200, 8, 0,
/* 153 */	    0, 208, 8, 0,
/* 154 */	    0, 216, 8, 0,
/* 155 */	    0, 224, 8, 0,
/* 156 */	    0, 232, 8, 0,
/* 157 */	    0, 240, 8, 0,
/* 158 */	    0, 248, 8, 0,
/* 159 */	    0, 0, 9, 0,
/* 160 */	    8, 8, 9, 0,
/* 161 */	    8, 16, 9, 0,
/* 162 */	    8, 24, 9, 0,
/* 163 */	    8, 32, 9, 0,
/* 164 */	    8, 40, 9, 0,
/* 165 */	    8, 48, 9, 0,
/* 166 */	    8, 56, 9, 0,
/* 167 */	    8, 64, 9, 0,
/* 168 */	    8, 72, 9, 0,
/* 169 */	    8, 80, 9, 0,
/* 170 */	    0, 88, 9, 0,
/* 171 */	    0, 96, 9, 0,
/* 172 */	    0, 104, 9, 0,
/* 173 */	    0, 112, 9, 0,
/* 174 */	    0, 120, 9, 0,
/* 175 */	    0, 128, 9, 0,
/* 176 */	    8, 136, 9, 0,
/* 177 */	    8, 144, 9, 0,
/* 178 */	    8, 152, 9, 0,
/* 179 */	    8, 160, 9, 0,
/* 180 */	    8, 168, 9, 0,
/* 181 */	    8, 176, 9, 0,
/* 182 */	    8, 184, 9, 0,
/* 183 */	    0, 192, 9, 0,
/* 184 */	    0, 200, 9, 0,
/* 185 */	    0, 208, 9, 0,
/* 186 */	    0, 216, 9, 0,
/* 187 */	    0, 224, 9, 0,
/* 188 */	    0, 232, 9, 0,
/* 189 */	    0, 240, 9, 0,
/* 190 */	    0, 248, 9, 0,
/* 191 */	    0, 0, 10, 0,
/* 192 */	    8, 8, 10, 0,
/* 193 */	    8, 16, 10, 0,
/* 194 */	    8, 24, 10, 0,
/* 195 */	    8, 32, 10, 0,
/* 196 */	    8, 40, 10, 0,
/* 197 */	    8, 48, 10, 0,
/* 198 */	    8, 56, 10, 0,
/* 199 */	    8, 64, 10, 0,
/* 200 */	    8, 72, 10, 0,
/* 201 */	    8, 80, 10, 0,
/* 202 */	    8, 88, 10, 0,
/* 203 */	    8, 96, 10, 0,
/* 204 */	    8, 104, 10, 0,
/* 205 */	    8, 112, 10, 0,
/* 206 */	    8, 120, 10, 0,
/* 207 */	    8, 128, 10, 0,
/* 208 */	    8, 136, 10, 0,
/* 209 */	    8, 144, 10, 0,
/* 210 */	    8, 152, 10, 0,
/* 211 */	    8, 160, 10, 0,
/* 212 */	    8, 168, 10, 0,
/* 213 */	    8, 176, 10, 0,
/* 214 */	    8, 184, 10, 0,
/* 215 */	    8, 192, 10, 0,
/* 216 */	    8, 200, 10, 0,
/* 217 */	    8, 208, 10, 0,
/* 218 */	    8, 216, 10, 0,
/* 219 */	    8, 224, 10, 0,
/* 220 */	    8, 232, 10, 0,
/* 221 */	    8, 240, 10, 0,
/* 222 */	    8, 248, 10, 0,
/* 223 */	    8, 0, 11, 0,
/* 224 */	    8, 8, 11, 0,
/* 225 */	    8, 16, 11, 0,
/* 226 */	    8, 24, 11, 0,
/* 227 */	    8, 32, 11, 0,
/* 228 */	    8, 40, 11, 0,
/* 229 */	    8, 48, 11, 0,
/* 230 */	    8, 56, 11, 0,
/* 231 */	    8, 64, 11, 0,
/* 232 */	    8, 72, 11, 0,
/* 233 */	    8, 80, 11, 0,
/* 234 */	    8, 88, 11, 0,
/* 235 */	    8, 96, 11, 0,
/* 236 */	    8, 104, 11, 0,
/* 237 */	    8, 112, 11, 0,
/* 238 */	    8, 120, 11, 0,
/* 239 */	    8, 128, 11, 0,
/* 240 */	    8, 136, 11, 0,
/* 241 */	    8, 144, 11, 0,
/* 242 */	    8, 152, 11, 0,
/* 243 */	    8, 160, 11, 0,
/* 244 */	    8, 168, 11, 0,
/* 245 */	    8, 176, 11, 0,
/* 246 */	    8, 184, 11, 0,
/* 247 */	    8, 192, 11, 0,
/* 248 */	    8, 200, 11, 0,
/* 249 */	    8, 208, 11, 0,
/* 250 */	    8, 216, 11, 0,
/* 251 */	    8, 224, 11, 0,
/* 252 */	    8, 232, 11, 0,
/* 253 */	    8, 240, 11, 0,
/* 254 */	    8, 248, 11, 0,
/* 255 */	    8, 0, 12, 0,

/* Map of characters */

/* 0 */	        0,0,0,0,0,0,0,0,
/* 1 */	        0,0,0,0,0,0,0,0,
/* 2 */	        0,0,0,0,0,0,0,0,
/* 3 */	        0,0,0,0,0,0,0,0,
/* 4 */	        0,0,0,0,0,0,0,0,
/* 5 */	        0,0,0,0,0,0,0,0,
/* 6 */	        0,0,0,0,0,0,0,0,
/* 7 */	        0,0,0,0,0,0,0,0,
/* 8 */	        0,0,0,0,0,0,0,0,
/* 9 */	        0,0,0,0,0,0,0,0,
/* 10 */	        0,0,0,0,0,0,0,0,
/* 11 */	        0,0,0,0,0,0,0,0,
/* 12 */	        0,0,0,0,0,0,0,0,
/* 13 */	        0,0,0,0,0,0,0,0,
/* 14 */	        0,0,0,0,0,0,0,0,
/* 15 */	        0,0,0,0,0,0,0,0,
/* 16 */	        0,0,0,0,0,0,0,0,
/* 17 */	        0,0,0,0,0,0,0,0,
/* 18 */	        0,0,0,0,0,0,0,0,
/* 19 */	        0,0,0,0,0,0,0,0,
/* 20 */	        0,0,0,0,0,0,0,0,
/* 21 */	        0,0,0,0,0,0,0,0,
/* 22 */	        0,0,0,0,0,0,0,0,
/* 23 */	        0,0,0,0,0,0,0,0,
/* 24 */	        0,0,0,0,0,0,0,0,
/* 25 */	        0,0,0,0,0,0,0,0,
/* 26 */	        0,0,0,0,0,0,0,0,
/* 27 */	        0,0,0,0,0,0,0,0,
/* 28 */	        0,0,0,0,0,0,0,0,
/* 29 */	        0,0,0,0,0,0,0,0,
/* 30 */	        0,0,0,0,0,0,0,0,
/* 31 */	        0,0,0,0,0,0,0,0,
/* 32 */	        0,0,0,0,0,0,0,0,
/* 33 */	        128,128,128,0,128,0,0,0,
/* 34 */	        0,0,0,0,128,0,0,0,
/* 35 */	        0,80,248,80,80,248,80,0,
/* 36 */	        0,32,248,160,248,40,248,32,
/* 37 */	        144,32,96,64,144,0,0,0,
/* 38 */	        0,32,80,32,88,144,104,0,
/* 39 */	        0,32,64,0,0,0,0,0,
/* 40 */	        64,128,128,128,64,0,0,0,
/* 41 */	        128,64,64,64,128,0,0,0,
/* 42 */	        0,0,80,32,248,32,80,0,
/* 43 */	        0,64,224,64,0,0,0,0,
/* 44 */	        0,0,0,64,128,0,0,0,
/* 45 */	        0,0,224,0,0,0,0,0,
/* 46 */	        0,0,0,0,128,0,0,0,
/* 47 */	        0,64,64,128,128,0,0,0,
/* 48 */	        224,160,160,160,224,0,0,0,
/* 49 */	        192,64,64,64,224,0,0,0,
/* 50 */	        224,32,224,128,224,0,0,0,
/* 51 */	        224,32,224,32,224,0,0,0,
/* 52 */	        160,160,224,32,32,0,0,0,
/* 53 */	        224,128,224,32,224,0,0,0,
/* 54 */	        224,128,224,160,224,0,0,0,
/* 55 */	        224,32,64,128,128,0,0,0,
/* 56 */	        224,160,224,160,224,0,0,0,
/* 57 */	        224,160,224,32,224,0,0,0,
/* 58 */	        128,0,0,0,128,0,0,0,
/* 59 */	        0,0,32,0,0,32,32,64,
/* 60 */	        160,160,0,0,0,0,0,0,
/* 61 */	        0,192,0,192,0,0,0,0,
/* 62 */	        128,64,32,64,128,0,0,0,
/* 63 */	        0,112,136,16,32,0,32,0,
/* 64 */	        0,112,152,168,176,128,112,0,
/* 65 */	        224,160,224,160,160,0,0,0,
/* 66 */	        224,160,192,160,224,0,0,0,
/* 67 */	        224,128,128,128,224,0,0,0,
/* 68 */	        192,160,160,160,192,0,0,0,
/* 69 */	        224,128,224,128,224,0,0,0,
/* 70 */	        224,128,224,128,128,0,0,0,
/* 71 */	        224,128,128,160,224,0,0,0,
/* 72 */	        160,160,224,160,160,0,0,0,
/* 73 */	        224,64,64,64,224,0,0,0,
/* 74 */	        32,32,32,160,224,0,0,0,
/* 75 */	        160,192,128,192,160,0,0,0,
/* 76 */	        128,128,128,128,224,0,0,0,
/* 77 */	        136,216,168,136,136,0,0,0,
/* 78 */	        144,208,176,144,144,0,0,0,
/* 79 */	        224,160,160,160,224,0,0,0,
/* 80 */	        224,160,224,128,128,0,0,0,
/* 81 */	        224,160,160,176,224,0,0,0,
/* 82 */	        224,160,224,192,160,0,0,0,
/* 83 */	        224,128,224,32,224,0,0,0,
/* 84 */	        224,64,64,64,64,0,0,0,
/* 85 */	        160,160,160,160,224,0,0,0,
/* 86 */	        160,160,160,224,64,0,0,0,
/* 87 */	        136,136,136,168,80,0,0,0,
/* 88 */	        144,96,64,96,144,0,0,0,
/* 89 */	        160,160,160,64,64,0,0,0,
/* 90 */	        240,16,32,64,240,0,0,0,
/* 91 */	        192,128,128,128,192,0,0,0,
/* 92 */	        0,0,128,64,32,16,8,0,
/* 93 */	        192,64,64,64,192,0,0,0,
/* 94 */	        0,32,112,168,32,32,32,0,
/* 95 */	        0,0,0,0,224,0,0,0,
/* 96 */	        0,48,72,224,64,64,248,0,
/* 97 */	        224,160,224,160,160,0,0,0,
/* 98 */	        224,160,192,160,224,0,0,0,
/* 99 */	        224,128,128,128,224,0,0,0,
/* 100 */	        192,160,160,160,192,0,0,0,
/* 101 */	        224,128,224,128,224,0,0,0,
/* 102 */	        224,128,192,128,128,0,0,0,
/* 103 */	        224,128,128,160,224,0,0,0,
/* 104 */	        160,160,224,160,160,0,0,0,
/* 105 */	        224,64,64,64,224,0,0,0,
/* 106 */	        32,32,32,160,224,0,0,0,
/* 107 */	        160,192,128,192,160,0,0,0,
/* 108 */	        128,128,128,128,224,0,0,0,
/* 109 */	        136,216,168,136,136,0,0,0,
/* 110 */	        144,208,176,144,144,0,0,0,
/* 111 */	        224,160,160,160,224,0,0,0,
/* 112 */	        224,160,224,128,128,0,0,0,
/* 113 */	        224,160,160,176,224,0,0,0,
/* 114 */	        224,160,224,192,160,0,0,0,
/* 115 */	        224,128,224,32,224,0,0,0,
/* 116 */	        224,64,64,64,64,0,0,0,
/* 117 */	        160,160,160,160,224,0,0,0,
/* 118 */	        160,160,160,160,64,0,0,0,
/* 119 */	        136,136,136,168,80,0,0,0,
/* 120 */	        136,80,32,80,136,0,0,0,
/* 121 */	        160,160,224,64,64,0,0,0,
/* 122 */	        240,16,32,64,240,0,0,0,
/* 123 */	        0,56,32,192,32,32,56,0,
/* 124 */	        0,32,32,32,32,32,32,0,
/* 125 */	        0,224,32,24,32,32,224,0,
/* 126 */	        0,40,80,0,0,0,0,0,
/* 127 */	        0,0,0,0,0,0,0,0,
/* 128 */	        0,0,0,0,0,0,0,0,
/* 129 */	        0,0,0,0,0,0,0,0,
/* 130 */	        0,0,0,0,0,0,0,0,
/* 131 */	        0,0,0,0,0,0,0,0,
/* 132 */	        0,0,0,0,0,0,0,0,
/* 133 */	        0,0,0,0,0,0,0,0,
/* 134 */	        0,0,0,0,0,0,0,0,
/* 135 */	        0,0,0,0,0,0,0,0,
/* 136 */	        0,0,0,252,0,0,0,0,
/* 137 */	        252,0,252,0,0,0,0,0,
/* 138 */	        0,0,0,0,0,0,0,0,
/* 139 */	        0,0,0,0,0,0,0,0,
/* 140 */	        0,0,0,0,0,0,0,0,
/* 141 */	        0,0,0,0,0,0,0,0,
/* 142 */	        0,0,0,0,0,0,0,0,
/* 143 */	        0,0,0,0,0,0,0,0,
/* 144 */	        0,16,16,16,16,254,0,0,
/* 145 */	        0,0,96,146,12,0,0,0,
/* 146 */	        0,0,254,0,214,0,0,0,
/* 147 */	        0,0,192,0,0,0,0,0,
/* 148 */	        0,0,0,0,0,0,0,0,
/* 149 */	        0,0,0,0,0,0,0,0,
/* 150 */	        0,0,0,0,0,0,0,0,
/* 151 */	        0,0,0,0,0,0,0,0,
/* 152 */	        0,0,0,0,0,0,0,0,
/* 153 */	        0,0,0,0,0,0,0,0,
/* 154 */	        0,0,0,0,0,0,0,0,
/* 155 */	        0,0,0,0,0,0,0,0,
/* 156 */	        0,0,0,0,0,0,0,0,
/* 157 */	        0,0,0,0,0,0,0,0,
/* 158 */	        0,0,0,0,0,0,0,0,
/* 159 */	        0,0,0,0,0,0,0,0,
/* 160 */	        0,224,224,128,224,0,0,0,
/* 161 */	        24,36,66,129,0,0,0,0,
/* 162 */	        0,0,0,0,129,66,36,24,
/* 163 */	        24,60,126,255,0,0,0,0,
/* 164 */	        0,0,0,0,255,126,60,24,
/* 165 */	        128,0,0,0,128,0,0,0,
/* 166 */	        224,32,112,32,56,0,0,0,
/* 167 */	        56,32,112,32,224,0,0,0,
/* 168 */	        128,0,0,0,128,0,0,0,
/* 169 */	        240,132,140,159,140,132,240,0,
/* 170 */	        0,0,0,0,0,0,0,0,
/* 171 */	        0,0,0,0,0,0,0,0,
/* 172 */	        0,0,0,0,0,0,0,0,
/* 173 */	        0,0,0,0,0,0,0,0,
/* 174 */	        0,0,0,0,0,0,0,0,
/* 175 */	        0,0,0,0,0,0,0,0,
/* 176 */	        0,224,224,128,224,0,0,0,
/* 177 */	        0,0,0,0,0,0,255,0,
/* 178 */	        124,130,130,130,130,130,1,0,
/* 179 */	        62,65,65,65,65,65,128,0,
/* 180 */	        0,0,0,0,0,0,255,0,
/* 181 */	        63,64,64,64,64,64,128,0,
/* 182 */	        252,2,2,2,2,2,1,0,
/* 183 */	        0,0,0,0,0,0,0,0,
/* 184 */	        0,0,0,0,0,0,0,0,
/* 185 */	        0,0,0,0,0,0,0,0,
/* 186 */	        0,0,0,0,0,0,0,0,
/* 187 */	        0,0,0,0,0,0,0,0,
/* 188 */	        0,0,0,0,0,0,0,0,
/* 189 */	        0,0,0,0,0,0,0,0,
/* 190 */	        0,0,0,0,0,0,0,0,
/* 191 */	        0,0,0,0,0,0,0,0,
/* 192 */	        224,160,224,160,160,0,0,0,
/* 193 */	        224,128,224,160,224,0,0,0,
/* 194 */	        224,160,192,160,224,0,0,0,
/* 195 */	        224,128,128,128,128,0,0,0,
/* 196 */	        112,80,80,248,136,0,0,0,
/* 197 */	        224,128,224,128,224,0,0,0,
/* 198 */	        144,96,240,96,144,0,0,0,
/* 199 */	        224,32,64,32,224,0,0,0,
/* 200 */	        144,176,208,144,144,0,0,0,
/* 201 */	        144,176,208,144,144,0,0,0,
/* 202 */	        160,192,128,192,160,0,0,0,
/* 203 */	        96,160,160,160,160,0,0,0,
/* 204 */	        136,216,168,136,136,0,0,0,
/* 205 */	        160,160,224,160,160,0,0,0,
/* 206 */	        224,160,160,160,224,0,0,0,
/* 207 */	        224,160,160,160,160,0,0,0,
/* 208 */	        224,160,224,128,128,0,0,0,
/* 209 */	        224,128,128,128,224,0,0,0,
/* 210 */	        224,64,64,64,64,0,0,0,
/* 211 */	        160,160,224,32,224,0,0,0,
/* 212 */	        248,168,168,248,32,0,0,0,
/* 213 */	        144,96,96,96,144,0,0,0,
/* 214 */	        160,160,160,160,240,0,0,0,
/* 215 */	        160,160,224,32,32,0,0,0,
/* 216 */	        168,168,168,168,248,0,0,0,
/* 217 */	        168,168,168,168,252,0,0,0,
/* 218 */	        192,64,112,80,112,0,0,0,
/* 219 */	        136,136,232,168,232,0,0,0,
/* 220 */	        128,128,224,160,224,0,0,0,
/* 221 */	        224,32,224,32,224,0,0,0,
/* 222 */	        184,168,232,168,184,0,0,0,
/* 223 */	        240,144,240,80,144,0,0,0,
/* 224 */	        224,160,224,160,160,0,0,0,
/* 225 */	        224,128,224,160,224,0,0,0,
/* 226 */	        224,160,192,160,224,0,0,0,
/* 227 */	        224,128,128,128,128,0,0,0,
/* 228 */	        112,80,80,248,136,0,0,0,
/* 229 */	        224,128,224,128,224,0,0,0,
/* 230 */	        144,96,240,96,144,0,0,0,
/* 231 */	        224,32,64,32,224,0,0,0,
/* 232 */	        144,176,208,144,144,0,0,0,
/* 233 */	        144,176,208,144,144,0,0,0,
/* 234 */	        160,192,128,192,160,0,0,0,
/* 235 */	        96,160,160,160,160,0,0,0,
/* 236 */	        136,216,168,136,136,0,0,0,
/* 237 */	        160,160,224,160,160,0,0,0,
/* 238 */	        224,160,160,160,224,0,0,0,
/* 239 */	        224,160,160,160,160,0,0,0,
/* 240 */	        224,160,224,128,128,0,0,0,
/* 241 */	        224,128,128,128,224,0,0,0,
/* 242 */	        224,64,64,64,64,0,0,0,
/* 243 */	        160,160,224,32,224,0,0,0,
/* 244 */	        248,168,168,248,32,0,0,0,
/* 245 */	        144,96,96,96,144,0,0,0,
/* 246 */	        160,160,160,160,240,0,0,0,
/* 247 */	        160,160,224,32,32,0,0,0,
/* 248 */	        168,168,168,168,248,0,0,0,
/* 249 */	        168,168,168,168,252,0,0,0,
/* 250 */	        192,64,112,80,112,0,0,0,
/* 251 */	        136,136,232,168,232,0,0,0,
/* 252 */	        128,128,224,160,224,0,0,0,
/* 253 */	        224,32,224,32,224,0,0,0,
/* 254 */	        184,168,232,168,184,0,0,0,
/* 255 */	        240,144,240,80,144,0,0,0
};
